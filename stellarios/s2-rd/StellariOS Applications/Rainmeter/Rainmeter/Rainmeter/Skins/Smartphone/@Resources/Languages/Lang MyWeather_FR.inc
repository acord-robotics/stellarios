[Variables]
Viento_Dir="W":"O","E":"E","N":"N","S":"S","CALM":"0","VAR":"- -"

Niveles="Low":"Faible","Moderate":"Modérée","High":"Haute","Very":"Très","Extreme":"Extreme","steady":"Stables","rising":"La hausse","falling":"Tomber","rapidly":"Rapidement","calm":" "

Semana="Monday":"Lundi","Tuesday":"Mardi","Wednesday":"Mercredi","Thursday":"Jeudi","Friday":"Vendredi","Saturday":"Samedi","Sunday":"Dimanche"

LunaEstado="Full":"Pleine","Waning Gibbous":"Lune décroissante","Last Quarter":"Dernier quartier","Waning Crescent":"Lune descendante","New":"Nouvelle","Waxing Crescent":"Lune ascendante","First Quarter":"Premier quartier","Waxing Gibbous":"Lune croissante","Moon":""

DirViento="W":"ouest","E":"Est","N":"Nord","S":"Sud","NNE":"nord-est nord-est","NE":"nord-est","ENE":"nord-est","ESE":"sud-est","SE":"sud-est","SSE":"sud-est","SSW":"sud-ouest sud-ouest","SW":"sud-ouest sud-ouest","WSW":"sud-ouest sud-ouest","WNW":"ouest sud-ouest","NW":"ouest nord-ouest","NNW":"nord ouest","calm":"calme","VAR":"Variable"

MedidaViento="km/h":"Kilomètres par heure","mph":"Miles par heure"

EnPunto=heure
Voz01=ce sont les
Voz02=La température extérieure est
Voz03=degrés
Voz04=et le temps est
Voz05=La pression est de
Voz06=et l'humidité de
Voz07=La vitesse du vent est
Voz08=de la
Voz09=Risque de pluie
Voz10=Cette nuit
Voz11=avec un minimum de
