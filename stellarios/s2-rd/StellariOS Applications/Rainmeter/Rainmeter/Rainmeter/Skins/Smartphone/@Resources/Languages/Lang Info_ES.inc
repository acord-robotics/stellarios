[Variables]
WS01=Administrador de tareas
WS02=Monitor de recursos
WS03=Administrador de dispositivos
WS04=Administrador de discos
WS05=Administrador de sonido
WS06=Conexiones de Red
WS07=Visor de eventos
WS08=Configuración de energía
WS09=Diagnósticos de DirectX
WS10=Optimizador de discos
WS11=Liberador de espacio
WS12=Desinstalador de aplicaciones
WS13=Cortafuegos
WS14=Editor del registro
WS15=Ajustes del ratón
WS16=Ajustes de la hora y fecha
WS17=Configuración del inicio
WS18=Configuración de Windows
WS19=Panel de Control
WS20=Información del sistema
WS21=Carpeta Mis Documentos
WS22=Carpeta Mi Música
WS23=Carpeta Mis Fotos
WS24=Carpeta Mis Videos
WS25=Carpeta Descargas
WS26=Carpeta Escritorio
WS27=Papelera
WS28=Acerca de Windows
Ajustes=AJUSTES
Juegos=JUEGOS
Marcadores=MARCADORES
InfoWCH=Sólo se traduce al idioma local las condiciones meteorológicas de la aplicacion My Weather. Los textos del SmartPhone estarán en inglés
InfoTT1=Ampliar imagen
InfoTT2=Los datos se reciben en grados Centígrados, la presión en hPa y el viento en km/h
InfoPL1=Otros reproductores necesitan plugins externos
InfoPL2=Pulsa aquí para más información
InfoPL3=Introduce Carpeta MP3
