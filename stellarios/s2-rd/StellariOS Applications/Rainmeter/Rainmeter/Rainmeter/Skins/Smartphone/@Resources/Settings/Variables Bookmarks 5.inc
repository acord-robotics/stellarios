[Variables]
Be01=http://pngimg.com/
Be02=https://www.kisspng.com/
Be03=https://icons8.com/icons
Be04=http://www.iconarchive.com/
Be05=https://www.urbanfonts.com/
Be06=https://www.dafont.com/
Be07=https://www.fontsquirrel.com/
Be08=https://freebiesbug.com/
Be09=https://www.pexels.com/
Be10=https://www.zedge.net/ringtones-and-wallpapers
Be11=https://wallup.net/
Be12=https://unsplash.com/t/wallpapers
Be13=http://dig.ccmixter.org/
Be14=http://soundbible.com/
Be15=https://www.soundjay.com/
Be16=https://soundpacks.com/
Be17=http://freemusicarchive.org/
Be18=https://mobygratis.com/
Be19=https://www.sshhtt.com/
Be20=https://www.jamendo.com/
Be21=
Be22=
Be23=
Be24=
Be25=
Be26=
Be27=
Be28=
