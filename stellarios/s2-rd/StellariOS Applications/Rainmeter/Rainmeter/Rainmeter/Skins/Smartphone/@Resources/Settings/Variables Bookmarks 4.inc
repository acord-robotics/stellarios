[Variables]
Bd01=http://retromusic.cz/?language=en
Bd02=http://www.105.net/sezioni/631/video
Bd03=https://www.capital.it/tv
Bd04=https://www.deejay.it/tv
Bd05=http://radiou.com/tv
Bd06=http://www.utv.ro/live
Bd07=http://russianmusicbox.tv
Bd08=http://www.cmc-tv.com
Bd09=https://videosmusicalesdelos80.com/
Bd10=http://www.vimutv.com
Bd11=https://tunein.com/
Bd12=https://www.radionomy.com/en/style
Bd13=https://www.reverbnation.com/main/discover
Bd14=https://www.last.fm/
Bd15=https://music.amazon.es/home
Bd16=https://soundcloud.com/
Bd17=https://www.spotify.com/
Bd18=https://music.youtube.com/
Bd19=https://us.napster.com/
Bd20=https://www.internetdj.com/
Bd21=
Bd22=
Bd23=
Bd24=
Bd25=
Bd26=
Bd27=
Bd28=
