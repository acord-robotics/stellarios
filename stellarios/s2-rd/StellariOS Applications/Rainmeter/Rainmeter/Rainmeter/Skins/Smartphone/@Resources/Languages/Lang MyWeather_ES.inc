[Variables]
Viento_Dir="W":"O","E":"E","N":"N","S":"S","CALM":"0","VAR":"- -"

Niveles="Low":"Bajo","Moderate":"Moderado","High":"Alto","Very":"Muy","Extreme":"Extremo","steady":"Estable","rising":"Subiendo","falling":"Bajando","rapidly":"rАpido","calm":" "

Semana="Monday":"Lunes","Tuesday":"Martes","Wednesday":"MiИrcoles","Thursday":"Jueves","Friday":"Viernes","Saturday":"SАbado","Sunday":"Domingo"

LunaEstado="Full":"Luna Llena","Waning Gibbous":"Menguante","Last Quarter":"Cuarto Menguante","Waning Crescent":"Menguante Decreciente","New":"Luna Nueva","Waxing Crescent":"Menguante Creciente","First Quarter":"Primer Menguante","Waxing Gibbous":"Cuarto Creciente","Moon":""

DirViento="W":"Oeste","E":"Este","N":"Norte","S":"Sur","NNE":"Norte noreste","NE":"Noreste","ENE":"Este Noreste","ESE":"Este Sureste","SE":"Sureste","SSE":"Sur Sureste","SSW":"Sur Suroeste","SW":"Suroeste","WSW":"Oeste Suroeste","WNW":"Oeste Noroeste","NW":"Noroeste","NNW":"Norte Noroeste","CALM":"en calma","VAR":"direcciСn variable"

MedidaViento="mph":"millas por hora","km/h":"Kilometros por hora"

EnPunto=En punto
Voz01=Son las
Voz02=La temperatura en el exterior es de
Voz03=grados
Voz04=y el tiempo es
Voz05=La presion es de
Voz06=y la humedad de
Voz07=La velocidad del viento es
Voz08=del
Voz09=Posibilidad de lluvia
Voz10=Esta noche
Voz11=con una mМnima de
