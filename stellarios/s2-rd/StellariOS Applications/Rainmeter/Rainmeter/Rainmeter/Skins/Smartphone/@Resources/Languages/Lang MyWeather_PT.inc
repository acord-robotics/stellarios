[Variables]
Viento_Dir="W":"W","E":"E","N":"N","S":"S","CALM":"0","VAR":"- -"

Niveles="Low":"Baixo","Moderate":"Moderado","High":"Alto","Very":"Muito","Extreme":"Extremo","steady":"Constante","rising":"Aumentando","falling":"Queda","rapidly":"Rapidamente","calm":" "

Semana="Monday":"2 feira","Tuesday":"3 feira","Wednesday":"4 feira","Thursday":"5 feira","Friday":"6 feira","Saturday":"Sábado","Sunday":"Domingo"

LunaEstado="New":"Nova","Waxing Crescent":"Crescente","First Quarter":"Quarto Crescente","Waxing Gibbous":"Crescente","Full":"Cheia","Waning Gibbous":"Minguante","Last Quarter":"Quarto Minguante","Waning Crescent":"Minguante","Moon":""

DirViento="W":"Oeste","E":"Este","N":"Norte","S":"south","NNE":"nordeste norte","NE":"Nordeste","ENE":"nordeste leste","ESE":"leste sudeste","SE":"Surdeste","SSE":"sudeste sul","SSW":"sul sudoeste","SW":"Sudoeste","WSW":"Oeste Sudoeste","WNW":"Oeste Noroeste","NW":"Noroeste","NNW":"Norte Noroeste","calm":"na calma","VAR":"variável"

MedidaViento="km/h":"Quilômetros por hora","mph":"milhas por hora"

EnPunto=Horas
Voz01=São as
Voz02=A temperatura exterior é
Voz03=graus
Voz04=e o tempo é
Voz05=A pressão é de
Voz06=y la humedad de
Voz07=e a umidade de
Voz08=do
Voz09=Possibilidade de chuva
Voz10=Esta noite
Voz11=com um mínimo de



