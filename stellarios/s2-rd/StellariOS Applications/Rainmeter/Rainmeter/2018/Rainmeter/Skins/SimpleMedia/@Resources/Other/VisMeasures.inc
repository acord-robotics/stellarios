[MeasureAudio]
Measure=Plugin
Plugin=AudioLevel
Port=Output
FFTSize=4100
FFTOverlap=3600
FFTAttack=500
FFTDecay=250
Bands=#Bars#
FreqMin=32
FreqMax=20400
Sensitivity=45
;Sensitivity=33

[MeasureBand0]
BandIdx=0
Measure=Plugin
Plugin=AudioLevel
Parent=MeasureAudio
Type=Band

[MeasureBand1]
BandIdx=1
Measure=Plugin
Plugin=AudioLevel
Parent=MeasureAudio
Type=Band

[MeasureBand2]
BandIdx=2
Measure=Plugin
Plugin=AudioLevel
Parent=MeasureAudio
Type=Band

[MeasureBand3]
BandIdx=3
Measure=Plugin
Plugin=AudioLevel
Parent=MeasureAudio
Type=Band

[MeasureBand4]
BandIdx=4
Measure=Plugin
Plugin=AudioLevel
Parent=MeasureAudio
Type=Band

[MeasureBand5]
BandIdx=5
Measure=Plugin
Plugin=AudioLevel
Parent=MeasureAudio
Type=Band

[MeasureBand6]
BandIdx=6
Measure=Plugin
Plugin=AudioLevel
Parent=MeasureAudio
Type=Band

[MeasureBand7]
BandIdx=7
Measure=Plugin
Plugin=AudioLevel
Parent=MeasureAudio
Type=Band

[MeasureBand8]
BandIdx=8
Measure=Plugin
Plugin=AudioLevel
Parent=MeasureAudio
Type=Band

[MeasureBand9]
BandIdx=9
Measure=Plugin
Plugin=AudioLevel
Parent=MeasureAudio
Type=Band

[MeasureBand10]
BandIdx=10
Measure=Plugin
Plugin=AudioLevel
Parent=MeasureAudio
Type=Band

[MeasureBand11]
BandIdx=11
Measure=Plugin
Plugin=AudioLevel
Parent=MeasureAudio
Type=Band

[MeasureBand12]
BandIdx=12
Measure=Plugin
Plugin=AudioLevel
Parent=MeasureAudio
Type=Band

[MeasureBand13]
BandIdx=13
Measure=Plugin
Plugin=AudioLevel
Parent=MeasureAudio
Type=Band

[MeasureBand14]
BandIdx=14
Measure=Plugin
Plugin=AudioLevel
Parent=MeasureAudio
Type=Band

[MeasureBand15]
BandIdx=15
Measure=Plugin
Plugin=AudioLevel
Parent=MeasureAudio
Type=Band

[MeasureBand16]
BandIdx=16
Measure=Plugin
Plugin=AudioLevel
Parent=MeasureAudio
Type=Band

[MeasureBand17]
BandIdx=17
Measure=Plugin
Plugin=AudioLevel
Parent=MeasureAudio
Type=Band

[MeasureBand18]
BandIdx=18
Measure=Plugin
Plugin=AudioLevel
Parent=MeasureAudio
Type=Band

[MeasureBand19]
BandIdx=19
Measure=Plugin
Plugin=AudioLevel
Parent=MeasureAudio
Type=Band

[MeasureBand20]
BandIdx=20
Measure=Plugin
Plugin=AudioLevel
Parent=MeasureAudio
Type=Band

[MeasureBand21]
BandIdx=21
Measure=Plugin
Plugin=AudioLevel
Parent=MeasureAudio
Type=Band

[MeasureBand22]
BandIdx=22
Measure=Plugin
Plugin=AudioLevel
Parent=MeasureAudio
Type=Band

[MeasureBand23]
BandIdx=23
Measure=Plugin
Plugin=AudioLevel
Parent=MeasureAudio
Type=Band

[MeasureBand24]
BandIdx=24
Measure=Plugin
Plugin=AudioLevel
Parent=MeasureAudio
Type=Band

[MeasureBand25]
BandIdx=25
Measure=Plugin
Plugin=AudioLevel
Parent=MeasureAudio
Type=Band

[MeasureBand26]
BandIdx=26
Measure=Plugin
Plugin=AudioLevel
Parent=MeasureAudio
Type=Band

[MeasureBand27]
BandIdx=27
Measure=Plugin
Plugin=AudioLevel
Parent=MeasureAudio
Type=Band

[MeasureBand28]
BandIdx=28
Measure=Plugin
Plugin=AudioLevel
Parent=MeasureAudio
Type=Band

[MeasureBand29]
BandIdx=29
Measure=Plugin
Plugin=AudioLevel
Parent=MeasureAudio
Type=Band

[MeasureBand30]
BandIdx=30
Measure=Plugin
Plugin=AudioLevel
Parent=MeasureAudio
Type=Band

[MeasureBand31]
BandIdx=31
Measure=Plugin
Plugin=AudioLevel
Parent=MeasureAudio
Type=Band

[MeasureBand32]
BandIdx=32
Measure=Plugin
Plugin=AudioLevel
Parent=MeasureAudio
Type=Band

[MeasureBand33]
BandIdx=33
Measure=Plugin
Plugin=AudioLevel
Parent=MeasureAudio
Type=Band

[MeasureBand34]
BandIdx=34
Measure=Plugin
Plugin=AudioLevel
Parent=MeasureAudio
Type=Band

[MeasureBand35]
BandIdx=35
Measure=Plugin
Plugin=AudioLevel
Parent=MeasureAudio
Type=Band

[MeasureBand36]
BandIdx=36
Measure=Plugin
Plugin=AudioLevel
Parent=MeasureAudio
Type=Band

[MeasureBand37]
BandIdx=37
Measure=Plugin
Plugin=AudioLevel
Parent=MeasureAudio
Type=Band

[MeasureBand38]
BandIdx=38
Measure=Plugin
Plugin=AudioLevel
Parent=MeasureAudio
Type=Band

[MeasureBand39]
BandIdx=39
Measure=Plugin
Plugin=AudioLevel
Parent=MeasureAudio
Type=Band

[MeasureBand40]
BandIdx=40
Measure=Plugin
Plugin=AudioLevel
Parent=MeasureAudio
Type=Band

[MeasureBand41]
BandIdx=41
Measure=Plugin
Plugin=AudioLevel
Parent=MeasureAudio
Type=Band

[MeasureBand42]
BandIdx=42
Measure=Plugin
Plugin=AudioLevel
Parent=MeasureAudio
Type=Band

[MeasureBand43]
BandIdx=43
Measure=Plugin
Plugin=AudioLevel
Parent=MeasureAudio
Type=Band

[MeasureBand44]
BandIdx=44
Measure=Plugin
Plugin=AudioLevel
Parent=MeasureAudio
Type=Band

[MeasureBand45]
BandIdx=45
Measure=Plugin
Plugin=AudioLevel
Parent=MeasureAudio
Type=Band

[MeasureBand46]
BandIdx=46
Measure=Plugin
Plugin=AudioLevel
Parent=MeasureAudio
Type=Band

[MeasureBand47]
BandIdx=47
Measure=Plugin
Plugin=AudioLevel
Parent=MeasureAudio
Type=Band

[MeasureBand48]
BandIdx=48
Measure=Plugin
Plugin=AudioLevel
Parent=MeasureAudio
Type=Band

[MeasureBand49]
BandIdx=49
Measure=Plugin
Plugin=AudioLevel
Parent=MeasureAudio
Type=Band

[MeasureBand50]
BandIdx=50
Measure=Plugin
Plugin=AudioLevel
Parent=MeasureAudio
Type=Band