;                          M@@@@@@@r                          
;                       ;@@@h    ,@@@B                       
;                     3@@@r         M@@@:                       /$$      /$$                               /$$                     /$$
;                   9@@@,     ;r:     h@@@;                    | $$  /$ | $$                              |__/                    | $$
;                 #@@#      B@@@@@s     r@@@3                  | $$ /$$$| $$  /$$$$$$   /$$$$$$  /$$$$$$$  /$$ /$$$$$$$   /$$$$$$ | $$
;              ;@@@G     ,#@@@@@@@@@h     ,@@@S                | $$/$$ $$ $$ |____  $$ /$$__  $$| $$__  $$| $$| $$__  $$ /$$__  $$| $$
;            r@@@s     r@@@@@@Gh#@@@@@B      #@@#              | $$$$_  $$$$  /$$$$$$$| $$  \__/| $$  \ $$| $$| $$  \ $$| $$  \ $$|__/
;          2@@@;     3@@@@@@S     @@@@@@#,     G@@@;           | $$$/ \  $$$ /$$__  $$| $$      | $$  | $$| $$| $$  | $$| $$  | $$    
;        B@@@:     H@@@@@@@@;     @@@@@@@@@;     3@@@r         | $$/   \  $$|  $$$$$$$| $$      | $$  | $$| $$| $$  | $$|  $$$$$$$ /$$
;     :@@@B     :#@@@@@@@@@@s     @@@@@@@@@@@3     r@@@h       |__/     \__/ \_______/|__/      |__/  |__/|__/|__/  |__/ \____  $$|__/
;   ;@@@2     ;@@@@@@@@@@@@@s     @@@@@@@@@@@@@H     :@@@G                                                               /$$  \ $$   
; ;@@@r     s@@@@@@@@@@@@@@@s     @@@@@@@@@@@@@@@#:     B@@B                                                            |  $$$$$$/    
;@@@B     ;@@@@@@@@@@@@@@@@@s     @@@@@@@@@@@@@@@@@@      @@@                                                            \______/    
;#@@@      @@@@@@@@@@@@@@@@@r     @@@@@@@@@@@@@@@@@G      @@@   Do not modify this file. Please use the settings windows in NXT-OS to edit setttings.
;  B@@B     :B@@@@@@@@@@@@@@r     @@@@@@@@@@@@@@@3     r@@@r    Many settings in this file have to be changed through other interfaces, such as the 
;    B@@@:     H@@@@@@@@@@@@@3;,;#@@@@@@@@@@@@@;     h@@@r      ones built in to widgets. 
;      h@@@;     3@@@@@@@@@@@@@@@@@@@@@@@@@@#:     G@@@,     
;        r@@@3     ;@@@@@@@@h     @@@@@@@@G      @@@#           Modifying this file could lead to problems with NXT-OS.
;          ,@@@G     :#@@@@@G     @@@@@@h     ;@@@H          
;             #@@#      G@@@@@@@@@@@@@r     s@@@s            
;               9@@@;     h@@@@@@@@@;     H@@@;              
;                 s@@@r     r@@@@#      M@@@                 
;                   ;@@@S            :@@@G                   
;                     :@@@B        r@@@h                     
;                        B@@@,   3@@@r                       
;                          ;@@@@@@G                          



[Variables]
Animate.Hud=1
Animation.Dock=12
Animation.Drawer=45
Animation.FPS=16
Animation.GameDrawer=40
Animation.Hud=40
Animation.Notify=50

CenterClock.AlbumDisplay=0
CenterClock.AtbgStyle=0
CenterClock.Behavior=Hdd
CenterClock.DriveLetter=C
CenterClock.Glass=1
CenterClock.NoArtStyle=0
CenterClock.Scale=0.5
CenterClock.SmoothSeconds=0
CenterClock.TickStyle=13

Color.Clipboard=0
Color.ClockDot=255,255,255
Color.ClockMain=255,255,255
Color.ClockSecHand=255,255,255,180
Color.ClockSecondary=255,255,255,180
Color.Command=0
Color.Dock=255,255,255,85
Color.DockFolderBackground=255,255,255
Color.DockFolderText=80,80,80
Color.DockFolderTint=80,80,80
Color.DockIcon=255,255,255
Color.Glass=0,0,0,150
Color.Main=255,255,255
Color.Notification=0
Color.TopLabel=0

Dash.SingleScreen=0
Dash.Widget.HDD.1=C
Dash.Widget.HDD.2=D
Dash.Widget.HDD.3=E
Dash.Widget.HDD.4=F
Dash.Widget.Sticky.Text=You can type in this widget!!

Dock.CenterAction=[Shell:::{2559a1f8-21d7-11d4-bdaf-00c04f60b9f0}]
Dock.CenterIcon=Resources\Images\Center\Center.png
Dock.Scale=0.5

Drawer.CloseOnLaunch=0
Drawer.ShowMenuButton=0

GameDrawer.CloseOnButton=1
GameDrawer.CloseOnGame=0
GameDrawer.DrawerMode=1
GameDrawer.GameTabPosition=3
GameDrawer.ProfilePic=851a981d490b2fd21862dfe2db097460407784f6
GameDrawer.SteamPath=C:\Program Files (x86)\Steam
GameDrawer.SteamUser=IrisDroidology
GameDrawer.UserDataID=275924434

LockScreen.Dots=0
LockScreen.Enable=1
LockScreen.SecondDots=0
LockScreen.ShowBG=0
LockScreen.Wallpaper=#@#\Wallpapers\Wallpaper.png
LockScreen.WallpaperB=1
LockScreen.Tint=154

Monitor.MainNum=P
Monitor.MainX=#PSCREENAREAX#
Monitor.MainY=#PSCREENAREAY#
Monitor.MainW=#PSCREENAREAWIDTH#
Monitor.MainH=#PSCREENAREAHEIGHT#

Notification.Battery=0
Notification.CapsLock=0
Notification.Duration=5
Notification.HudDuration=2
Notification.MicCheck=0
Notification.Music=0
Notification.NumLock=0
Notification.Speakers=0
Notification.Update=0

Sound.DockClick=1
Sound.DockScroll=1
Sound.DrawerClick=1
Sound.DrawerShift=1
Sound.GameHover=1
Sound.GameItemClick=1
Sound.GameLaunch=1
Sound.GameShift=1
Sound.GameTabClick=1
Sound.LockSound=1
Sound.TopClick=1

System.AutoVis=iTunes
System.ClipboardKeyModifier2=ALT
System.ClipboardKeyModifier=CTRL
System.ClipboardKey=V
System.ClipboardKeyState=0
System.CommandKey=F10
System.CommandKeyModifier=ALT
System.CommandKeyState=0
System.DashKey=F9
System.DashKeyModifier=ALT
System.DashKeyState=0
System.DateFormat=%A, %B %#d
System.DateLang=Local
System.DisplayPos=0
System.InputForce=1
System.InstallFinished=0
System.InstallType=Minimal
System.LockTimeout=0
System.Player=iTunes
System.PlayerPlugin=NowPlaying
System.TimeFormat=1
System.UpdateCheck=5
System.UpdateCheckMod=12
System.UserName=|
System.VisualizerMode=1
System.WeatherCode=USCA0273
System.WeatherUnit=1

Top.Quick.AutoHide=0
Top.Quick.Order=visualizer|command|dash|lock|add|power|rainmeter|drawer|
Top.Quick.ShowLabel=0
Top.Scale=0.61
Top.Widget.Clock.Align=CenterTop
Top.Widget.HDD.Drive1=C
Top.Widget.HDD.Drive2=D
Top.Widget.HDD.Drive3=F
Top.Widget.TextClock.Align=CenterTop
Top.Widget.TextClock.BoldSetting=#FirstWordBold#
Top.Widget.TextClock.Case=None
Top.Widget.TextClock.Date=1
Top.Widget.TextClock.Space=" "
Top.WidgetEditMode=0

Visualizer.Style=Bars
Visualizer.Smoothing=0
Visualizer.NumBars=80
Visualizer.FFTSize=128
Visualizer.FFTOverlap=64
Visualizer.FFTAttack=10
Visualizer.FFTDecay=125
Visualizer.FreqMin=20
Visualizer.FreqMax=160
Visualizer.Sensitivity=55
