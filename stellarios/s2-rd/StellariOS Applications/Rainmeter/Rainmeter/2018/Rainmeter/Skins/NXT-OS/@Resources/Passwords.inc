;                          M@@@@@@@r                          
;                       ;@@@h    ,@@@B                       
;                     3@@@r         M@@@:                       /$$      /$$                               /$$                     /$$
;                   9@@@,     ;r:     h@@@;                    | $$  /$ | $$                              |__/                    | $$
;                 #@@#      B@@@@@s     r@@@3                  | $$ /$$$| $$  /$$$$$$   /$$$$$$  /$$$$$$$  /$$ /$$$$$$$   /$$$$$$ | $$
;              ;@@@G     ,#@@@@@@@@@h     ,@@@S                | $$/$$ $$ $$ |____  $$ /$$__  $$| $$__  $$| $$| $$__  $$ /$$__  $$| $$
;            r@@@s     r@@@@@@Gh#@@@@@B      #@@#              | $$$$_  $$$$  /$$$$$$$| $$  \__/| $$  \ $$| $$| $$  \ $$| $$  \ $$|__/
;          2@@@;     3@@@@@@S     @@@@@@#,     G@@@;           | $$$/ \  $$$ /$$__  $$| $$      | $$  | $$| $$| $$  | $$| $$  | $$    
;        B@@@:     H@@@@@@@@;     @@@@@@@@@;     3@@@r         | $$/   \  $$|  $$$$$$$| $$      | $$  | $$| $$| $$  | $$|  $$$$$$$ /$$
;     :@@@B     :#@@@@@@@@@@s     @@@@@@@@@@@3     r@@@h       |__/     \__/ \_______/|__/      |__/  |__/|__/|__/  |__/ \____  $$|__/
;   ;@@@2     ;@@@@@@@@@@@@@s     @@@@@@@@@@@@@H     :@@@G                                                               /$$  \ $$   
; ;@@@r     s@@@@@@@@@@@@@@@s     @@@@@@@@@@@@@@@#:     B@@B                                                            |  $$$$$$/    
;@@@B     ;@@@@@@@@@@@@@@@@@s     @@@@@@@@@@@@@@@@@@      @@@                                                            \______/    
;#@@@      @@@@@@@@@@@@@@@@@r     @@@@@@@@@@@@@@@@@G      @@@   Do not modify this file. This file is used by NXT-OS' authentication system.
;  B@@B     :B@@@@@@@@@@@@@@r     @@@@@@@@@@@@@@@3     r@@@r    The password stored in this file is hashed, and is not ment to be user writen. 
;    B@@@:     H@@@@@@@@@@@@@3;,;#@@@@@@@@@@@@@;     h@@@r      To change your password go to the User settings in the NXT-OS settings menu. 
;      h@@@;     3@@@@@@@@@@@@@@@@@@@@@@@@@@#:     G@@@,     
;        r@@@3     ;@@@@@@@@h     @@@@@@@@G      @@@#           Modifying this file could leave you locked out of your computer.
;          ,@@@G     :#@@@@@G     @@@@@@h     ;@@@H          
;             #@@#      G@@@@@@@@@@@@@r     s@@@s            
;               9@@@;     h@@@@@@@@@;     H@@@;              
;                 s@@@r     r@@@@#      M@@@                 
;                   ;@@@S            :@@@G                   
;                     :@@@B        r@@@h                     
;                        B@@@,   3@@@r                       
;                          ;@@@@@@G                          


[Variables]
Password2=e3b0c44298fc1c149afbf4c8996fb92427ae41e4649b934ca495991b7852b855
Salt2=0
