[variables]
;We recommand you to use Notepad++ or Sublime Text for easier editing

;Global editing notes:
;	Use #CRLF# for line break
;	Use [explorer.exe "application path or folder path"] for launching applications and folders
;	Refer to https://docs.rainmeter.net/tips/launching-windows-special-folders/ for launching windows special folders
;	Go to https://materialdesignicons.com/ for more icons

;=========================================================================================================================
;Logo and Username tag
;Logo path: [Documents\Rainmeter\Skins\Spectrum\@Resources\Images\Logos] (We have already prepared some presets including dank memes, cool logos and your waifu)
;use 192x192 images
UserLogo=44518088_692029811184075_6677821834789912576_n.jpg
UserName=Liam

;=========================================================================================================================
;Drive settings
;Insert your HDD/SSD/whateverdrive letter here
Drive1=C:
Drive2=E:
Drive3=F:

;=========================================================================================================================
;Weather settings
;go to Weather.com for location code
Location=ASXX0089
;Unit: f for Liberia, Myanmar and USA, m for the rest of the world
Unit=m

;=========================================================================================================================
;Center Launchers
;Icons, on hover icons and paths (you can use it to launch everything because I can't tell you what to do)
;App icon path: [Documents\Rainmeter\Skins\Spectrum\@Resources\Images\CenterLauncherIcons]
;On hover icon path: [Documents\Rainmeter\Skins\Spectrum\@Resources\Images\CenterLauncherIcons\hover]
;Template in the folder

;TOP
Launcher1Action=
Launcher1Icon=Sai.png
Launcher1HoverIcon=Sai.png

;BOTTOM
Launcher2Action=
Launcher2Icon=Steam.png
Launcher2HoverIcon=Steam.png

;LEFT TOP
Launcher3Action=
Launcher3Icon=Photoshop.png
Launcher3HoverIcon=Photoshop.png

;LEFT BOTTOM
Launcher4Action=
Launcher4Icon=iTunes.png
Launcher4HoverIcon=iTunes.png

;RIGHT TOP
Launcher5Action=
Launcher5Icon=Illustrator.png
Launcher5HoverIcon=Illustrator.png

;RIGHT BOTTOM
Launcher6Action=
Launcher6Icon=Soundnode.png
Launcher6HoverIcon=Soundnode.png

;=========================================================================================================================
;Large Launchers
;Icons, on hover backgrounds, names and paths (you can use it to launch everything because again, I can't tell you what to do)
;Icon path: [Documents\Rainmeter\Skins\Spectrum\@Resources\Images\LargeLauncherIcons] (use 144x144 transparent images)
;On hover background path: [Documents\Rainmeter\Skins\Spectrum\@Resources\Images\LargeLauncherIcons\hover] (use 256x256 images)

;Change the font here 
;PSA: SELECT YOUR FONT CAREFULLY BECAUSE FONTS ARE VERY SERIOUS BUSINESS. IF YOU USE ARIAL, COMIC SANS, PAPYRUS, IMPACT, TIMES OR JOKERSMAN, I WILL FIND YOU AND I WILL DELETE ALL OF THEM AND FORCE YOU TO INSTALL ACTUAL GOOD FONTS.
;Fonts that come with this skin:[Documents\Rainmeter\Skins\Spectrum\@Resources\Fonts]
LargeLauncherFont=San Francisco Thin

SLauncher1Action=
SLauncher1Name=
SLauncher1Icon=
SLauncher1OverBG=68

SLauncher2Action=
SLauncher2Name=
SLauncher2Icon=
SLauncher2OverBG=63

SLauncher3Action=
SLauncher3Name=
SLauncher3Icon=
SLauncher3OverBG=60

SLauncher4Action=
SLauncher4Name=
SLauncher4Icon=
SLauncher4OverBG=40

SLauncher5Action=
SLauncher5Name=
SLauncher5Icon=
SLauncher5OverBG=75

SLauncher6Action=
SLauncher6Name=
SLauncher6Icon=
SLauncher6OverBG=56

;=========================================================================================================================
;Sidebar App Launchers
;App icons, paths and names
;App icon path: [Documents\Rainmeter\Skins\Spectrum\@Resources\Images\Appicons]
;use 48x48 images 

App1Icon=photos.png
App1Action=ms-photos:
App1Name=Gallery

App2Icon=calc.png
App2Action=calculator://
App2Name=Calculator

App3Icon=paint.png
App3Action=explorer.exe "C:\WINDOWS\system32\mspaint.exe"
App3Name=Paint

App4Icon=screenshot.png
App4Action=explorer.exe "C:\WINDOWS\system32\SnippingTool.exe"
App4Name=Capture

App5Icon=charmap.png
App5Action=explorer.exe "C:\WINDOWS\system32\Charmap.exe"
App5Name=Character#CRLF#Map

App6Icon=
App6Action=
App6Name=

App7Icon=
App7Action=
App7Name=

App8Icon=
App8Action=
App8Name=

App9Icon=
App9Action=
App9Name=

App10Icon=
App10Action=
App10Name=

App11Icon=
App11Action=
App11Name=

App12Icon=
App12Action=
App12Name=

App13Icon=
App13Action=
App13Name=

App14Icon=
App14Action=
App14Name=

App15Icon=
App15Action=
App15Name=

App16Icon=
App16Action=
App16Name=

App17Icon=
App17Action=
App17Name=

App18Icon=
App18Action=
App18Name=

App19Icon=
App19Action=
App19Name=

App20Icon=
App20Action=
App20Name=

App21Icon=
App21Action=
App21Name=

App22Icon=
App22Action=
App22Name=

App23Icon=
App23Action=
App23Name=

App24Icon=
App24Action=
App24Name=

;=========================================================================================================================
;Sidebar Folder Launchers
;Folder icons, paths and names
;App icon path: [Documents\Rainmeter\Skins\Spectrum\@Resources\Images\Foldericons]
;use 48x48 images 

Folder1Icon=computer.png
Folder1Action=::{20D04FE0-3AEA-1069-A2D8-08002B30309D}
Folder1Name=This PC

Folder2Icon=self.png
Folder2Action=shell:Desktop
Folder2Name=Desktop

Folder3Icon=download.png
Folder3Action=explorer.exe "%UserProfile%\Downloads"
Folder3Name=Download

Folder4Icon=documents.png
Folder4Action=explorer.exe "%UserProfile%\Documents"
Folder4Name=Document

Folder5Icon=
Folder5Action=
Folder5Name=

Folder6Icon=
Folder6Action=
Folder6Name=

Folder7Icon=
Folder7Action=
Folder7Name=

Folder8Icon=
Folder8Action=
Folder8Name=

Folder9Icon=
Folder9Action=
Folder9Name=

Folder10Icon=
Folder10Action=
Folder10Name=

Folder11Icon=
Folder11Action=
Folder11Name=

Folder12Icon=
Folder12Action=
Folder12Name=

Folder13Icon=
Folder13Action=
Folder13Name=

Folder14Icon=
Folder14Action=
Folder14Name=

Folder15Icon=
Folder15Action=
Folder15Name=

Folder16Icon=
Folder16Action=
Folder16Name=

Folder17Icon=
Folder17Action=
Folder17Name=

Folder18Icon=
Folder18Action=
Folder18Name=

Folder19Icon=
Folder19Action=
Folder19Name=

Folder20Icon=
Folder20Action=
Folder20Name=

Folder21Icon=
Folder21Action=
Folder21Name=

Folder22Icon=
Folder22Action=
Folder22Name=

Folder23Icon=
Folder23Action=
Folder23Name=

Folder24Icon=
Folder24Action=
Folder24Name=

;=========================================================================================================================
;Sidebar Website Launchers
;Website icons, paths and names
;App icon path: [Documents\Rainmeter\Skins\Spectrum\@Resources\Images\Webicons]
;use 48x48 images 

Web1Icon=
Web1Action=
Web1Name=

Web2Icon=
Web2Action=
Web2Name=

Web3Icon=
Web3Action=
Web3Name=

Web4Icon=
Web4Action=
Web4Name=

Web5Icon=
Web5Action=
Web5Name=

Web6Icon=
Web6Action=
Web6Name=

Web7Icon=
Web7Action=
Web7Name=

Web8Icon=
Web8Action=
Web8Name=

Web9Icon=
Web9Action=
Web9Name=

Web10Icon=
Web10Action=
Web10Name=

Web11Icon=
Web11Action=
Web11Name=

Web12Icon=
Web12Action=
Web12Name=

Web13Icon=
Web13Action=
Web13Name=

Web14Icon=
Web14Action=
Web14Name=

Web15Icon=
Web15Action=
Web15Name=

Web16Icon=
Web16Action=
Web16Name=

Web17Icon=
Web17Action=
Web17Name=

Web18Icon=
Web18Action=
Web18Name=

Web19Icon=
Web19Action=
Web19Name=

Web20Icon=
Web20Action=
Web20Name=

Web21Icon=
Web21Action=
Web21Name=

Web22Icon=
Web22Action=
Web22Name=

Web23Icon=
Web23Action=
Web23Name=

Web24Icon=
Web24Action=
Web24Name=
