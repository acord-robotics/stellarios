[Variables]

;;ADOBE;;
AfterEffects=["C:\Path\To\App.exe"]
Audition=["C:\Path\To\App.exe"]
Bridge=["C:\Path\To\App.exe"]
Dreamweaver=["C:\Path\To\App.exe"]
Encore=["C:\Path\To\App.exe"]
Fireworks=["C:\Path\To\App.exe"]
FlashBuilder=["C:\Path\To\App.exe"]
FlashPro=["C:\Path\To\App.exe"]
Illustrator=["C:\Path\To\App.exe"]
InDesign=["C:\Path\To\App.exe"]
Lightroom=["C:\Path\To\App.exe"]
Photoshop=["C:\Path\To\App.exe"]
Prelude=["C:\Path\To\App.exe"]
PremirePro=[""]
SpeedGrade=["C:\Path\To\App.exe"]

;;MICROSOFT OFFICE;;
Access=["C:\Path\To\App.exe"]
Excel=["C:\Path\To\App.exe"]
infoPath=["C:\Path\To\App.exe"]
Lync=["C:\Path\To\App.exe"]
Office=["C:\Path\To\App.exe"]
OneNote=["C:\Path\To\App.exe"]
Outlook=["C:\Path\To\App.exe"]
PowerPoint=["C:\Path\To\App.exe"]
Project=["C:\Path\To\App.exe"]
Publisher=["C:\Path\To\App.exe"]
Visio=["C:\Path\To\App.exe"]
Word=["C:\Path\To\App.exe"]

;;--;;
AbletonLive=["C:\Path\To\App.exe"]
Android Studio=["C:\Path\To\App.exe"]
;Arma="steam://rungameid/107410"
Arma="C:\Games\Arma3\arma3.exe"
Audacity=["C:\Path\To\App.exe"]
Avast=["C:\Path\To\App.exe"]
AVG=["C:\Path\To\App.exe"]
Battlenet=["C:\Program Files (x86)\Battle.net\Battle.net Launcher.exe"]
BattleBlockTheater="steam://rungameid/238460"
BattlefieldFour=["C:\Program Files (x86)\Origin Games\Battlefield 4\bf4"]
BattlefieldHardline=["C:\Path\To\App.exe"]
Bittorrent=["C:\Path\To\App.exe"]
Blade=["C:\Path\To\App.exe"]
Blender=["C:\Path\To\App.exe"]
Calculator="calc.exe"]
CallofDutyAdvancedWarfare=["steam://rungameid/209650"]
CallofDutyBlackOpsMultiplayer=["steam://rungameid/202990"]
CallofDutyBlackOpsSingleplayer=["steam://rungameid/202970"]
CallofDutyBlackOpsZombies=["steam://rungameid/212910"]
CallofDutyWaW=["steam://rungameid/10090"]
CCleaner=["C:\Path\To\App.exe"]
CitiesSkylines="steam://rungameid/255710"
CinemaFourD=["C:\Path\To\App.exe"]
CodeBlocks=["C:\Path\To\App.exe"]
ControlPanel=[%SystemRoot%\system32\control.exe]
Crazybump=["C:\Path\To\App.exe"]
CSGO="steam://rungameid/730"
Curse=["C:\Users\USERNAME\AppData\Roaming\Curse Client\Bin\Curse.exe"]
Dashlane=["C:\Path\To\App.exe"]
Deluge=["C:\Path\To\App.exe"]
Dirt=["C:\Path\To\App.exe"]
Discord=["C:\Path\To\App.exe"]
DocumentsFolder=["C:\Users\USERNAME\Documents"]
Dota=["C:\Path\To\App.exe"]
Downloads=["C:\Users\USERNAME\Downloads"]
Dropbox=["C:\Path\To\App.exe"]
Eclipse=["C:\Path\To\App.exe"]
EuropaUniversalisIV=["steam://rungameid/236850"]
Evolve=["C:\Path\To\App.exe"]
Facebook="https://facebook.com"
Fallout=["steam://rungameid/377160"]
FileExplorer=["C:\"]
FinalFantasy=["steam://rungameid/39210"]
FLStudio=["C:\Path\To\App.exe"]
Fraps=["C:\Path\To\App.exe"]
Games=["C:\Path\To\App.exe"]
GamesFolder=["C:\Path\To\App.exe"]
Garry=["steam://rungameid/4000"]
GeForceExperience=["C:\Path\To\App.exe"]
Gimp=["C:\Path\To\App.exe"]
GitHub=["C:\Path\To\App.exe"]
Gmail=["https://mail.google.com"]
GOG=["C:\Path\To\App.exe"]
Chrome=["C:\Program Files (x86)\Google\Chrome\Application\chrome.exe"]
GoogleDrive=["https://drive.google.com/"]
GTAV=["steam://rungameid/271590"]
HalfLife=["steam://rungameid/70"]
Hamachi=["C:\Program Files (x86)\LogMeIn Hamachi\hamachi-2-ui.exe"]
Hearthstone=["C:\Program Files (x86)\Hearthstone\Hearthstone Beta Launcher.exe"]
iTunes=["C:\Path\To\App.exe"]
Kodi=["C:\Program Files (x86)\Kodi\Kodi.exe"]
LeagueofLegends=["C:\Riot Games\League of Legends\lol.launcher.exe"]
LethalLeague=["C:\Games\Lethal League\Lethal League LanGame.exe"]
;LoLNexus="http://www.lolnexus.com/"
LoLNexus="C:\Dropbox\Data\Shortcuts\LoLNexus"
MadCatz=["C:\Path\To\App.exe"]
Marvel=["C:\Path\To\App.exe"]
MicrosoftVisualStudio=["C:\Path\To\App.exe"]
Minecraft=["C:\Path\To\App.exe"]
Monaco=["C:\Path\To\App.exe"]
MoviesFolder=["C:\Path\To\App.exe"]
MozillaFirefox=["C:\Path\To\App.exe"]
MSIAfterburner=["C:\Program Files (x86)\MSI Afterburner\MSIAfterburner.exe"]
Neverwinter=["C:\Path\To\App.exe"]
NotepadPlusPlus=["C:\Program Files (x86)\Notepad++\notpad++.exe"]
obs=["C:\Program Files (x86)\OBS\OBS.exe"]
Onedrive=["C:\Path\To\App.exe"]
OneFingerDeathPunch=["C:\Path\To\App.exe"]
Opera=["C:\Path\To\App.exe"]
Origin=["C:\Path\To\App.exe"]
Overwatch=["C:\Path\To\App.exe"]
payday_2=["steam://rungameid/218620"]
Pictures=["C:\Users\USERNAME\Pictures"]
Plex=["C:\Users\USERNAME\Pictures"]
PopcornTime=["C:\"]
Portal=["steam://rungameid/620"]
QuakeLive=["C:\Path\To\App.exe"]
RainbowSixVegas=["steam://rungameid/15120"]
RecycleBin=!execute [!RainmeterPluginBang "MeasureBinSize OpenBin"]
;RecycleBin=["C:\Dropbox\Data\Shortcuts\Uninstall_Programs"] ;Uncomment this for "Uninstall programs"
Reddit="http://www.reddit.com/"
RocketLeague="steam://rungameid/252950"
Runescape=["C:\Path\To\App.exe"]
Search=["#CURRENTPATH#Search.exe"]
Server=["C:\Path\To\App.exe"]
Skype=["C:\Program Files (x86)\Skype\Phone\Skype.exe"]
Skyrim=["steam://rungameid/72850"]
SonyVegas=["C:\Path\To\App.exe"]
Soundcloud="https://soundcloud.com"
Speedrunners=["steam://rungameid/207140"]
Spotify=["C:\Users\USERNAME\AppData\Roaming\Spotify"]
Steam=["C:\Program Files (x86)\Steam\Steam.exe"]
SublimeText=["C:\Path\To\App.exe"]
TeamFortress=["steam://rungameid/440"]
Teamspeak=["C:\Path\To\App.exe"]
TeamViewer=["C:\Program Files (x86)\TeamViewer\TeamViewer.exe"]
Terminal=["cmd"]
Terraria=["steam://rungameid/105600"]
Tunngle=["C:\Program Files (x86)\Tunngle\Tunngle.exe"]
Twitch="http://www.twitch.tv/"
Twitter="https://twitter.com"
Unity=["C:\Path\To\App.exe"]
UPlay=["C:\Path\To\App.exe"]
AAuTorrent=["C:\Users\Karl\AppData\Roaming\uTorrent\uTorrent.exe"]
uTorrent=["%APPDATA%\uTorrent\uTorrent.exe"]
VideosFolder=["C:\Users\USERNAME\Videos"]
VLCMediaPlayer=["C:\Program Files (x86)\VideoLAN\VLC\vlc.exe"]
WatchDogs=["steam://rungameid/243470"]
WindowsMediaPlayer=["%ProgramFiles(x86)%\Windows Media Player\wmplayer.exe"]
Witcher=["steam://rungameid/292030"]
WoW=["C:\Path\To\App.exe"]
XBMC=["C:\Path\To\App.exe"]
XSplit=["C:\Program Files (x86)\SplitmediaLabs\XSplit Broadcaster\XSplit.Core.exe"]
Youtube="https://www.youtube.com/"
