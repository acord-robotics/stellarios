; auto-generated by sFactoryBars
[0]
Meter=Roundline
MeterStyle=styleLine
StartAngle=10.995574287564
X=126.68
Y=44.8
LineLength=((([mBand0]+((1-0)=0?0:[mBand1]+[mBand79]))/3=0)?-1:((([mBand0]+((1-0)=0?0:[mBand1]+[mBand79]))/3-[mBand0])*1+[mBand0])*44.8+0)
DynamicVariables=1
[1]
Meter=Roundline
MeterStyle=styleLine
StartAngle=10.917034471225
X=120.2557692418
Y=45.052408713931
LineLength=((([mBand1]+((1-0)=0?0:[mBand2]+[mBand0]))/3=0)?-1:((([mBand1]+((1-0)=0?0:[mBand2]+[mBand0]))/3-[mBand1])*1+[mBand1])*44.8+0)
DynamicVariables=1
[2]
Meter=Roundline
MeterStyle=styleLine
StartAngle=10.838494654885
X=113.87114600251
Y=45.80807867207
LineLength=((([mBand2]+((1-0)=0?0:[mBand3]+[mBand1]))/3=0)?-1:((([mBand2]+((1-0)=0?0:[mBand3]+[mBand1]))/3-[mBand2])*1+[mBand2])*44.8+0)
DynamicVariables=1
[3]
Meter=Roundline
MeterStyle=styleLine
StartAngle=10.759954838545
X=107.56549360748
Y=47.062350917838
LineLength=((([mBand3]+((1-0)=0?0:[mBand4]+[mBand2]))/3=0)?-1:((([mBand3]+((1-0)=0?0:[mBand4]+[mBand2]))/3-[mBand3])*1+[mBand3])*44.8+0)
DynamicVariables=1
[4]
Meter=Roundline
MeterStyle=styleLine
StartAngle=10.681415022205
X=101.37768850058
Y=48.807492445753
LineLength=((([mBand4]+((1-0)=0?0:[mBand5]+[mBand3]))/3=0)?-1:((([mBand4]+((1-0)=0?0:[mBand5]+[mBand3]))/3-[mBand4])*1+[mBand4])*44.8+0)
DynamicVariables=1
[5]
Meter=Roundline
MeterStyle=styleLine
StartAngle=10.602875205866
X=95.345880557946
Y=51.032743877976
LineLength=((([mBand5]+((1-0)=0?0:[mBand6]+[mBand4]))/3=0)?-1:((([mBand5]+((1-0)=0?0:[mBand6]+[mBand4]))/3-[mBand5])*1+[mBand5])*44.8+0)
DynamicVariables=1
[6]
Meter=Roundline
MeterStyle=styleLine
StartAngle=10.524335389526
X=89.507257881326
Y=53.724385799456
LineLength=((([mBand6]+((1-0)=0?0:[mBand7]+[mBand5]))/3=0)?-1:((([mBand6]+((1-0)=0?0:[mBand7]+[mBand5]))/3-[mBand6])*1+[mBand6])*44.8+0)
DynamicVariables=1
[7]
Meter=Roundline
MeterStyle=styleLine
StartAngle=10.445795573186
X=83.897817521058
Y=56.865823342687
LineLength=((([mBand7]+((1-0)=0?0:[mBand8]+[mBand6]))/3=0)?-1:((([mBand7]+((1-0)=0?0:[mBand8]+[mBand6]))/3-[mBand7])*1+[mBand7])*44.8+0)
DynamicVariables=1
[8]
Meter=Roundline
MeterStyle=styleLine
StartAngle=10.367255756846
X=78.552143542292
Y=60.437688500579
LineLength=((([mBand8]+((1-0)=0?0:[mBand9]+[mBand7]))/3=0)?-1:((([mBand8]+((1-0)=0?0:[mBand9]+[mBand7]))/3-[mBand8])*1+[mBand8])*44.8+0)
DynamicVariables=1
[9]
Meter=Roundline
MeterStyle=styleLine
StartAngle=10.288715940507
X=73.503193802725
Y=64.417959536669
LineLength=((([mBand9]+((1-0)=0?0:[mBand10]+[mBand8]))/3=0)?-1:((([mBand9]+((1-0)=0?0:[mBand10]+[mBand8]))/3-[mBand9])*1+[mBand9])*44.8+0)
DynamicVariables=1
[10]
Meter=Roundline
MeterStyle=styleLine
StartAngle=10.210176124167
X=68.782096756446
Y=68.782096756445
LineLength=((([mBand10]+((1-0)=0?0:[mBand11]+[mBand9]))/3=0)?-1:((([mBand10]+((1-0)=0?0:[mBand11]+[mBand9]))/3-[mBand10])*1+[mBand10])*44.8+0)
DynamicVariables=1
[11]
Meter=Roundline
MeterStyle=styleLine
StartAngle=10.131636307827
X=64.417959536669
Y=73.503193802725
LineLength=((([mBand11]+((1-0)=0?0:[mBand12]+[mBand10]))/3=0)?-1:((([mBand11]+((1-0)=0?0:[mBand12]+[mBand10]))/3-[mBand11])*1+[mBand11])*44.8+0)
DynamicVariables=1
[12]
Meter=Roundline
MeterStyle=styleLine
StartAngle=10.053096491487
X=60.437688500579
Y=78.552143542292
LineLength=((([mBand12]+((1-0)=0?0:[mBand13]+[mBand11]))/3=0)?-1:((([mBand12]+((1-0)=0?0:[mBand13]+[mBand11]))/3-[mBand12])*1+[mBand12])*44.8+0)
DynamicVariables=1
[13]
Meter=Roundline
MeterStyle=styleLine
StartAngle=9.9745566751476
X=56.865823342687
Y=83.897817521058
LineLength=((([mBand13]+((1-0)=0?0:[mBand14]+[mBand12]))/3=0)?-1:((([mBand13]+((1-0)=0?0:[mBand14]+[mBand12]))/3-[mBand13])*1+[mBand13])*44.8+0)
DynamicVariables=1
[14]
Meter=Roundline
MeterStyle=styleLine
StartAngle=9.8960168588078
X=53.724385799456
Y=89.507257881326
LineLength=((([mBand14]+((1-0)=0?0:[mBand15]+[mBand13]))/3=0)?-1:((([mBand14]+((1-0)=0?0:[mBand15]+[mBand13]))/3-[mBand14])*1+[mBand14])*44.8+0)
DynamicVariables=1
[15]
Meter=Roundline
MeterStyle=styleLine
StartAngle=9.8174770424681
X=51.032743877976
Y=95.345880557946
LineLength=((([mBand15]+((1-0)=0?0:[mBand16]+[mBand14]))/3=0)?-1:((([mBand15]+((1-0)=0?0:[mBand16]+[mBand14]))/3-[mBand15])*1+[mBand15])*44.8+0)
DynamicVariables=1
[16]
Meter=Roundline
MeterStyle=styleLine
StartAngle=9.7389372261284
X=48.807492445753
Y=101.37768850058
LineLength=((([mBand16]+((1-0)=0?0:[mBand17]+[mBand15]))/3=0)?-1:((([mBand16]+((1-0)=0?0:[mBand17]+[mBand15]))/3-[mBand16])*1+[mBand16])*44.8+0)
DynamicVariables=1
[17]
Meter=Roundline
MeterStyle=styleLine
StartAngle=9.6603974097886
X=47.062350917838
Y=107.56549360748
LineLength=((([mBand17]+((1-0)=0?0:[mBand18]+[mBand16]))/3=0)?-1:((([mBand17]+((1-0)=0?0:[mBand18]+[mBand16]))/3-[mBand17])*1+[mBand17])*44.8+0)
DynamicVariables=1
[18]
Meter=Roundline
MeterStyle=styleLine
StartAngle=9.5818575934489
X=45.80807867207
Y=113.87114600251
LineLength=((([mBand18]+((1-0)=0?0:[mBand19]+[mBand17]))/3=0)?-1:((([mBand18]+((1-0)=0?0:[mBand19]+[mBand17]))/3-[mBand18])*1+[mBand18])*44.8+0)
DynamicVariables=1
[19]
Meter=Roundline
MeterStyle=styleLine
StartAngle=9.5033177771091
X=45.052408713931
Y=120.2557692418
LineLength=((([mBand19]+((1-0)=0?0:[mBand20]+[mBand18]))/3=0)?-1:((([mBand19]+((1-0)=0?0:[mBand20]+[mBand18]))/3-[mBand19])*1+[mBand19])*44.8+0)
DynamicVariables=1
[20]
Meter=Roundline
MeterStyle=styleLine
StartAngle=9.4247779607694
X=44.8
Y=126.68
LineLength=((([mBand20]+((1-0)=0?0:[mBand21]+[mBand19]))/3=0)?-1:((([mBand20]+((1-0)=0?0:[mBand21]+[mBand19]))/3-[mBand20])*1+[mBand20])*44.8+0)
DynamicVariables=1
[21]
Meter=Roundline
MeterStyle=styleLine
StartAngle=9.3462381444296
X=45.052408713931
Y=133.1042307582
LineLength=((([mBand21]+((1-0)=0?0:[mBand22]+[mBand20]))/3=0)?-1:((([mBand21]+((1-0)=0?0:[mBand22]+[mBand20]))/3-[mBand21])*1+[mBand21])*44.8+0)
DynamicVariables=1
[22]
Meter=Roundline
MeterStyle=styleLine
StartAngle=9.2676983280899
X=45.80807867207
Y=139.48885399749
LineLength=((([mBand22]+((1-0)=0?0:[mBand23]+[mBand21]))/3=0)?-1:((([mBand22]+((1-0)=0?0:[mBand23]+[mBand21]))/3-[mBand22])*1+[mBand22])*44.8+0)
DynamicVariables=1
[23]
Meter=Roundline
MeterStyle=styleLine
StartAngle=9.1891585117501
X=47.062350917838
Y=145.79450639252
LineLength=((([mBand23]+((1-0)=0?0:[mBand24]+[mBand22]))/3=0)?-1:((([mBand23]+((1-0)=0?0:[mBand24]+[mBand22]))/3-[mBand23])*1+[mBand23])*44.8+0)
DynamicVariables=1
[24]
Meter=Roundline
MeterStyle=styleLine
StartAngle=9.1106186954104
X=48.807492445753
Y=151.98231149942
LineLength=((([mBand24]+((1-0)=0?0:[mBand25]+[mBand23]))/3=0)?-1:((([mBand24]+((1-0)=0?0:[mBand25]+[mBand23]))/3-[mBand24])*1+[mBand24])*44.8+0)
DynamicVariables=1
[25]
Meter=Roundline
MeterStyle=styleLine
StartAngle=9.0320788790707
X=51.032743877976
Y=158.01411944205
LineLength=((([mBand25]+((1-0)=0?0:[mBand26]+[mBand24]))/3=0)?-1:((([mBand25]+((1-0)=0?0:[mBand26]+[mBand24]))/3-[mBand25])*1+[mBand25])*44.8+0)
DynamicVariables=1
[26]
Meter=Roundline
MeterStyle=styleLine
StartAngle=8.9535390627309
X=53.724385799456
Y=163.85274211867
LineLength=((([mBand26]+((1-0)=0?0:[mBand27]+[mBand25]))/3=0)?-1:((([mBand26]+((1-0)=0?0:[mBand27]+[mBand25]))/3-[mBand26])*1+[mBand26])*44.8+0)
DynamicVariables=1
[27]
Meter=Roundline
MeterStyle=styleLine
StartAngle=8.8749992463912
X=56.865823342687
Y=169.46218247894
LineLength=((([mBand27]+((1-0)=0?0:[mBand28]+[mBand26]))/3=0)?-1:((([mBand27]+((1-0)=0?0:[mBand28]+[mBand26]))/3-[mBand27])*1+[mBand27])*44.8+0)
DynamicVariables=1
[28]
Meter=Roundline
MeterStyle=styleLine
StartAngle=8.7964594300514
X=60.437688500579
Y=174.80785645771
LineLength=((([mBand28]+((1-0)=0?0:[mBand29]+[mBand27]))/3=0)?-1:((([mBand28]+((1-0)=0?0:[mBand29]+[mBand27]))/3-[mBand28])*1+[mBand28])*44.8+0)
DynamicVariables=1
[29]
Meter=Roundline
MeterStyle=styleLine
StartAngle=8.7179196137117
X=64.417959536669
Y=179.85680619728
LineLength=((([mBand29]+((1-0)=0?0:[mBand30]+[mBand28]))/3=0)?-1:((([mBand29]+((1-0)=0?0:[mBand30]+[mBand28]))/3-[mBand29])*1+[mBand29])*44.8+0)
DynamicVariables=1
[30]
Meter=Roundline
MeterStyle=styleLine
StartAngle=8.6393797973719
X=68.782096756446
Y=184.57790324355
LineLength=((([mBand30]+((1-0)=0?0:[mBand31]+[mBand29]))/3=0)?-1:((([mBand30]+((1-0)=0?0:[mBand31]+[mBand29]))/3-[mBand30])*1+[mBand30])*44.8+0)
DynamicVariables=1
[31]
Meter=Roundline
MeterStyle=styleLine
StartAngle=8.5608399810322
X=73.503193802725
Y=188.94204046333
LineLength=((([mBand31]+((1-0)=0?0:[mBand32]+[mBand30]))/3=0)?-1:((([mBand31]+((1-0)=0?0:[mBand32]+[mBand30]))/3-[mBand31])*1+[mBand31])*44.8+0)
DynamicVariables=1
[32]
Meter=Roundline
MeterStyle=styleLine
StartAngle=8.4823001646924
X=78.552143542292
Y=192.92231149942
LineLength=((([mBand32]+((1-0)=0?0:[mBand33]+[mBand31]))/3=0)?-1:((([mBand32]+((1-0)=0?0:[mBand33]+[mBand31]))/3-[mBand32])*1+[mBand32])*44.8+0)
DynamicVariables=1
[33]
Meter=Roundline
MeterStyle=styleLine
StartAngle=8.4037603483527
X=83.897817521058
Y=196.49417665731
LineLength=((([mBand33]+((1-0)=0?0:[mBand34]+[mBand32]))/3=0)?-1:((([mBand33]+((1-0)=0?0:[mBand34]+[mBand32]))/3-[mBand33])*1+[mBand33])*44.8+0)
DynamicVariables=1
[34]
Meter=Roundline
MeterStyle=styleLine
StartAngle=8.325220532013
X=89.507257881326
Y=199.63561420054
LineLength=((([mBand34]+((1-0)=0?0:[mBand35]+[mBand33]))/3=0)?-1:((([mBand34]+((1-0)=0?0:[mBand35]+[mBand33]))/3-[mBand34])*1+[mBand34])*44.8+0)
DynamicVariables=1
[35]
Meter=Roundline
MeterStyle=styleLine
StartAngle=8.2466807156732
X=95.345880557946
Y=202.32725612202
LineLength=((([mBand35]+((1-0)=0?0:[mBand36]+[mBand34]))/3=0)?-1:((([mBand35]+((1-0)=0?0:[mBand36]+[mBand34]))/3-[mBand35])*1+[mBand35])*44.8+0)
DynamicVariables=1
[36]
Meter=Roundline
MeterStyle=styleLine
StartAngle=8.1681408993335
X=101.37768850058
Y=204.55250755425
LineLength=((([mBand36]+((1-0)=0?0:[mBand37]+[mBand35]))/3=0)?-1:((([mBand36]+((1-0)=0?0:[mBand37]+[mBand35]))/3-[mBand36])*1+[mBand36])*44.8+0)
DynamicVariables=1
[37]
Meter=Roundline
MeterStyle=styleLine
StartAngle=8.0896010829937
X=107.56549360748
Y=206.29764908216
LineLength=((([mBand37]+((1-0)=0?0:[mBand38]+[mBand36]))/3=0)?-1:((([mBand37]+((1-0)=0?0:[mBand38]+[mBand36]))/3-[mBand37])*1+[mBand37])*44.8+0)
DynamicVariables=1
[38]
Meter=Roundline
MeterStyle=styleLine
StartAngle=8.011061266654
X=113.87114600251
Y=207.55192132793
LineLength=((([mBand38]+((1-0)=0?0:[mBand39]+[mBand37]))/3=0)?-1:((([mBand38]+((1-0)=0?0:[mBand39]+[mBand37]))/3-[mBand38])*1+[mBand38])*44.8+0)
DynamicVariables=1
[39]
Meter=Roundline
MeterStyle=styleLine
StartAngle=7.9325214503142
X=120.2557692418
Y=208.30759128607
LineLength=((([mBand39]+((1-0)=0?0:[mBand40]+[mBand38]))/3=0)?-1:((([mBand39]+((1-0)=0?0:[mBand40]+[mBand38]))/3-[mBand39])*1+[mBand39])*44.8+0)
DynamicVariables=1
[40]
Meter=Roundline
MeterStyle=styleLine
StartAngle=7.8539816339745
X=126.68
Y=208.56
LineLength=((([mBand40]+((1-0)=0?0:[mBand41]+[mBand39]))/3=0)?-1:((([mBand40]+((1-0)=0?0:[mBand41]+[mBand39]))/3-[mBand40])*1+[mBand40])*44.8+0)
DynamicVariables=1
[41]
Meter=Roundline
MeterStyle=styleLine
StartAngle=7.7754418176347
X=133.1042307582
Y=208.30759128607
LineLength=((([mBand41]+((1-0)=0?0:[mBand42]+[mBand40]))/3=0)?-1:((([mBand41]+((1-0)=0?0:[mBand42]+[mBand40]))/3-[mBand41])*1+[mBand41])*44.8+0)
DynamicVariables=1
[42]
Meter=Roundline
MeterStyle=styleLine
StartAngle=7.696902001295
X=139.48885399749
Y=207.55192132793
LineLength=((([mBand42]+((1-0)=0?0:[mBand43]+[mBand41]))/3=0)?-1:((([mBand42]+((1-0)=0?0:[mBand43]+[mBand41]))/3-[mBand42])*1+[mBand42])*44.8+0)
DynamicVariables=1
[43]
Meter=Roundline
MeterStyle=styleLine
StartAngle=7.6183621849552
X=145.79450639252
Y=206.29764908216
LineLength=((([mBand43]+((1-0)=0?0:[mBand44]+[mBand42]))/3=0)?-1:((([mBand43]+((1-0)=0?0:[mBand44]+[mBand42]))/3-[mBand43])*1+[mBand43])*44.8+0)
DynamicVariables=1
[44]
Meter=Roundline
MeterStyle=styleLine
StartAngle=7.5398223686155
X=151.98231149942
Y=204.55250755425
LineLength=((([mBand44]+((1-0)=0?0:[mBand45]+[mBand43]))/3=0)?-1:((([mBand44]+((1-0)=0?0:[mBand45]+[mBand43]))/3-[mBand44])*1+[mBand44])*44.8+0)
DynamicVariables=1
[45]
Meter=Roundline
MeterStyle=styleLine
StartAngle=7.4612825522758
X=158.01411944205
Y=202.32725612202
LineLength=((([mBand45]+((1-0)=0?0:[mBand46]+[mBand44]))/3=0)?-1:((([mBand45]+((1-0)=0?0:[mBand46]+[mBand44]))/3-[mBand45])*1+[mBand45])*44.8+0)
DynamicVariables=1
[46]
Meter=Roundline
MeterStyle=styleLine
StartAngle=7.382742735936
X=163.85274211867
Y=199.63561420054
LineLength=((([mBand46]+((1-0)=0?0:[mBand47]+[mBand45]))/3=0)?-1:((([mBand46]+((1-0)=0?0:[mBand47]+[mBand45]))/3-[mBand46])*1+[mBand46])*44.8+0)
DynamicVariables=1
[47]
Meter=Roundline
MeterStyle=styleLine
StartAngle=7.3042029195963
X=169.46218247894
Y=196.49417665731
LineLength=((([mBand47]+((1-0)=0?0:[mBand48]+[mBand46]))/3=0)?-1:((([mBand47]+((1-0)=0?0:[mBand48]+[mBand46]))/3-[mBand47])*1+[mBand47])*44.8+0)
DynamicVariables=1
[48]
Meter=Roundline
MeterStyle=styleLine
StartAngle=7.2256631032565
X=174.80785645771
Y=192.92231149942
LineLength=((([mBand48]+((1-0)=0?0:[mBand49]+[mBand47]))/3=0)?-1:((([mBand48]+((1-0)=0?0:[mBand49]+[mBand47]))/3-[mBand48])*1+[mBand48])*44.8+0)
DynamicVariables=1
[49]
Meter=Roundline
MeterStyle=styleLine
StartAngle=7.1471232869168
X=179.85680619728
Y=188.94204046333
LineLength=((([mBand49]+((1-0)=0?0:[mBand50]+[mBand48]))/3=0)?-1:((([mBand49]+((1-0)=0?0:[mBand50]+[mBand48]))/3-[mBand49])*1+[mBand49])*44.8+0)
DynamicVariables=1
[50]
Meter=Roundline
MeterStyle=styleLine
StartAngle=7.068583470577
X=184.57790324355
Y=184.57790324355
LineLength=((([mBand50]+((1-0)=0?0:[mBand51]+[mBand49]))/3=0)?-1:((([mBand50]+((1-0)=0?0:[mBand51]+[mBand49]))/3-[mBand50])*1+[mBand50])*44.8+0)
DynamicVariables=1
[51]
Meter=Roundline
MeterStyle=styleLine
StartAngle=6.9900436542373
X=188.94204046333
Y=179.85680619728
LineLength=((([mBand51]+((1-0)=0?0:[mBand52]+[mBand50]))/3=0)?-1:((([mBand51]+((1-0)=0?0:[mBand52]+[mBand50]))/3-[mBand51])*1+[mBand51])*44.8+0)
DynamicVariables=1
[52]
Meter=Roundline
MeterStyle=styleLine
StartAngle=6.9115038378975
X=192.92231149942
Y=174.80785645771
LineLength=((([mBand52]+((1-0)=0?0:[mBand53]+[mBand51]))/3=0)?-1:((([mBand52]+((1-0)=0?0:[mBand53]+[mBand51]))/3-[mBand52])*1+[mBand52])*44.8+0)
DynamicVariables=1
[53]
Meter=Roundline
MeterStyle=styleLine
StartAngle=6.8329640215578
X=196.49417665731
Y=169.46218247894
LineLength=((([mBand53]+((1-0)=0?0:[mBand54]+[mBand52]))/3=0)?-1:((([mBand53]+((1-0)=0?0:[mBand54]+[mBand52]))/3-[mBand53])*1+[mBand53])*44.8+0)
DynamicVariables=1
[54]
Meter=Roundline
MeterStyle=styleLine
StartAngle=6.7544242052181
X=199.63561420054
Y=163.85274211867
LineLength=((([mBand54]+((1-0)=0?0:[mBand55]+[mBand53]))/3=0)?-1:((([mBand54]+((1-0)=0?0:[mBand55]+[mBand53]))/3-[mBand54])*1+[mBand54])*44.8+0)
DynamicVariables=1
[55]
Meter=Roundline
MeterStyle=styleLine
StartAngle=6.6758843888783
X=202.32725612202
Y=158.01411944205
LineLength=((([mBand55]+((1-0)=0?0:[mBand56]+[mBand54]))/3=0)?-1:((([mBand55]+((1-0)=0?0:[mBand56]+[mBand54]))/3-[mBand55])*1+[mBand55])*44.8+0)
DynamicVariables=1
[56]
Meter=Roundline
MeterStyle=styleLine
StartAngle=6.5973445725386
X=204.55250755425
Y=151.98231149942
LineLength=((([mBand56]+((1-0)=0?0:[mBand57]+[mBand55]))/3=0)?-1:((([mBand56]+((1-0)=0?0:[mBand57]+[mBand55]))/3-[mBand56])*1+[mBand56])*44.8+0)
DynamicVariables=1
[57]
Meter=Roundline
MeterStyle=styleLine
StartAngle=6.5188047561988
X=206.29764908216
Y=145.79450639252
LineLength=((([mBand57]+((1-0)=0?0:[mBand58]+[mBand56]))/3=0)?-1:((([mBand57]+((1-0)=0?0:[mBand58]+[mBand56]))/3-[mBand57])*1+[mBand57])*44.8+0)
DynamicVariables=1
[58]
Meter=Roundline
MeterStyle=styleLine
StartAngle=6.4402649398591
X=207.55192132793
Y=139.48885399749
LineLength=((([mBand58]+((1-0)=0?0:[mBand59]+[mBand57]))/3=0)?-1:((([mBand58]+((1-0)=0?0:[mBand59]+[mBand57]))/3-[mBand58])*1+[mBand58])*44.8+0)
DynamicVariables=1
[59]
Meter=Roundline
MeterStyle=styleLine
StartAngle=6.3617251235193
X=208.30759128607
Y=133.1042307582
LineLength=((([mBand59]+((1-0)=0?0:[mBand60]+[mBand58]))/3=0)?-1:((([mBand59]+((1-0)=0?0:[mBand60]+[mBand58]))/3-[mBand59])*1+[mBand59])*44.8+0)
DynamicVariables=1
[60]
Meter=Roundline
MeterStyle=styleLine
StartAngle=6.2831853071796
X=208.56
Y=126.68
LineLength=((([mBand60]+((1-0)=0?0:[mBand61]+[mBand59]))/3=0)?-1:((([mBand60]+((1-0)=0?0:[mBand61]+[mBand59]))/3-[mBand60])*1+[mBand60])*44.8+0)
DynamicVariables=1
[61]
Meter=Roundline
MeterStyle=styleLine
StartAngle=6.2046454908398
X=208.30759128607
Y=120.2557692418
LineLength=((([mBand61]+((1-0)=0?0:[mBand62]+[mBand60]))/3=0)?-1:((([mBand61]+((1-0)=0?0:[mBand62]+[mBand60]))/3-[mBand61])*1+[mBand61])*44.8+0)
DynamicVariables=1
[62]
Meter=Roundline
MeterStyle=styleLine
StartAngle=6.1261056745001
X=207.55192132793
Y=113.87114600251
LineLength=((([mBand62]+((1-0)=0?0:[mBand63]+[mBand61]))/3=0)?-1:((([mBand62]+((1-0)=0?0:[mBand63]+[mBand61]))/3-[mBand62])*1+[mBand62])*44.8+0)
DynamicVariables=1
[63]
Meter=Roundline
MeterStyle=styleLine
StartAngle=6.0475658581604
X=206.29764908216
Y=107.56549360748
LineLength=((([mBand63]+((1-0)=0?0:[mBand64]+[mBand62]))/3=0)?-1:((([mBand63]+((1-0)=0?0:[mBand64]+[mBand62]))/3-[mBand63])*1+[mBand63])*44.8+0)
DynamicVariables=1
[64]
Meter=Roundline
MeterStyle=styleLine
StartAngle=5.9690260418206
X=204.55250755425
Y=101.37768850058
LineLength=((([mBand64]+((1-0)=0?0:[mBand65]+[mBand63]))/3=0)?-1:((([mBand64]+((1-0)=0?0:[mBand65]+[mBand63]))/3-[mBand64])*1+[mBand64])*44.8+0)
DynamicVariables=1
[65]
Meter=Roundline
MeterStyle=styleLine
StartAngle=5.8904862254809
X=202.32725612202
Y=95.345880557946
LineLength=((([mBand65]+((1-0)=0?0:[mBand66]+[mBand64]))/3=0)?-1:((([mBand65]+((1-0)=0?0:[mBand66]+[mBand64]))/3-[mBand65])*1+[mBand65])*44.8+0)
DynamicVariables=1
[66]
Meter=Roundline
MeterStyle=styleLine
StartAngle=5.8119464091411
X=199.63561420054
Y=89.507257881326
LineLength=((([mBand66]+((1-0)=0?0:[mBand67]+[mBand65]))/3=0)?-1:((([mBand66]+((1-0)=0?0:[mBand67]+[mBand65]))/3-[mBand66])*1+[mBand66])*44.8+0)
DynamicVariables=1
[67]
Meter=Roundline
MeterStyle=styleLine
StartAngle=5.7334065928014
X=196.49417665731
Y=83.897817521058
LineLength=((([mBand67]+((1-0)=0?0:[mBand68]+[mBand66]))/3=0)?-1:((([mBand67]+((1-0)=0?0:[mBand68]+[mBand66]))/3-[mBand67])*1+[mBand67])*44.8+0)
DynamicVariables=1
[68]
Meter=Roundline
MeterStyle=styleLine
StartAngle=5.6548667764616
X=192.92231149942
Y=78.552143542292
LineLength=((([mBand68]+((1-0)=0?0:[mBand69]+[mBand67]))/3=0)?-1:((([mBand68]+((1-0)=0?0:[mBand69]+[mBand67]))/3-[mBand68])*1+[mBand68])*44.8+0)
DynamicVariables=1
[69]
Meter=Roundline
MeterStyle=styleLine
StartAngle=5.5763269601219
X=188.94204046333
Y=73.503193802725
LineLength=((([mBand69]+((1-0)=0?0:[mBand70]+[mBand68]))/3=0)?-1:((([mBand69]+((1-0)=0?0:[mBand70]+[mBand68]))/3-[mBand69])*1+[mBand69])*44.8+0)
DynamicVariables=1
[70]
Meter=Roundline
MeterStyle=styleLine
StartAngle=5.4977871437821
X=184.57790324355
Y=68.782096756445
LineLength=((([mBand70]+((1-0)=0?0:[mBand71]+[mBand69]))/3=0)?-1:((([mBand70]+((1-0)=0?0:[mBand71]+[mBand69]))/3-[mBand70])*1+[mBand70])*44.8+0)
DynamicVariables=1
[71]
Meter=Roundline
MeterStyle=styleLine
StartAngle=5.4192473274424
X=179.85680619728
Y=64.417959536669
LineLength=((([mBand71]+((1-0)=0?0:[mBand72]+[mBand70]))/3=0)?-1:((([mBand71]+((1-0)=0?0:[mBand72]+[mBand70]))/3-[mBand71])*1+[mBand71])*44.8+0)
DynamicVariables=1
[72]
Meter=Roundline
MeterStyle=styleLine
StartAngle=5.3407075111026
X=174.80785645771
Y=60.437688500579
LineLength=((([mBand72]+((1-0)=0?0:[mBand73]+[mBand71]))/3=0)?-1:((([mBand72]+((1-0)=0?0:[mBand73]+[mBand71]))/3-[mBand72])*1+[mBand72])*44.8+0)
DynamicVariables=1
[73]
Meter=Roundline
MeterStyle=styleLine
StartAngle=5.2621676947629
X=169.46218247894
Y=56.865823342687
LineLength=((([mBand73]+((1-0)=0?0:[mBand74]+[mBand72]))/3=0)?-1:((([mBand73]+((1-0)=0?0:[mBand74]+[mBand72]))/3-[mBand73])*1+[mBand73])*44.8+0)
DynamicVariables=1
[74]
Meter=Roundline
MeterStyle=styleLine
StartAngle=5.1836278784232
X=163.85274211867
Y=53.724385799456
LineLength=((([mBand74]+((1-0)=0?0:[mBand75]+[mBand73]))/3=0)?-1:((([mBand74]+((1-0)=0?0:[mBand75]+[mBand73]))/3-[mBand74])*1+[mBand74])*44.8+0)
DynamicVariables=1
[75]
Meter=Roundline
MeterStyle=styleLine
StartAngle=5.1050880620834
X=158.01411944205
Y=51.032743877976
LineLength=((([mBand75]+((1-0)=0?0:[mBand76]+[mBand74]))/3=0)?-1:((([mBand75]+((1-0)=0?0:[mBand76]+[mBand74]))/3-[mBand75])*1+[mBand75])*44.8+0)
DynamicVariables=1
[76]
Meter=Roundline
MeterStyle=styleLine
StartAngle=5.0265482457437
X=151.98231149942
Y=48.807492445753
LineLength=((([mBand76]+((1-0)=0?0:[mBand77]+[mBand75]))/3=0)?-1:((([mBand76]+((1-0)=0?0:[mBand77]+[mBand75]))/3-[mBand76])*1+[mBand76])*44.8+0)
DynamicVariables=1
[77]
Meter=Roundline
MeterStyle=styleLine
StartAngle=4.9480084294039
X=145.79450639252
Y=47.062350917838
LineLength=((([mBand77]+((1-0)=0?0:[mBand78]+[mBand76]))/3=0)?-1:((([mBand77]+((1-0)=0?0:[mBand78]+[mBand76]))/3-[mBand77])*1+[mBand77])*44.8+0)
DynamicVariables=1
[78]
Meter=Roundline
MeterStyle=styleLine
StartAngle=4.8694686130642
X=139.48885399749
Y=45.80807867207
LineLength=((([mBand78]+((1-0)=0?0:[mBand79]+[mBand77]))/3=0)?-1:((([mBand78]+((1-0)=0?0:[mBand79]+[mBand77]))/3-[mBand78])*1+[mBand78])*44.8+0)
DynamicVariables=1
[79]
Meter=Roundline
MeterStyle=styleLine
StartAngle=4.7909287967244
X=133.1042307582
Y=45.052408713931
LineLength=((([mBand79]+((1-0)=0?0:[mBand0]+[mBand78]))/3=0)?-1:((([mBand79]+((1-0)=0?0:[mBand0]+[mBand78]))/3-[mBand79])*1+[mBand79])*44.8+0)
DynamicVariables=1