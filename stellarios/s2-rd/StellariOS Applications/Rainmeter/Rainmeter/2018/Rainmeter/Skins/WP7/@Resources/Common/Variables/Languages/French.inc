[Variables]
Translation=French
Translated=(Guillaume Beauchesne\gooee)
contributor=(@ravaged_\Twitter)
langoverride=1
;This one is for google searches
languagedomain=fr
individualpanelcolor=Couleur individuelle
Thanks=Thanks
Donation=We spent a lot of time on Omnimo, if you wish to show your gratitude, please consider donating to help maintain the server costs and for future projects.
programs=Programmes
systemtools=Outils système
alarm1=Alarme
Set=Réglez
donatorpanels=Donator Panels
donateifyoulike=Donate if you like
Snooze=Répéter
Videos=Vidéos
Music=Musique
TV=TV
Pictures=Images
openfolder=Ouvrir
new=Nouveau
no=Non
Picturesfoldername=Fichier d'images
applications=Applications
Library=Bibliothèque
editnotes=Modifier les remarques
games=jeux

Calendar=Calendrier
Todayis=Aujourd'hui, c'est
Monday=Lundi
Tuesday=Mardi
Wednesday=Mercredi
Thursday=Jeudi
Friday=Vendredi
Saturday=Samedi
Sunday=Dimanche
January=Janvier
February=Février
March=Mars
April=Avril
May=Mai
June=Juin
July=Juillet
August=Août
September=Septembre
October=Octobre
November=Novembre
December=Décembre
Tonight=Ce soir
Mon=Lun
Tue=Mar
Wed=Mer
Thu=Jeu
Fri=Ven
Sat=Sam
Sun=Dim
Januaryshort=Janv.
Februaryshort=Fév.
Marchshort=Mars
Aprilshort=Avril
Mayshort=Mai
Juneshort=Juin
Julyshort=Juil.
Augustshort=Août
Septembershort=Sept.
Octobershort=Oct.
Novembershort=Nov.
Decembershort=Déc.

ControlPanel=Configuration
Devices=Périphériques
Sound=Son
Gamesexplorer=Explorateur de jeux
Friends=Amis
internetshortcuts=Raccourcis Internet
People=Personnes

Gallery=Galerie
Panels=Panneaux
Skins=Apparences

Items=Éléments
Size=Taille
Battery=Batterie
ACLine=Connecteur d'alimentation
Power=Batterie
Uptime=durée active
Memory=Mémoire
CORE=UC
Phase=Phase
harddrives=Disques durs
Free=Libre
Space=Espace
Used=Utilisé
drives1=Lecteurs
settings=Paramètres
tools=Outils
downloads=Téléchargements
Network=Réseau
Setaswallpaper=Appliquer le papier peint
RecycleBin=Corbeille

;weather
MostlyCloudy=Très nuageux
LightSnow=Neige faible
LightRain=Pluie faible
LightRainShower=Averse de pluie faible
Cloudy=Nuageux
Drizzle=Bruine
Lgt=Fbl
And=et
Partly=Partiellement
Mostly=Très
with=avec
Clear=Clair
Fair=Convenable
PartlyCloudy=nuages partiels
Cloudy=Nuageux
FreezingRain=Pluie froide
Rain=Pluie
Thunder=Tonnerre
intheVicinity=Dans la région
Shower=Averse
Snow=Neige
Sunny=Ensoleillé
Windy=Venteux
Haze=Brume
Fog=Brouillard
WidespreadDust=Poussière
Set=Réglez
T-Storm=Orage
LightDrizzle=Bruine
WintryMiX=Mélange hivernal
Light=Faible
Weather=Météo

notconfigured=Non configuré
Updates=Mises à jour
Currentversion=Version actuelle
NoUpdatesAvailable=Aucune mise à jour disponible
NewUpdateAvailable=Nouvelle mise à jour disponible
news=Actualités
feeds=Flux
systemstorage=Stockage système
BinaryClock=Horloge binaire
noresize=Ce panneau n'est pas redimensionnable
countdown=Compte à rebours
start=début
stop=arrêt
settimer=réglez
reset=rétablir
IPAddress=Adresse IP
Empty=Vider
Processor=Processeur
Volume=Volume
systeminfo=Info système

;The user panel - ME as in "I"

ME=MOI
Wireless=sans fil
Folders=Fichiers
Maps=Cartes
Search=Recherche
MoonPhase=Phase de la lune
;Stock market
Stocks=Actions
Calculator=Calculatrice
Camera=Capture d'écran
Notestitle=Remarques

;GALLERY
TIME=Heure
PCINFO=INFO PC
SHORTCUTS=RACCOURCIS
INTERNET=INTERNET
TOOLS1=OUTILS
INSTALLEDPANELS=PANNEAUX INSTALLÉS
INSTALLEDTHEMES=THÈMES INSTALLÉS
ALLTEXTITEMS=TOUS LES ÉLÉMENTS DE TEXTE
INSTALLED=INSTALLÉ
CUSTOMIZE=PERSONNALISER
textitemscolor=Couleur de l'élément de texte
Viewgift=Voir le cadeau

;Better ignore these 2
panels1=panels
textitems=text items
;Changecolorsettings=Changer les paramètres de l'apparence et la couleur8
viewinstalledpanels=Affiché panneaux installé8
Viewdefaultpanels=Affiché panneaux par défaut8
Downloadpanels=Télécharger Panneaux/Modules complémentaires
Changeadvancedcolorandappearance=Modifier les paramètres de couleurs et apparences 8
viewtextitems=Afficher les éléments de texte
Preview=Aperçu
Close= fermer [x]
Apply= Appliquer

all=tous
unreademails=mails non lus
inboX=boîte de réception
resource=utilisation
resourceuseage=utilisation des ressources
SYSTEMMONITORING=SURVEILLANCE DU SYSTÈME
Processorload=Charge du processeur
Systemmemory=Mémoire système
Virtualmemory=Mémoire virtuelle
Primaryharddrive=Disque dur principal
Secondaryharddrive=Disque dur secondaire
information=information
system=système
info=info
dateandtime=date et heure
networkoptions=options de réseau
poweroptions=options d’alimentation
audiooptions=options audio
themeoptions=options de thème
displayoptions=options d'affichage
useraccounts=comptes d’utilisateurs
windowsupdate=windows update
monitorsconnected=moniteur(s) connecté
loggedinas=Connecté en tant que
installupdatesevery=Installez les mises à jour: Tous les
today=aujourd'hui,
forecast=prévision
BaroMeter=Baromètre
Humidity=Humidité
Visibility=Visibilité
Wind=Vent8
Windchill=Refroidissement éolien
Winddirection=Direction du vent
Sunrise=Aube
Sunset=Crépuscule

world=Horloge
worldclock=Horloge mondiale
Localtime=Heure locale
Translator=Traducteur
Stocks=Actions
PowerPlan=Gestion de l'alimentation
Select=Sélectionner
Balanced=Balancé
HighPerf=Hautes performances
PowerSaver=Économiseur d’énergie

Radio=Radio
Playlists=Sélections

Style=Style
Settings=Paramètres
normalcolorTR=Couleur normale
hovercolorTR=Couleur 2
textcolorTR=Couleur du texte
textitemscolorTR=Couleur du texte 2
bordercolorTR=Bordure
borderstyleTR=Style de la bordure
aeroglass=Aero Glass
roundedTR=Arrondi
centertext=Centrer le texte
changecolor=Modifier la couleur
opacityTR=Opacité
resizepanels=Redimensionner les panneaux
Addons=Modules
moreaddons=+ de Modules

Calendar=Calendrier
Devices=Périphériques
Sound=Son
ControlPanel=Configuration
Radio=Radio
Playlists= 
ColorConverter=Convertisseur de couleur
Convert=Convertir
ImageConverter=Convertisseur d'images
SunClock=Horloge solaire
Eject=Éjecter	
timelineview=chronologie
timeline=chronologie

off=Off

donothing=L'action sélectionnée sera effectuée automatiquement dans 10 secondes.

Sleep=Veille
Logoff=Déconnecter
Shutdown=Arrêt
Restart=Redémarrer
Hibernate=Veille prolongée
cancel=Annuler

clickhereforgallery=Appuyez ici pour la galerie
changegallerytheme=Changer le thème de la galerie

StartText=Démarrer
Computer=Ordinateur

SetString=Valider
CloseString=Annuler
WeatherForecast=Prévisions météo
Lock=Vérouiller
Headers=Titres
TrayIcons=Icônes système

Fahrenheit=Fahrenheit
24HourTime=Format 24 heures
RSSDecoding=Décodeur RSS
ArrowStyle=Modèle de bouton
LayoutThemes=Thème Omnimo
Checkforupdates=Mise à jour
Goodmorning=Bonjour
Goodafternoon=Bonjour
Goodevening=Bonsoir
Greetings=Salutations
sunasinstar=Soleil
Pressure=Baromètre
Browserballot=Choix du navigateur
Connected=Connecté
storage=Espace de stockage
Desktop=Bureau
Finance=Finance
Photos=Photos
Reader=Lecteur RSS
languagename=Langue
default=Par défaut
Font=Police
font1=Police 1
font2=Police 2
font3=Police 3
noupdates=Pas de mises à jour
newupdate=Mise à jour disponible !
extras=Extras
Styles=Styles
quickaccess=Barre de raccourcis
time=Horaire
weather=Météo
mail=Mail
morepcsettings=Plus de paramètres PC
Wifi=Wifi
Mute=Couper le son
extrawidth=10
brightness=Luminosité


Layouts=Disposition
Toggle=Bascule
Advanced=Avancé
Simple=Simple
ResizeAllPanels=Redimensionner tous les panneaux
FontString=Police
TogglePanelIcons=Basculer les icônes de panneaux
SidebarColors=Couleurs de menu latéral
Menu=Menu
High=Haut
Low=Bas
MiddleClickToDelete=Clic du milieu pour suprimmer le panneau
CreatePanel=Créer panneau
ViewPanels=Voir panneaux
donothing1=L'action sélectionnée sera exécutée en %$%
donothing2=secondes.

DominantRSS=http://rss.lemonde.fr/c/205/f/3050/index.rss
DominantRSSName=LeMonde

viewall=Voir tous
videotutorials=Tutoriels vidéo