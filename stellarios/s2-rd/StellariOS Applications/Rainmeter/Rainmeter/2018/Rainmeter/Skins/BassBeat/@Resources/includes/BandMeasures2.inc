; auto-generated by sFactoryBandMeasuresR
[mBandR0]
Measure=Plugin
Plugin=AudioLevel
Parent=mAudioOut
Type=Band
BandIdx=1
Channel=R
[mBandR1]
Measure=Plugin
Plugin=AudioLevel
Parent=mAudioOut
Type=Band
BandIdx=2
Channel=R
[mBandR2]
Measure=Plugin
Plugin=AudioLevel
Parent=mAudioOut
Type=Band
BandIdx=3
Channel=R
[mBandR3]
Measure=Plugin
Plugin=AudioLevel
Parent=mAudioOut
Type=Band
BandIdx=4
Channel=R
[mBandR4]
Measure=Plugin
Plugin=AudioLevel
Parent=mAudioOut
Type=Band
BandIdx=5
Channel=R
[mBandR5]
Measure=Plugin
Plugin=AudioLevel
Parent=mAudioOut
Type=Band
BandIdx=6
Channel=R
[mBandR6]
Measure=Plugin
Plugin=AudioLevel
Parent=mAudioOut
Type=Band
BandIdx=7
Channel=R
[mBandR7]
Measure=Plugin
Plugin=AudioLevel
Parent=mAudioOut
Type=Band
BandIdx=8
Channel=R
[mBandR8]
Measure=Plugin
Plugin=AudioLevel
Parent=mAudioOut
Type=Band
BandIdx=9
Channel=R
[mBandR9]
Measure=Plugin
Plugin=AudioLevel
Parent=mAudioOut
Type=Band
BandIdx=10
Channel=R
[mBandR10]
Measure=Plugin
Plugin=AudioLevel
Parent=mAudioOut
Type=Band
BandIdx=11
Channel=R
[mBandR11]
Measure=Plugin
Plugin=AudioLevel
Parent=mAudioOut
Type=Band
BandIdx=12
Channel=R
[mBandR12]
Measure=Plugin
Plugin=AudioLevel
Parent=mAudioOut
Type=Band
BandIdx=13
Channel=R
[mBandR13]
Measure=Plugin
Plugin=AudioLevel
Parent=mAudioOut
Type=Band
BandIdx=14
Channel=R
[mBandR14]
Measure=Plugin
Plugin=AudioLevel
Parent=mAudioOut
Type=Band
BandIdx=15
Channel=R
[mBandR15]
Measure=Plugin
Plugin=AudioLevel
Parent=mAudioOut
Type=Band
BandIdx=16
Channel=R
[mBandR16]
Measure=Plugin
Plugin=AudioLevel
Parent=mAudioOut
Type=Band
BandIdx=17
Channel=R
[mBandR17]
Measure=Plugin
Plugin=AudioLevel
Parent=mAudioOut
Type=Band
BandIdx=18
Channel=R
[mBandR18]
Measure=Plugin
Plugin=AudioLevel
Parent=mAudioOut
Type=Band
BandIdx=19
Channel=R
[mBandR19]
Measure=Plugin
Plugin=AudioLevel
Parent=mAudioOut
Type=Band
BandIdx=20
Channel=R
[mBandR20]
Measure=Plugin
Plugin=AudioLevel
Parent=mAudioOut
Type=Band
BandIdx=21
Channel=R
[mBandR21]
Measure=Plugin
Plugin=AudioLevel
Parent=mAudioOut
Type=Band
BandIdx=22
Channel=R
[mBandR22]
Measure=Plugin
Plugin=AudioLevel
Parent=mAudioOut
Type=Band
BandIdx=23
Channel=R
[mBandR23]
Measure=Plugin
Plugin=AudioLevel
Parent=mAudioOut
Type=Band
BandIdx=24
Channel=R
[mBandR24]
Measure=Plugin
Plugin=AudioLevel
Parent=mAudioOut
Type=Band
BandIdx=25
Channel=R
[mBandR25]
Measure=Plugin
Plugin=AudioLevel
Parent=mAudioOut
Type=Band
BandIdx=26
Channel=R
[mBandR26]
Measure=Plugin
Plugin=AudioLevel
Parent=mAudioOut
Type=Band
BandIdx=27
Channel=R
[mBandR27]
Measure=Plugin
Plugin=AudioLevel
Parent=mAudioOut
Type=Band
BandIdx=28
Channel=R
[mBandR28]
Measure=Plugin
Plugin=AudioLevel
Parent=mAudioOut
Type=Band
BandIdx=29
Channel=R
[mBandR29]
Measure=Plugin
Plugin=AudioLevel
Parent=mAudioOut
Type=Band
BandIdx=30
Channel=R
[mBandR30]
Measure=Plugin
Plugin=AudioLevel
Parent=mAudioOut
Type=Band
BandIdx=31
Channel=R
[mBandR31]
Measure=Plugin
Plugin=AudioLevel
Parent=mAudioOut
Type=Band
BandIdx=32
Channel=R
[mBandR32]
Measure=Plugin
Plugin=AudioLevel
Parent=mAudioOut
Type=Band
BandIdx=33
Channel=R
[mBandR33]
Measure=Plugin
Plugin=AudioLevel
Parent=mAudioOut
Type=Band
BandIdx=34
Channel=R
[mBandR34]
Measure=Plugin
Plugin=AudioLevel
Parent=mAudioOut
Type=Band
BandIdx=35
Channel=R
[mBandR35]
Measure=Plugin
Plugin=AudioLevel
Parent=mAudioOut
Type=Band
BandIdx=36
Channel=R
[mBandR36]
Measure=Plugin
Plugin=AudioLevel
Parent=mAudioOut
Type=Band
BandIdx=37
Channel=R
[mBandR37]
Measure=Plugin
Plugin=AudioLevel
Parent=mAudioOut
Type=Band
BandIdx=38
Channel=R
[mBandR38]
Measure=Plugin
Plugin=AudioLevel
Parent=mAudioOut
Type=Band
BandIdx=39
Channel=R
[mBandR39]
Measure=Plugin
Plugin=AudioLevel
Parent=mAudioOut
Type=Band
BandIdx=40
Channel=R
[mBandR40]
Measure=Plugin
Plugin=AudioLevel
Parent=mAudioOut
Type=Band
BandIdx=41
Channel=R
[mBandR41]
Measure=Plugin
Plugin=AudioLevel
Parent=mAudioOut
Type=Band
BandIdx=42
Channel=R
[mBandR42]
Measure=Plugin
Plugin=AudioLevel
Parent=mAudioOut
Type=Band
BandIdx=43
Channel=R
[mBandR43]
Measure=Plugin
Plugin=AudioLevel
Parent=mAudioOut
Type=Band
BandIdx=44
Channel=R
[mBandR44]
Measure=Plugin
Plugin=AudioLevel
Parent=mAudioOut
Type=Band
BandIdx=45
Channel=R
[mBandR45]
Measure=Plugin
Plugin=AudioLevel
Parent=mAudioOut
Type=Band
BandIdx=46
Channel=R
[mBandR46]
Measure=Plugin
Plugin=AudioLevel
Parent=mAudioOut
Type=Band
BandIdx=47
Channel=R
[mBandR47]
Measure=Plugin
Plugin=AudioLevel
Parent=mAudioOut
Type=Band
BandIdx=48
Channel=R
[mBandR48]
Measure=Plugin
Plugin=AudioLevel
Parent=mAudioOut
Type=Band
BandIdx=49
Channel=R
[mBandR49]
Measure=Plugin
Plugin=AudioLevel
Parent=mAudioOut
Type=Band
BandIdx=50
Channel=R
[mBandR50]
Measure=Plugin
Plugin=AudioLevel
Parent=mAudioOut
Type=Band
BandIdx=51
Channel=R
[mBandR51]
Measure=Plugin
Plugin=AudioLevel
Parent=mAudioOut
Type=Band
BandIdx=52
Channel=R
[mBandR52]
Measure=Plugin
Plugin=AudioLevel
Parent=mAudioOut
Type=Band
BandIdx=53
Channel=R
[mBandR53]
Measure=Plugin
Plugin=AudioLevel
Parent=mAudioOut
Type=Band
BandIdx=54
Channel=R
[mBandR54]
Measure=Plugin
Plugin=AudioLevel
Parent=mAudioOut
Type=Band
BandIdx=55
Channel=R
[mBandR55]
Measure=Plugin
Plugin=AudioLevel
Parent=mAudioOut
Type=Band
BandIdx=56
Channel=R
[mBandR56]
Measure=Plugin
Plugin=AudioLevel
Parent=mAudioOut
Type=Band
BandIdx=57
Channel=R
[mBandR57]
Measure=Plugin
Plugin=AudioLevel
Parent=mAudioOut
Type=Band
BandIdx=58
Channel=R
[mBandR58]
Measure=Plugin
Plugin=AudioLevel
Parent=mAudioOut
Type=Band
BandIdx=59
Channel=R
[mBandR59]
Measure=Plugin
Plugin=AudioLevel
Parent=mAudioOut
Type=Band
BandIdx=60
Channel=R
[mBandR60]
Measure=Plugin
Plugin=AudioLevel
Parent=mAudioOut
Type=Band
BandIdx=61
Channel=R
[mBandR61]
Measure=Plugin
Plugin=AudioLevel
Parent=mAudioOut
Type=Band
BandIdx=62
Channel=R
[mBandR62]
Measure=Plugin
Plugin=AudioLevel
Parent=mAudioOut
Type=Band
BandIdx=63
Channel=R
[mBandR63]
Measure=Plugin
Plugin=AudioLevel
Parent=mAudioOut
Type=Band
BandIdx=64
Channel=R
[mBandR64]
Measure=Plugin
Plugin=AudioLevel
Parent=mAudioOut
Type=Band
BandIdx=65
Channel=R
[mBandR65]
Measure=Plugin
Plugin=AudioLevel
Parent=mAudioOut
Type=Band
BandIdx=66
Channel=R
[mBandR66]
Measure=Plugin
Plugin=AudioLevel
Parent=mAudioOut
Type=Band
BandIdx=67
Channel=R
[mBandR67]
Measure=Plugin
Plugin=AudioLevel
Parent=mAudioOut
Type=Band
BandIdx=68
Channel=R
[mBandR68]
Measure=Plugin
Plugin=AudioLevel
Parent=mAudioOut
Type=Band
BandIdx=69
Channel=R
[mBandR69]
Measure=Plugin
Plugin=AudioLevel
Parent=mAudioOut
Type=Band
BandIdx=70
Channel=R
[mBandR70]
Measure=Plugin
Plugin=AudioLevel
Parent=mAudioOut
Type=Band
BandIdx=71
Channel=R
[mBandR71]
Measure=Plugin
Plugin=AudioLevel
Parent=mAudioOut
Type=Band
BandIdx=72
Channel=R
[mBandR72]
Measure=Plugin
Plugin=AudioLevel
Parent=mAudioOut
Type=Band
BandIdx=73
Channel=R
[mBandR73]
Measure=Plugin
Plugin=AudioLevel
Parent=mAudioOut
Type=Band
BandIdx=74
Channel=R
[mBandR74]
Measure=Plugin
Plugin=AudioLevel
Parent=mAudioOut
Type=Band
BandIdx=75
Channel=R
[mBandR75]
Measure=Plugin
Plugin=AudioLevel
Parent=mAudioOut
Type=Band
BandIdx=76
Channel=R
[mBandR76]
Measure=Plugin
Plugin=AudioLevel
Parent=mAudioOut
Type=Band
BandIdx=77
Channel=R
[mBandR77]
Measure=Plugin
Plugin=AudioLevel
Parent=mAudioOut
Type=Band
BandIdx=78
Channel=R
[mBandR78]
Measure=Plugin
Plugin=AudioLevel
Parent=mAudioOut
Type=Band
BandIdx=79
Channel=R
[mBandR79]
Measure=Plugin
Plugin=AudioLevel
Parent=mAudioOut
Type=Band
BandIdx=80
Channel=R
[mBandR80]
Measure=Plugin
Plugin=AudioLevel
Parent=mAudioOut
Type=Band
BandIdx=81
Channel=R
[mBandR81]
Measure=Plugin
Plugin=AudioLevel
Parent=mAudioOut
Type=Band
BandIdx=82
Channel=R
[mBandR82]
Measure=Plugin
Plugin=AudioLevel
Parent=mAudioOut
Type=Band
BandIdx=83
Channel=R
[mBandR83]
Measure=Plugin
Plugin=AudioLevel
Parent=mAudioOut
Type=Band
BandIdx=84
Channel=R
[mBandR84]
Measure=Plugin
Plugin=AudioLevel
Parent=mAudioOut
Type=Band
BandIdx=85
Channel=R
[mBandR85]
Measure=Plugin
Plugin=AudioLevel
Parent=mAudioOut
Type=Band
BandIdx=86
Channel=R
[mBandR86]
Measure=Plugin
Plugin=AudioLevel
Parent=mAudioOut
Type=Band
BandIdx=87
Channel=R
[mBandR87]
Measure=Plugin
Plugin=AudioLevel
Parent=mAudioOut
Type=Band
BandIdx=88
Channel=R
[mBandR88]
Measure=Plugin
Plugin=AudioLevel
Parent=mAudioOut
Type=Band
BandIdx=89
Channel=R
[mBandR89]
Measure=Plugin
Plugin=AudioLevel
Parent=mAudioOut
Type=Band
BandIdx=90
Channel=R
[mBandR90]
Measure=Plugin
Plugin=AudioLevel
Parent=mAudioOut
Type=Band
BandIdx=91
Channel=R
[mBandR91]
Measure=Plugin
Plugin=AudioLevel
Parent=mAudioOut
Type=Band
BandIdx=92
Channel=R
[mBandR92]
Measure=Plugin
Plugin=AudioLevel
Parent=mAudioOut
Type=Band
BandIdx=93
Channel=R
[mBandR93]
Measure=Plugin
Plugin=AudioLevel
Parent=mAudioOut
Type=Band
BandIdx=94
Channel=R
[mBandR94]
Measure=Plugin
Plugin=AudioLevel
Parent=mAudioOut
Type=Band
BandIdx=95
Channel=R
[mBandR95]
Measure=Plugin
Plugin=AudioLevel
Parent=mAudioOut
Type=Band
BandIdx=96
Channel=R
[mBandR96]
Measure=Plugin
Plugin=AudioLevel
Parent=mAudioOut
Type=Band
BandIdx=97
Channel=R
[mBandR97]
Measure=Plugin
Plugin=AudioLevel
Parent=mAudioOut
Type=Band
BandIdx=98
Channel=R
[mBandR98]
Measure=Plugin
Plugin=AudioLevel
Parent=mAudioOut
Type=Band
BandIdx=99
Channel=R
[mBandR99]
Measure=Plugin
Plugin=AudioLevel
Parent=mAudioOut
Type=Band
BandIdx=100
Channel=R