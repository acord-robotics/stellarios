[Variables]

;-------------------------------------------------------------
;-------------------------------------------------------------


Date="Sunday":"Niedziela","Monday":"Poniedziałek","Tuesday":"Wtorek","Wednesday":"Środa","Thursday":"Czwartek","Friday":"Piątek","Saturday":"Sobota","January":"Gennaio","February":"Febbraio","March":"Marzo","April":"Aprile","Jun":"Giugno","July":"Luglio","August":"Agosto","September":"Settembre","October":"Ottobre","November":"Novembre","December":"Dicembre"
Conditions="Thunderstorms":"Burza z Piorunami","Windy Rain":"Deszcz i Wiatr","T-Storms":"Burza z Możliwymi Piorunami","Rain Snow":"Opady Śniegu","Sleet":"Deszcz ze Śniegiem","Snow/Rain Icy Mix":"Marznący Deszcz ze Śniegiem","Freezing Drizzle":"Marznąca Mrzawka","Drizzle":"Mrzawka","Freezing Rain":"Marznący Deszcz","T-Showers":"Opady z Możliwymi Burzami","Showers":"Przelotny Deszcz","Light Rain":"Lekki Deszcz","Heavy Rain":"Mocne Opady","Snow Flurries":"Przelotne Opady Śniegu","Light Snow":"Lekkie Opady Śniegu","Snowflakes":"Opady Śniegu","Heavy Snow":"Mocne Opady Śniegu","Hail":"Grad","Dust":"Pył / Pylenie","Fog":"Mgła","Haze":"Mgiełka","Smoke":"Dymnie","Windy":"Wietrznie","Frigid":"Chłodno","Partly Cloudy":"Częściowe Zachmurzenie","Cloudy":"Pochmurnie","Mostly Cloudy":"W Większości Pochmurnie","Clear":"Czyste Niebo","Sunny":"Słonecznie","Fair":"Zadowalająco","Mostly Clear":"Przeważnie Czyte Niebo","Mostly Sunny":"Przeważnie Słonecznie","Hot":"Upalnie","Isolated Thunder":"Pojedyncze Burze","Scattered T-Storms":"Słabe Burze z Możliwymi Piorunami","Scattered Rain":"Słabe Opady Deszczu","Scattered Snow":"Słabe Opady Śniegu","Windy/Snowy":"Wietrznie z Opadami Śniegu","Scattered Showers":"Słaby Przelotny Deszcz","Snowy":"Śnierznie","and":"i","with":"z","Thunder":"Piorunami","Moderate":"Umierkowanie","Shower":"Przelotny Deszcz","Mostly":"Przeważnie","Scattered":"Słaby","Rain":"Deszcz","Snow":"Śnieg","Wind":"Wiatr","Early":"","Late":"","PM":"PM","AM":"AM","Sun":"Słońca","Cloud":"Chmura","Light":"Błyskawica / Światło","Snow Shower":"Opady Śniegu","Widespread":"Rozległe","Few":"Parę","Isolated":"Pojedyncze","Mist":"Mgiełka","In the Vicinity":"W sąsiedztwie","Clouds":"Chmury"
MoonPhase="Full":"Pełnia","Waning Gibbous":"Faza Malejąca","Last Quarter":"Ostatnia Kwadra","Waning Crescent":"Półksiężyc","New":"Nów","Waxing Crescent":"Półksiężyc","First Quarter":"Pierwsza Kwadra","Waxing Gibbous":"Faza Rosnąca","Moon":""
Index="Low":"Niskie","Moderate":"Średnie","High":"Wysokie","Very":"Bardzo","Extreme":"Ekstremalne"
Greets="00":"Dobranoc","01":"Dobranoc","02":"Dobranoc","03":"Dobranoc","04":"Dobranoc","05":"Dobranoc","06":"Dobranoc","07":"Dzień dobry","08":"Dzień dobry","09":"Dzień dobry","10":"Dzień dobry","11":"Dzień dobry","12":"Dzień dobry","13":"Dzień dobry","14":"Dzień dobry","15":"Dzień dobry","16":"Dzień dobry","17":"Dzień dobry","18":"Dobry wieczór","19":"Dobry wieczór","20":"Dobry wieczór","21":"Dobranoc","22":"Dobranoc","23":"Dobranoc"
Welcome=Witamy spowrotem
Weather Forecast For=Prognoza pogody dla
Currently is=obecnie jest
Detailed2=Więcej Detali
Tomorrow=Jutro
Today=Dziś
Tonight=W Nocy
Feels Like=Odczuwalne
Humidity=Wilgotność
IndexUV=UV Index
Pressure=Ciśnienie
Visibility=Widoczność
Wind=Wiatr
Chance of Precip=Przewidywalność
Sunrise=Wschód Słońca
Sunset=Zachód Słońca
Moon=Księżyc
Moon Phase=Fazy Księżyca
Updated At=Aktualizacji na
Weather Station=Stacja pogodowa
Artist=Artysta
Title=Tytuł
Album=Sztambuch
Position=Pozycja
Music Player=Odtwarzacz muzyki
Unknown Artist=Nieznany artysta
Unknown Title=Nieznany tytuł
Player Is Off Or Stopped=Odtwarzacz muzyki jest wyłączona lub zatrzymana
