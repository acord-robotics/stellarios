; auto-generated by sFactoryBars
[0]
Meter=Roundline
MeterStyle=styleLine
StartAngle=11.205013797804
X=368.63293526542
Y=273.7481919413
LineLength=((([mBand0]+(0.1=0?0:[mBand1]+[mBand84]))/3=0)?1:((([mBand0]+(0.1=0?0:[mBand1]+[mBand84]))/3-[mBand0])*0.1+[mBand0])*271+1)
DynamicVariables=1
[1]
Meter=Roundline
MeterStyle=styleLine
StartAngle=11.13109397066
X=362.80841979851
Y=272.73349975268
LineLength=((([mBand1]+(0.1=0?0:[mBand2]+[mBand0]))/3=0)?1:((([mBand1]+(0.1=0?0:[mBand2]+[mBand0]))/3-[mBand1])*0.1+[mBand1])*271+1)
DynamicVariables=1
[2]
Meter=Roundline
MeterStyle=styleLine
StartAngle=11.057174143517
X=356.92487249072
Y=272.15173370104
LineLength=((([mBand2]+(0.1=0?0:[mBand3]+[mBand1]))/3=0)?1:((([mBand2]+(0.1=0?0:[mBand3]+[mBand1]))/3-[mBand2])*0.1+[mBand2])*271+1)
DynamicVariables=1
[3]
Meter=Roundline
MeterStyle=styleLine
StartAngle=10.983254316374
X=351.01442723718
Y=272.00607119081
LineLength=((([mBand3]+(0.1=0?0:[mBand4]+[mBand2]))/3=0)?1:((([mBand3]+(0.1=0?0:[mBand4]+[mBand2]))/3-[mBand3])*0.1+[mBand3])*271+1)
DynamicVariables=1
[4]
Meter=Roundline
MeterStyle=styleLine
StartAngle=10.90933448923
X=345.10936484031
Y=272.29730778013
LineLength=((([mBand4]+(0.1=0?0:[mBand5]+[mBand3]))/3=0)?1:((([mBand4]+(0.1=0?0:[mBand5]+[mBand3]))/3-[mBand4])*0.1+[mBand4])*271+1)
DynamicVariables=1
[5]
Meter=Roundline
MeterStyle=styleLine
StartAngle=10.835414662087
X=339.2419367032
Y=273.02385283571
LineLength=((([mBand5]+(0.1=0?0:[mBand6]+[mBand4]))/3=0)?1:((([mBand5]+(0.1=0?0:[mBand6]+[mBand4]))/3-[mBand5])*0.1+[mBand5])*271+1)
DynamicVariables=1
[6]
Meter=Roundline
MeterStyle=styleLine
StartAngle=10.761494834944
X=333.44418868369
Y=274.18173822043
LineLength=((([mBand6]+(0.1=0?0:[mBand7]+[mBand5]))/3=0)?1:((([mBand6]+(0.1=0?0:[mBand7]+[mBand5]))/3-[mBand6])*0.1+[mBand6])*271+1)
DynamicVariables=1
[7]
Meter=Roundline
MeterStyle=styleLine
StartAngle=10.687575007801
X=327.74778607096
Y=275.76463996583
LineLength=((([mBand7]+(0.1=0?0:[mBand8]+[mBand6]))/3=0)?1:((([mBand7]+(0.1=0?0:[mBand8]+[mBand6]))/3-[mBand7])*0.1+[mBand7])*271+1)
DynamicVariables=1
[8]
Meter=Roundline
MeterStyle=styleLine
StartAngle=10.613655180657
X=322.18384064073
Y=277.76391281147
LineLength=((([mBand8]+(0.1=0?0:[mBand9]+[mBand7]))/3=0)?1:((([mBand8]+(0.1=0?0:[mBand9]+[mBand7]))/3-[mBand8])*0.1+[mBand8])*271+1)
DynamicVariables=1
[9]
Meter=Roundline
MeterStyle=styleLine
StartAngle=10.539735353514
X=316.78274073352
Y=280.16863742238
LineLength=((([mBand9]+(0.1=0?0:[mBand10]+[mBand8]))/3=0)?1:((([mBand9]+(0.1=0?0:[mBand10]+[mBand8]))/3-[mBand9])*0.1+[mBand9])*271+1)
DynamicVariables=1
[10]
Meter=Roundline
MeterStyle=styleLine
StartAngle=10.465815526371
X=311.57398528408
Y=282.96568002661
LineLength=((([mBand10]+(0.1=0?0:[mBand11]+[mBand9]))/3=0)?1:((([mBand10]+(0.1=0?0:[mBand11]+[mBand9]))/3-[mBand10])*0.1+[mBand10])*271+1)
DynamicVariables=1
[11]
Meter=Roundline
MeterStyle=styleLine
StartAngle=10.391895699227
X=306.58602270843
Y=286.13976414739
LineLength=((([mBand11]+(0.1=0?0:[mBand12]+[mBand10]))/3=0)?1:((([mBand11]+(0.1=0?0:[mBand12]+[mBand10]))/3-[mBand11])*0.1+[mBand11])*271+1)
DynamicVariables=1
[12]
Meter=Roundline
MeterStyle=styleLine
StartAngle=10.317975872084
X=301.84609552847
Y=289.67355403795
LineLength=((([mBand12]+(0.1=0?0:[mBand13]+[mBand11]))/3=0)?1:((([mBand12]+(0.1=0?0:[mBand13]+[mBand11]))/3-[mBand12])*0.1+[mBand12])*271+1)
DynamicVariables=1
[13]
Meter=Roundline
MeterStyle=styleLine
StartAngle=10.244056044941
X=297.38009158279
Y=293.5477493633
LineLength=((([mBand13]+(0.1=0?0:[mBand14]+[mBand12]))/3=0)?1:((([mBand13]+(0.1=0?0:[mBand14]+[mBand12]))/3-[mBand13])*0.1+[mBand13])*271+1)
DynamicVariables=1
[14]
Meter=Roundline
MeterStyle=styleLine
StartAngle=10.170136217798
X=293.21240263624
Y=297.74119061206
LineLength=((([mBand14]+(0.1=0?0:[mBand15]+[mBand13]))/3=0)?1:((([mBand14]+(0.1=0?0:[mBand15]+[mBand13]))/3-[mBand14])*0.1+[mBand14])*271+1)
DynamicVariables=1
[15]
Meter=Roundline
MeterStyle=styleLine
StartAngle=10.096216390654
X=289.36579116063
Y=302.23097466228
LineLength=((([mBand15]+(0.1=0?0:[mBand16]+[mBand14]))/3=0)?1:((([mBand15]+(0.1=0?0:[mBand16]+[mBand14]))/3-[mBand15])*0.1+[mBand15])*271+1)
DynamicVariables=1
[16]
Meter=Roundline
MeterStyle=styleLine
StartAngle=10.022296563511
X=285.86126601394
Y=306.99257987041
LineLength=((([mBand16]+(0.1=0?0:[mBand17]+[mBand15]))/3=0)?1:((([mBand16]+(0.1=0?0:[mBand17]+[mBand15]))/3-[mBand16])*0.1+[mBand16])*271+1)
DynamicVariables=1
[17]
Meter=Roundline
MeterStyle=styleLine
StartAngle=9.9483767363677
X=282.71796769724
Y=312
LineLength=((([mBand17]+(0.1=0?0:[mBand18]+[mBand16]))/3=0)?1:((([mBand17]+(0.1=0?0:[mBand18]+[mBand16]))/3-[mBand17])*0.1+[mBand17])*271+1)
DynamicVariables=1
[18]
Meter=Roundline
MeterStyle=styleLine
StartAngle=9.8744569092244
X=279.95306381595
Y=317.22588625872
LineLength=((([mBand18]+(0.1=0?0:[mBand19]+[mBand17]))/3=0)?1:((([mBand18]+(0.1=0?0:[mBand19]+[mBand17]))/3-[mBand18])*0.1+[mBand18])*271+1)
DynamicVariables=1
[19]
Meter=Roundline
MeterStyle=styleLine
StartAngle=9.8005370820811
X=277.58165531626
Y=322.64169666803
LineLength=((([mBand19]+(0.1=0?0:[mBand20]+[mBand18]))/3=0)?1:((([mBand19]+(0.1=0?0:[mBand20]+[mBand18]))/3-[mBand19])*0.1+[mBand19])*271+1)
DynamicVariables=1
[20]
Meter=Roundline
MeterStyle=styleLine
StartAngle=9.7266172549378
X=275.61669400907
Y=328.2178519495
LineLength=((([mBand20]+(0.1=0?0:[mBand21]+[mBand19]))/3=0)?1:((([mBand20]+(0.1=0?0:[mBand21]+[mBand19]))/3-[mBand20])*0.1+[mBand20])*271+1)
DynamicVariables=1
[21]
Meter=Roundline
MeterStyle=styleLine
StartAngle=9.6526974277945
X=274.06891183164
Y=333.92389707666
LineLength=((([mBand21]+(0.1=0?0:[mBand22]+[mBand20]))/3=0)?1:((([mBand21]+(0.1=0?0:[mBand22]+[mBand20]))/3-[mBand21])*0.1+[mBand21])*271+1)
DynamicVariables=1
[22]
Meter=Roundline
MeterStyle=styleLine
StartAngle=9.5787776006512
X=272.9467622335
Y=339.72866760971
LineLength=((([mBand22]+(0.1=0?0:[mBand23]+[mBand21]))/3=0)?1:((([mBand22]+(0.1=0?0:[mBand23]+[mBand21]))/3-[mBand22])*0.1+[mBand22])*271+1)
DynamicVariables=1
[23]
Meter=Roundline
MeterStyle=styleLine
StartAngle=9.5048577735079
X=272.25637400662
Y=345.60045990492
LineLength=((([mBand23]+(0.1=0?0:[mBand24]+[mBand22]))/3=0)?1:((([mBand23]+(0.1=0?0:[mBand24]+[mBand22]))/3-[mBand23])*0.1+[mBand23])*271+1)
DynamicVariables=1
[24]
Meter=Roundline
MeterStyle=styleLine
StartAngle=9.4309379463647
X=272.0015178121
Y=351.50720426895
LineLength=((([mBand24]+(0.1=0?0:[mBand25]+[mBand23]))/3=0)?1:((([mBand24]+(0.1=0?0:[mBand25]+[mBand23]))/3-[mBand24])*0.1+[mBand24])*271+1)
DynamicVariables=1
[25]
Meter=Roundline
MeterStyle=styleLine
StartAngle=9.3570181192214
X=272.18358558609
Y=357.41664011238
LineLength=((([mBand25]+(0.1=0?0:[mBand26]+[mBand24]))/3=0)?1:((([mBand25]+(0.1=0?0:[mBand26]+[mBand24]))/3-[mBand25])*0.1+[mBand25])*271+1)
DynamicVariables=1
[26]
Meter=Roundline
MeterStyle=styleLine
StartAngle=9.2830982920781
X=272.80158293754
Y=363.29649214585
LineLength=((([mBand26]+(0.1=0?0:[mBand27]+[mBand25]))/3=0)?1:((([mBand26]+(0.1=0?0:[mBand27]+[mBand25]))/3-[mBand26])*0.1+[mBand26])*271+1)
DynamicVariables=1
[27]
Meter=Roundline
MeterStyle=styleLine
StartAngle=9.2091784649348
X=273.85213457923
Y=369.11464665652
LineLength=((([mBand27]+(0.1=0?0:[mBand28]+[mBand26]))/3=0)?1:((([mBand27]+(0.1=0?0:[mBand28]+[mBand26]))/3-[mBand27])*0.1+[mBand27])*271+1)
DynamicVariables=1
[28]
Meter=Roundline
MeterStyle=styleLine
StartAngle=9.1352586377915
X=275.32950276239
Y=374.83932690203
LineLength=((([mBand28]+(0.1=0?0:[mBand29]+[mBand27]))/3=0)?1:((([mBand28]+(0.1=0?0:[mBand29]+[mBand27]))/3-[mBand28])*0.1+[mBand28])*271+1)
DynamicVariables=1
[29]
Meter=Roundline
MeterStyle=styleLine
StartAngle=9.0613388106482
X=277.22561861431
Y=380.43926666403
LineLength=((([mBand29]+(0.1=0?0:[mBand30]+[mBand28]))/3=0)?1:((([mBand29]+(0.1=0?0:[mBand30]+[mBand28]))/3-[mBand29])*0.1+[mBand29])*271+1)
DynamicVariables=1
[30]
Meter=Roundline
MeterStyle=styleLine
StartAngle=8.9874189835049
X=279.53012620773
Y=385.88388101343
LineLength=((([mBand30]+(0.1=0?0:[mBand31]+[mBand29]))/3=0)?1:((([mBand30]+(0.1=0?0:[mBand31]+[mBand29]))/3-[mBand30])*0.1+[mBand30])*271+1)
DynamicVariables=1
[31]
Meter=Roundline
MeterStyle=styleLine
StartAngle=8.9134991563616
X=282.23043912131
Y=391.14343335471
LineLength=((([mBand31]+(0.1=0?0:[mBand32]+[mBand30]))/3=0)?1:((([mBand31]+(0.1=0?0:[mBand32]+[mBand30]))/3-[mBand31])*0.1+[mBand31])*271+1)
DynamicVariables=1
[32]
Meter=Roundline
MeterStyle=styleLine
StartAngle=8.8395793292183
X=285.31180918231
Y=396.18919783684
LineLength=((([mBand32]+(0.1=0?0:[mBand33]+[mBand31]))/3=0)?1:((([mBand32]+(0.1=0?0:[mBand33]+[mBand31]))/3-[mBand32])*0.1+[mBand32])*271+1)
DynamicVariables=1
[33]
Meter=Roundline
MeterStyle=styleLine
StartAngle=8.7656595020751
X=288.75740701599
Y=400.99361624394
LineLength=((([mBand33]+(0.1=0?0:[mBand34]+[mBand32]))/3=0)?1:((([mBand33]+(0.1=0?0:[mBand34]+[mBand32]))/3-[mBand33])*0.1+[mBand33])*271+1)
DynamicVariables=1
[34]
Meter=Roundline
MeterStyle=styleLine
StartAngle=8.6917396749318
X=292.54841396181
Y=405.53044850871
LineLength=((([mBand34]+(0.1=0?0:[mBand35]+[mBand33]))/3=0)?1:((([mBand34]+(0.1=0?0:[mBand35]+[mBand33]))/3-[mBand34])*0.1+[mBand34])*271+1)
DynamicVariables=1
[35]
Meter=Roundline
MeterStyle=styleLine
StartAngle=8.6178198477885
X=296.66412485445
Y=409.77491602656
LineLength=((([mBand35]+(0.1=0?0:[mBand36]+[mBand34]))/3=0)?1:((([mBand35]+(0.1=0?0:[mBand36]+[mBand34]))/3-[mBand35])*0.1+[mBand35])*271+1)
DynamicVariables=1
[36]
Meter=Roundline
MeterStyle=styleLine
StartAngle=8.5439000206452
X=301.08206110823
Y=413.70383698777
LineLength=((([mBand36]+(0.1=0?0:[mBand37]+[mBand35]))/3=0)?1:((([mBand36]+(0.1=0?0:[mBand37]+[mBand35]))/3-[mBand36])*0.1+[mBand36])*271+1)
DynamicVariables=1
[37]
Meter=Roundline
MeterStyle=styleLine
StartAngle=8.4699801935019
X=305.77809348734
Y=417.2957529885
LineLength=((([mBand37]+(0.1=0?0:[mBand38]+[mBand36]))/3=0)?1:((([mBand37]+(0.1=0?0:[mBand38]+[mBand36]))/3-[mBand37])*0.1+[mBand37])*271+1)
DynamicVariables=1
[38]
Meter=Roundline
MeterStyle=styleLine
StartAngle=8.3960603663586
X=310.72657389138
Y=420.53104622911
LineLength=((([mBand38]+(0.1=0?0:[mBand39]+[mBand37]))/3=0)?1:((([mBand38]+(0.1=0?0:[mBand39]+[mBand37]))/3-[mBand38])*0.1+[mBand38])*271+1)
DynamicVariables=1
[39]
Meter=Roundline
MeterStyle=styleLine
StartAngle=8.3221405392153
X=315.90047543637
Y=423.39204665984
LineLength=((([mBand39]+(0.1=0?0:[mBand40]+[mBand38]))/3=0)?1:((([mBand39]+(0.1=0?0:[mBand40]+[mBand38]))/3-[mBand39])*0.1+[mBand39])*271+1)
DynamicVariables=1
[40]
Meter=Roundline
MeterStyle=styleLine
StartAngle=8.248220712072
X=321.27154006625
Y=425.86312848844
LineLength=((([mBand40]+(0.1=0?0:[mBand41]+[mBand39]))/3=0)?1:((([mBand40]+(0.1=0?0:[mBand41]+[mBand39]))/3-[mBand40])*0.1+[mBand40])*271+1)
DynamicVariables=1
[41]
Meter=Roundline
MeterStyle=styleLine
StartAngle=8.1743008849287
X=326.81043288852
Y=427.93079552287
LineLength=((([mBand41]+(0.1=0?0:[mBand42]+[mBand40]))/3=0)?1:((([mBand41]+(0.1=0?0:[mBand42]+[mBand40]))/3-[mBand41])*0.1+[mBand41])*271+1)
DynamicVariables=1
[42]
Meter=Roundline
MeterStyle=styleLine
StartAngle=8.1003810577854
X=332.48690239133
Y=429.5837548828
LineLength=((([mBand42]+(0.1=0?0:[mBand43]+[mBand41]))/3=0)?1:((([mBand42]+(0.1=0?0:[mBand43]+[mBand41]))/3-[mBand42])*0.1+[mBand42])*271+1)
DynamicVariables=1
[43]
Meter=Roundline
MeterStyle=styleLine
StartAngle=8.0264612306422
X=338.26994566669
Y=430.8129786774
LineLength=((([mBand43]+(0.1=0?0:[mBand44]+[mBand42]))/3=0)?1:((([mBand43]+(0.1=0?0:[mBand44]+[mBand42]))/3-[mBand43])*0.1+[mBand43])*271+1)
DynamicVariables=1
[44]
Meter=Roundline
MeterStyle=styleLine
StartAngle=7.9525414034989
X=344.12797773763
Y=431.61175331257
LineLength=((([mBand44]+(0.1=0?0:[mBand45]+[mBand43]))/3=0)?1:((([mBand44]+(0.1=0?0:[mBand45]+[mBand43]))/3-[mBand44])*0.1+[mBand44])*271+1)
DynamicVariables=1
[45]
Meter=Roundline
MeterStyle=styleLine
StartAngle=7.8786215763556
X=350.02900406437
Y=431.97571615823
LineLength=((([mBand45]+(0.1=0?0:[mBand46]+[mBand44]))/3=0)?1:((([mBand45]+(0.1=0?0:[mBand46]+[mBand44]))/3-[mBand45])*0.1+[mBand45])*271+1)
DynamicVariables=1
[46]
Meter=Roundline
MeterStyle=styleLine
StartAngle=7.8047017492123
X=355.94079528743
Y=431.90287937554
LineLength=((([mBand46]+(0.1=0?0:[mBand47]+[mBand45]))/3=0)?1:((([mBand46]+(0.1=0?0:[mBand47]+[mBand45]))/3-[mBand46])*0.1+[mBand46])*271+1)
DynamicVariables=1
[47]
Meter=Roundline
MeterStyle=styleLine
StartAngle=7.730781922069
X=361.83106325318
Y=431.39364077375
LineLength=((([mBand47]+(0.1=0?0:[mBand48]+[mBand46]))/3=0)?1:((([mBand47]+(0.1=0?0:[mBand48]+[mBand46]))/3-[mBand47])*0.1+[mBand47])*271+1)
DynamicVariables=1
[48]
Meter=Roundline
MeterStyle=styleLine
StartAngle=7.6568620949257
X=367.66763736057
Y=430.45078163752
LineLength=((([mBand48]+(0.1=0?0:[mBand49]+[mBand47]))/3=0)?1:((([mBand48]+(0.1=0?0:[mBand49]+[mBand47]))/3-[mBand48])*0.1+[mBand48])*271+1)
DynamicVariables=1
[49]
Meter=Roundline
MeterStyle=styleLine
StartAngle=7.5829422677824
X=373.4186402658
Y=429.07945153648
LineLength=((([mBand49]+(0.1=0?0:[mBand50]+[mBand48]))/3=0)?1:((([mBand49]+(0.1=0?0:[mBand50]+[mBand48]))/3-[mBand49])*0.1+[mBand49])*271+1)
DynamicVariables=1
[50]
Meter=Roundline
MeterStyle=styleLine
StartAngle=7.5090224406391
X=379.05266198527
Y=427.28714020011
LineLength=((([mBand50]+(0.1=0?0:[mBand51]+[mBand49]))/3=0)?1:((([mBand50]+(0.1=0?0:[mBand51]+[mBand49]))/3-[mBand50])*0.1+[mBand50])*271+1)
DynamicVariables=1
[51]
Meter=Roundline
MeterStyle=styleLine
StartAngle=7.4351026134958
X=384.53893144606
Y=425.08363661141
LineLength=((([mBand51]+(0.1=0?0:[mBand52]+[mBand50]))/3=0)?1:((([mBand51]+(0.1=0?0:[mBand52]+[mBand50]))/3-[mBand51])*0.1+[mBand51])*271+1)
DynamicVariables=1
[52]
Meter=Roundline
MeterStyle=styleLine
StartAngle=7.3611827863526
X=389.84748454688
Y=422.48097554286
LineLength=((([mBand52]+(0.1=0?0:[mBand53]+[mBand51]))/3=0)?1:((([mBand52]+(0.1=0?0:[mBand53]+[mBand51]))/3-[mBand52])*0.1+[mBand52])*271+1)
DynamicVariables=1
[53]
Meter=Roundline
MeterStyle=styleLine
StartAngle=7.2872629592093
X=394.94932781153
Y=419.4933718267
LineLength=((([mBand53]+(0.1=0?0:[mBand54]+[mBand52]))/3=0)?1:((([mBand53]+(0.1=0?0:[mBand54]+[mBand52]))/3-[mBand53])*0.1+[mBand53])*271+1)
DynamicVariables=1
[54]
Meter=Roundline
MeterStyle=styleLine
StartAngle=7.213343132066
X=399.81659674129
Y=416.13714271841
LineLength=((([mBand54]+(0.1=0?0:[mBand55]+[mBand53]))/3=0)?1:((([mBand54]+(0.1=0?0:[mBand55]+[mBand53]))/3-[mBand54])*0.1+[mBand54])*271+1)
DynamicVariables=1
[55]
Meter=Roundline
MeterStyle=styleLine
StartAngle=7.1394233049227
X=404.42270800108
Y=412.43061877752
LineLength=((([mBand55]+(0.1=0?0:[mBand56]+[mBand54]))/3=0)?1:((([mBand55]+(0.1=0?0:[mBand56]+[mBand54]))/3-[mBand55])*0.1+[mBand55])*271+1)
DynamicVariables=1
[56]
Meter=Roundline
MeterStyle=styleLine
StartAngle=7.0655034777794
X=408.74250460847
Y=408.39404375249
LineLength=((([mBand56]+(0.1=0?0:[mBand57]+[mBand55]))/3=0)?1:((([mBand56]+(0.1=0?0:[mBand57]+[mBand55]))/3-[mBand56])*0.1+[mBand56])*271+1)
DynamicVariables=1
[57]
Meter=Roundline
MeterStyle=styleLine
StartAngle=6.9915836506361
X=412.75239333238
Y=404.04946401634
LineLength=((([mBand57]+(0.1=0?0:[mBand58]+[mBand56]))/3=0)?1:((([mBand57]+(0.1=0?0:[mBand58]+[mBand56]))/3-[mBand57])*0.1+[mBand57])*271+1)
DynamicVariables=1
[58]
Meter=Roundline
MeterStyle=styleLine
StartAngle=6.9176638234928
X=416.43047355111
Y=399.420608157
LineLength=((([mBand58]+(0.1=0?0:[mBand59]+[mBand57]))/3=0)?1:((([mBand58]+(0.1=0?0:[mBand59]+[mBand57]))/3-[mBand58])*0.1+[mBand58])*271+1)
DynamicVariables=1
[59]
Meter=Roundline
MeterStyle=styleLine
StartAngle=6.8437439963495
X=419.75665686596
Y=394.53275738003
LineLength=((([mBand59]+(0.1=0?0:[mBand60]+[mBand58]))/3=0)?1:((([mBand59]+(0.1=0?0:[mBand60]+[mBand58]))/3-[mBand59])*0.1+[mBand59])*271+1)
DynamicVariables=1
[60]
Meter=Roundline
MeterStyle=styleLine
StartAngle=6.7698241692062
X=422.71277681709
Y=389.41260743141
LineLength=((([mBand60]+(0.1=0?0:[mBand61]+[mBand59]))/3=0)?1:((([mBand60]+(0.1=0?0:[mBand61]+[mBand59]))/3-[mBand60])*0.1+[mBand60])*271+1)
DynamicVariables=1
[61]
Meter=Roundline
MeterStyle=styleLine
StartAngle=6.695904342063
X=425.28268810243
Y=384.08812279462
LineLength=((([mBand61]+(0.1=0?0:[mBand62]+[mBand60]))/3=0)?1:((([mBand61]+(0.1=0?0:[mBand62]+[mBand60]))/3-[mBand61])*0.1+[mBand61])*271+1)
DynamicVariables=1
[62]
Meter=Roundline
MeterStyle=styleLine
StartAngle=6.6219845149197
X=427.4523547577
Y=378.58838395837
LineLength=((([mBand62]+(0.1=0?0:[mBand63]+[mBand61]))/3=0)?1:((([mBand62]+(0.1=0?0:[mBand63]+[mBand61]))/3-[mBand62])*0.1+[mBand62])*271+1)
DynamicVariables=1
[63]
Meter=Roundline
MeterStyle=styleLine
StartAngle=6.5480646877764
X=429.20992681602
Y=372.94342858904
LineLength=((([mBand63]+(0.1=0?0:[mBand64]+[mBand62]))/3=0)?1:((([mBand63]+(0.1=0?0:[mBand64]+[mBand62]))/3-[mBand63])*0.1+[mBand63])*271+1)
DynamicVariables=1
[64]
Meter=Roundline
MeterStyle=styleLine
StartAngle=6.4741448606331
X=430.54580502828
Y=367.18408747535
LineLength=((([mBand64]+(0.1=0?0:[mBand65]+[mBand63]))/3=0)?1:((([mBand64]+(0.1=0?0:[mBand65]+[mBand63]))/3-[mBand64])*0.1+[mBand64])*271+1)
DynamicVariables=1
[65]
Meter=Roundline
MeterStyle=styleLine
StartAngle=6.4002250334898
X=431.45269329093
Y=361.34181614127
LineLength=((([mBand65]+(0.1=0?0:[mBand66]+[mBand64]))/3=0)?1:((([mBand65]+(0.1=0?0:[mBand66]+[mBand64]))/3-[mBand65])*0.1+[mBand65])*271+1)
DynamicVariables=1
[66]
Meter=Roundline
MeterStyle=styleLine
StartAngle=6.3263052063465
X=431.92563849476
Y=355.4485230469
LineLength=((([mBand66]+(0.1=0?0:[mBand67]+[mBand65]))/3=0)?1:((([mBand66]+(0.1=0?0:[mBand67]+[mBand65]))/3-[mBand66])*0.1+[mBand66])*271+1)
DynamicVariables=1
[67]
Meter=Roundline
MeterStyle=styleLine
StartAngle=6.2523853792032
X=431.96205757707
Y=349.53639531551
LineLength=((([mBand67]+(0.1=0?0:[mBand68]+[mBand66]))/3=0)?1:((([mBand67]+(0.1=0?0:[mBand68]+[mBand66]))/3-[mBand67])*0.1+[mBand67])*271+1)
DynamicVariables=1
[68]
Meter=Roundline
MeterStyle=styleLine
StartAngle=6.1784655520599
X=431.56175162946
Y=343.63772293859
LineLength=((([mBand68]+(0.1=0?0:[mBand69]+[mBand67]))/3=0)?1:((([mBand68]+(0.1=0?0:[mBand69]+[mBand67]))/3-[mBand68])*0.1+[mBand68])*271+1)
DynamicVariables=1
[69]
Meter=Roundline
MeterStyle=styleLine
StartAngle=6.1045457249166
X=430.72690698421
Y=337.78472241918
LineLength=((([mBand69]+(0.1=0?0:[mBand70]+[mBand68]))/3=0)?1:((([mBand69]+(0.1=0?0:[mBand70]+[mBand68]))/3-[mBand69])*0.1+[mBand69])*271+1)
DynamicVariables=1
[70]
Meter=Roundline
MeterStyle=styleLine
StartAngle=6.0306258977733
X=429.46208327326
Y=332.00936081646
LineLength=((([mBand70]+(0.1=0?0:[mBand71]+[mBand69]))/3=0)?1:((([mBand70]+(0.1=0?0:[mBand71]+[mBand69]))/3-[mBand70])*0.1+[mBand70])*271+1)
DynamicVariables=1
[71]
Meter=Roundline
MeterStyle=styleLine
StartAngle=5.9567060706301
X=427.77418852512
Y=326.34318115278
LineLength=((([mBand71]+(0.1=0?0:[mBand72]+[mBand70]))/3=0)?1:((([mBand71]+(0.1=0?0:[mBand72]+[mBand70]))/3-[mBand71])*0.1+[mBand71])*271+1)
DynamicVariables=1
[72]
Meter=Roundline
MeterStyle=styleLine
StartAngle=5.8827862434868
X=425.6724414356
Y=320.81713013659
LineLength=((([mBand72]+(0.1=0?0:[mBand73]+[mBand71]))/3=0)?1:((([mBand72]+(0.1=0?0:[mBand73]+[mBand71]))/3-[mBand72])*0.1+[mBand72])*271+1)
DynamicVariables=1
[73]
Meter=Roundline
MeterStyle=styleLine
StartAngle=5.8088664163435
X=423.16832101846
Y=315.46138914225
LineLength=((([mBand73]+(0.1=0?0:[mBand74]+[mBand72]))/3=0)?1:((([mBand73]+(0.1=0?0:[mBand74]+[mBand72]))/3-[mBand73])*0.1+[mBand73])*271+1)
DynamicVariables=1
[74]
Meter=Roundline
MeterStyle=styleLine
StartAngle=5.7349465892002
X=420.27550391107
Y=310.30520936987
LineLength=((([mBand74]+(0.1=0?0:[mBand75]+[mBand73]))/3=0)?1:((([mBand74]+(0.1=0?0:[mBand75]+[mBand73]))/3-[mBand74])*0.1+[mBand74])*271+1)
DynamicVariables=1
[75]
Meter=Roundline
MeterStyle=styleLine
StartAngle=5.6610267620569
X=417.00978967732
Y=305.37675208535
LineLength=((([mBand75]+(0.1=0?0:[mBand76]+[mBand74]))/3=0)?1:((([mBand75]+(0.1=0?0:[mBand76]+[mBand74]))/3-[mBand75])*0.1+[mBand75])*271+1)
DynamicVariables=1
[76]
Meter=Roundline
MeterStyle=styleLine
StartAngle=5.5871069349136
X=413.3890145159
Y=300.70293481331
LineLength=((([mBand76]+(0.1=0?0:[mBand77]+[mBand75]))/3=0)?1:((([mBand76]+(0.1=0?0:[mBand77]+[mBand75]))/3-[mBand76])*0.1+[mBand76])*271+1)
DynamicVariables=1
[77]
Meter=Roundline
MeterStyle=styleLine
StartAngle=5.5131871077703
X=409.43295384516
Y=296.30928432297
LineLength=((([mBand77]+(0.1=0?0:[mBand78]+[mBand76]))/3=0)?1:((([mBand77]+(0.1=0?0:[mBand78]+[mBand76]))/3-[mBand77])*0.1+[mBand77])*271+1)
DynamicVariables=1
[78]
Meter=Roundline
MeterStyle=styleLine
StartAngle=5.439267280627
X=405.16321429663
Y=292.21979720969
LineLength=((([mBand78]+(0.1=0?0:[mBand79]+[mBand77]))/3=0)?1:((([mBand78]+(0.1=0?0:[mBand79]+[mBand77]))/3-[mBand78])*0.1+[mBand78])*271+1)
DynamicVariables=1
[79]
Meter=Roundline
MeterStyle=styleLine
StartAngle=5.3653474534837
X=400.60311570711
Y=288.45680883398
LineLength=((([mBand79]+(0.1=0?0:[mBand80]+[mBand78]))/3=0)?1:((([mBand79]+(0.1=0?0:[mBand80]+[mBand78]))/3-[mBand79])*0.1+[mBand79])*271+1)
DynamicVariables=1
[80]
Meter=Roundline
MeterStyle=styleLine
StartAngle=5.2914276263405
X=395.77756375377
Y=285.04087133344
LineLength=((([mBand80]+(0.1=0?0:[mBand81]+[mBand79]))/3=0)?1:((([mBand80]+(0.1=0?0:[mBand81]+[mBand79]))/3-[mBand80])*0.1+[mBand80])*271+1)
DynamicVariables=1
[81]
Meter=Roundline
MeterStyle=styleLine
StartAngle=5.2175077991972
X=390.71291392802
Y=281.99064137416
LineLength=((([mBand81]+(0.1=0?0:[mBand82]+[mBand80]))/3=0)?1:((([mBand81]+(0.1=0?0:[mBand82]+[mBand80]))/3-[mBand81])*0.1+[mBand81])*271+1)
DynamicVariables=1
[82]
Meter=Roundline
MeterStyle=styleLine
StartAngle=5.1435879720539
X=385.43682759094
Y=279.32277825444
LineLength=((([mBand82]+(0.1=0?0:[mBand83]+[mBand81]))/3=0)?1:((([mBand82]+(0.1=0?0:[mBand83]+[mBand81]))/3-[mBand82])*0.1+[mBand82])*271+1)
DynamicVariables=1
[83]
Meter=Roundline
MeterStyle=styleLine
StartAngle=5.0696681449106
X=379.9781208965
Y=277.0518529175
LineLength=((([mBand83]+(0.1=0?0:[mBand84]+[mBand82]))/3=0)?1:((([mBand83]+(0.1=0?0:[mBand84]+[mBand82]))/3-[mBand83])*0.1+[mBand83])*271+1)
DynamicVariables=1
[84]
Meter=Roundline
MeterStyle=styleLine
StartAngle=4.9957483177673
X=374.36660740774
Y=275.19026837003
LineLength=((([mBand84]+(0.1=0?0:[mBand0]+[mBand83]))/3=0)?1:((([mBand84]+(0.1=0?0:[mBand0]+[mBand83]))/3-[mBand84])*0.1+[mBand84])*271+1)
DynamicVariables=1