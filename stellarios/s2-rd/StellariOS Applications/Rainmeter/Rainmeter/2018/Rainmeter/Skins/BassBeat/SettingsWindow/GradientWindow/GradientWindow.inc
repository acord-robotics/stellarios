; auto-generated by GradientWindow.lua
[1a]
Meter=Image
MeterStyle=styleAnchor
X=24
LeftMouseDownAction=[!CommandMeasure s "anchorSelect(1)"]
RightMouseDownAction=[!CommandMeasure s "anchorDelete(1)"]
[1c]
Meter=Image
MeterStyle=styleAnchorFill | styleCheck
X=25
[1f]
Meter=Image
MeterStyle=styleAnchorFill
X=25
SolidColor=0,0,0,255
[2a]
Meter=Image
MeterStyle=styleAnchor
X=24
LeftMouseDownAction=[!CommandMeasure s "anchorSelect(2)"]
RightMouseDownAction=[!CommandMeasure s "anchorDelete(2)"]
[2c]
Meter=Image
MeterStyle=styleAnchorFill | styleCheck
X=25
[2f]
Meter=Image
MeterStyle=styleAnchorFill
X=25
SolidColor=0,0,0,255
[3a]
Meter=Image
MeterStyle=styleAnchor
X=24
LeftMouseDownAction=[!CommandMeasure s "anchorSelect(3)"]
RightMouseDownAction=[!CommandMeasure s "anchorDelete(3)"]
[3c]
Meter=Image
MeterStyle=styleAnchorFill | styleCheck
X=25
[3f]
Meter=Image
MeterStyle=styleAnchorFill
X=25
SolidColor=0,0,0,255
[4a]
Meter=Image
MeterStyle=styleAnchor
X=24
LeftMouseDownAction=[!CommandMeasure s "anchorSelect(4)"]
RightMouseDownAction=[!CommandMeasure s "anchorDelete(4)"]
[4c]
Meter=Image
MeterStyle=styleAnchorFill | styleCheck
X=25
[4f]
Meter=Image
MeterStyle=styleAnchorFill
X=25
SolidColor=0,0,0,255
[5a]
Meter=Image
MeterStyle=styleAnchor
X=24
LeftMouseDownAction=[!CommandMeasure s "anchorSelect(5)"]
RightMouseDownAction=[!CommandMeasure s "anchorDelete(5)"]
[5c]
Meter=Image
MeterStyle=styleAnchorFill | styleCheck
X=25
[5f]
Meter=Image
MeterStyle=styleAnchorFill
X=25
SolidColor=0,0,0,255
[6a]
Meter=Image
MeterStyle=styleAnchor
X=24
LeftMouseDownAction=[!CommandMeasure s "anchorSelect(6)"]
RightMouseDownAction=[!CommandMeasure s "anchorDelete(6)"]
[6c]
Meter=Image
MeterStyle=styleAnchorFill | styleCheck
X=25
[6f]
Meter=Image
MeterStyle=styleAnchorFill
X=25
SolidColor=0,0,0,255
[7a]
Meter=Image
MeterStyle=styleAnchor
X=24
LeftMouseDownAction=[!CommandMeasure s "anchorSelect(7)"]
RightMouseDownAction=[!CommandMeasure s "anchorDelete(7)"]
[7c]
Meter=Image
MeterStyle=styleAnchorFill | styleCheck
X=25
[7f]
Meter=Image
MeterStyle=styleAnchorFill
X=25
SolidColor=0,0,0,255
[8a]
Meter=Image
MeterStyle=styleAnchor
X=24
LeftMouseDownAction=[!CommandMeasure s "anchorSelect(8)"]
RightMouseDownAction=[!CommandMeasure s "anchorDelete(8)"]
[8c]
Meter=Image
MeterStyle=styleAnchorFill | styleCheck
X=25
[8f]
Meter=Image
MeterStyle=styleAnchorFill
X=25
SolidColor=0,0,0,255
[9a]
Meter=Image
MeterStyle=styleAnchor
X=24
LeftMouseDownAction=[!CommandMeasure s "anchorSelect(9)"]
RightMouseDownAction=[!CommandMeasure s "anchorDelete(9)"]
[9c]
Meter=Image
MeterStyle=styleAnchorFill | styleCheck
X=25
[9f]
Meter=Image
MeterStyle=styleAnchorFill
X=25
SolidColor=0,0,0,255
[10a]
Meter=Image
MeterStyle=styleAnchor
X=24
LeftMouseDownAction=[!CommandMeasure s "anchorSelect(10)"]
RightMouseDownAction=[!CommandMeasure s "anchorDelete(10)"]
[10c]
Meter=Image
MeterStyle=styleAnchorFill | styleCheck
X=25
[10f]
Meter=Image
MeterStyle=styleAnchorFill
X=25
SolidColor=0,0,0,255
[11a]
Meter=Image
MeterStyle=styleAnchor
X=24
LeftMouseDownAction=[!CommandMeasure s "anchorSelect(11)"]
RightMouseDownAction=[!CommandMeasure s "anchorDelete(11)"]
[11c]
Meter=Image
MeterStyle=styleAnchorFill | styleCheck
X=25
[11f]
Meter=Image
MeterStyle=styleAnchorFill
X=25
SolidColor=0,0,0,255
[12a]
Meter=Image
MeterStyle=styleAnchor
X=24
LeftMouseDownAction=[!CommandMeasure s "anchorSelect(12)"]
RightMouseDownAction=[!CommandMeasure s "anchorDelete(12)"]
[12c]
Meter=Image
MeterStyle=styleAnchorFill | styleCheck
X=25
[12f]
Meter=Image
MeterStyle=styleAnchorFill
X=25
SolidColor=0,0,0,255
[13a]
Meter=Image
MeterStyle=styleAnchor
X=24
LeftMouseDownAction=[!CommandMeasure s "anchorSelect(13)"]
RightMouseDownAction=[!CommandMeasure s "anchorDelete(13)"]
[13c]
Meter=Image
MeterStyle=styleAnchorFill | styleCheck
X=25
[13f]
Meter=Image
MeterStyle=styleAnchorFill
X=25
SolidColor=0,0,0,255
[14a]
Meter=Image
MeterStyle=styleAnchor
X=24
LeftMouseDownAction=[!CommandMeasure s "anchorSelect(14)"]
RightMouseDownAction=[!CommandMeasure s "anchorDelete(14)"]
[14c]
Meter=Image
MeterStyle=styleAnchorFill | styleCheck
X=25
[14f]
Meter=Image
MeterStyle=styleAnchorFill
X=25
SolidColor=0,0,0,255
[15a]
Meter=Image
MeterStyle=styleAnchor
X=24
LeftMouseDownAction=[!CommandMeasure s "anchorSelect(15)"]
RightMouseDownAction=[!CommandMeasure s "anchorDelete(15)"]
[15c]
Meter=Image
MeterStyle=styleAnchorFill | styleCheck
X=25
[15f]
Meter=Image
MeterStyle=styleAnchorFill
X=25
SolidColor=0,0,0,255
[16a]
Meter=Image
MeterStyle=styleAnchor
X=24
LeftMouseDownAction=[!CommandMeasure s "anchorSelect(16)"]
RightMouseDownAction=[!CommandMeasure s "anchorDelete(16)"]
[16c]
Meter=Image
MeterStyle=styleAnchorFill | styleCheck
X=25
[16f]
Meter=Image
MeterStyle=styleAnchorFill
X=25
SolidColor=0,0,0,255
[17a]
Meter=Image
MeterStyle=styleAnchor
X=24
LeftMouseDownAction=[!CommandMeasure s "anchorSelect(17)"]
RightMouseDownAction=[!CommandMeasure s "anchorDelete(17)"]
[17c]
Meter=Image
MeterStyle=styleAnchorFill | styleCheck
X=25
[17f]
Meter=Image
MeterStyle=styleAnchorFill
X=25
SolidColor=0,0,0,255
[18a]
Meter=Image
MeterStyle=styleAnchor
X=24
LeftMouseDownAction=[!CommandMeasure s "anchorSelect(18)"]
RightMouseDownAction=[!CommandMeasure s "anchorDelete(18)"]
[18c]
Meter=Image
MeterStyle=styleAnchorFill | styleCheck
X=25
[18f]
Meter=Image
MeterStyle=styleAnchorFill
X=25
SolidColor=0,0,0,255
[19a]
Meter=Image
MeterStyle=styleAnchor
X=24
LeftMouseDownAction=[!CommandMeasure s "anchorSelect(19)"]
RightMouseDownAction=[!CommandMeasure s "anchorDelete(19)"]
[19c]
Meter=Image
MeterStyle=styleAnchorFill | styleCheck
X=25
[19f]
Meter=Image
MeterStyle=styleAnchorFill
X=25
SolidColor=0,0,0,255
[20a]
Meter=Image
MeterStyle=styleAnchor
X=24
LeftMouseDownAction=[!CommandMeasure s "anchorSelect(20)"]
RightMouseDownAction=[!CommandMeasure s "anchorDelete(20)"]
[20c]
Meter=Image
MeterStyle=styleAnchorFill | styleCheck
X=25
[20f]
Meter=Image
MeterStyle=styleAnchorFill
X=25
SolidColor=0,0,0,255
[21a]
Meter=Image
MeterStyle=styleAnchor
X=24
LeftMouseDownAction=[!CommandMeasure s "anchorSelect(21)"]
RightMouseDownAction=[!CommandMeasure s "anchorDelete(21)"]
[21c]
Meter=Image
MeterStyle=styleAnchorFill | styleCheck
X=25
[21f]
Meter=Image
MeterStyle=styleAnchorFill
X=25
SolidColor=0,0,0,255
[22a]
Meter=Image
MeterStyle=styleAnchor
X=24
LeftMouseDownAction=[!CommandMeasure s "anchorSelect(22)"]
RightMouseDownAction=[!CommandMeasure s "anchorDelete(22)"]
[22c]
Meter=Image
MeterStyle=styleAnchorFill | styleCheck
X=25
[22f]
Meter=Image
MeterStyle=styleAnchorFill
X=25
SolidColor=0,0,0,255
[23a]
Meter=Image
MeterStyle=styleAnchor
X=24
LeftMouseDownAction=[!CommandMeasure s "anchorSelect(23)"]
RightMouseDownAction=[!CommandMeasure s "anchorDelete(23)"]
[23c]
Meter=Image
MeterStyle=styleAnchorFill | styleCheck
X=25
[23f]
Meter=Image
MeterStyle=styleAnchorFill
X=25
SolidColor=0,0,0,255
[24a]
Meter=Image
MeterStyle=styleAnchor
X=24
LeftMouseDownAction=[!CommandMeasure s "anchorSelect(24)"]
RightMouseDownAction=[!CommandMeasure s "anchorDelete(24)"]
[24c]
Meter=Image
MeterStyle=styleAnchorFill | styleCheck
X=25
[24f]
Meter=Image
MeterStyle=styleAnchorFill
X=25
SolidColor=0,0,0,255
[25a]
Meter=Image
MeterStyle=styleAnchor
X=24
LeftMouseDownAction=[!CommandMeasure s "anchorSelect(25)"]
RightMouseDownAction=[!CommandMeasure s "anchorDelete(25)"]
[25c]
Meter=Image
MeterStyle=styleAnchorFill | styleCheck
X=25
[25f]
Meter=Image
MeterStyle=styleAnchorFill
X=25
SolidColor=223,207,78,255
[26a]
Meter=Image
MeterStyle=styleAnchor
X=24
LeftMouseDownAction=[!CommandMeasure s "anchorSelect(26)"]
RightMouseDownAction=[!CommandMeasure s "anchorDelete(26)"]
[26c]
Meter=Image
MeterStyle=styleAnchorFill | styleCheck
X=25
[26f]
Meter=Image
MeterStyle=styleAnchorFill
X=25
SolidColor=0,0,0,255
[27a]
Meter=Image
MeterStyle=styleAnchor
X=24
LeftMouseDownAction=[!CommandMeasure s "anchorSelect(27)"]
RightMouseDownAction=[!CommandMeasure s "anchorDelete(27)"]
[27c]
Meter=Image
MeterStyle=styleAnchorFill | styleCheck
X=25
[27f]
Meter=Image
MeterStyle=styleAnchorFill
X=25
SolidColor=97,225,61,255
[28a]
Meter=Image
MeterStyle=styleAnchor
X=24
LeftMouseDownAction=[!CommandMeasure s "anchorSelect(28)"]
RightMouseDownAction=[!CommandMeasure s "anchorDelete(28)"]
[28c]
Meter=Image
MeterStyle=styleAnchorFill | styleCheck
X=25
[28f]
Meter=Image
MeterStyle=styleAnchorFill
X=25
SolidColor=1,103,235,255
[29a]
Meter=Image
MeterStyle=styleAnchor
X=24
LeftMouseDownAction=[!CommandMeasure s "anchorSelect(29)"]
RightMouseDownAction=[!CommandMeasure s "anchorDelete(29)"]
[29c]
Meter=Image
MeterStyle=styleAnchorFill | styleCheck
X=25
[29f]
Meter=Image
MeterStyle=styleAnchorFill
X=25
SolidColor=90,226,241,255
[30a]
Meter=Image
MeterStyle=styleAnchor
X=24
LeftMouseDownAction=[!CommandMeasure s "anchorSelect(30)"]
RightMouseDownAction=[!CommandMeasure s "anchorDelete(30)"]
[30c]
Meter=Image
MeterStyle=styleAnchorFill | styleCheck
X=25
[30f]
Meter=Image
MeterStyle=styleAnchorFill
X=25
SolidColor=169,240,255,255
[31a]
Meter=Image
MeterStyle=styleAnchor
X=24
LeftMouseDownAction=[!CommandMeasure s "anchorSelect(31)"]
RightMouseDownAction=[!CommandMeasure s "anchorDelete(31)"]
[31c]
Meter=Image
MeterStyle=styleAnchorFill | styleCheck
X=25
[31f]
Meter=Image
MeterStyle=styleAnchorFill
X=25
SolidColor=0,0,0,255
[32a]
Meter=Image
MeterStyle=styleAnchor
X=24
LeftMouseDownAction=[!CommandMeasure s "anchorSelect(32)"]
RightMouseDownAction=[!CommandMeasure s "anchorDelete(32)"]
[32c]
Meter=Image
MeterStyle=styleAnchorFill | styleCheck
X=25
[32f]
Meter=Image
MeterStyle=styleAnchorFill
X=25
SolidColor=0,0,0,255
[33a]
Meter=Image
MeterStyle=styleAnchor
X=24
LeftMouseDownAction=[!CommandMeasure s "anchorSelect(33)"]
RightMouseDownAction=[!CommandMeasure s "anchorDelete(33)"]
[33c]
Meter=Image
MeterStyle=styleAnchorFill | styleCheck
X=25
[33f]
Meter=Image
MeterStyle=styleAnchorFill
X=25
SolidColor=237,144,0,255
[34a]
Meter=Image
MeterStyle=styleAnchor
X=24
LeftMouseDownAction=[!CommandMeasure s "anchorSelect(34)"]
RightMouseDownAction=[!CommandMeasure s "anchorDelete(34)"]
[34c]
Meter=Image
MeterStyle=styleAnchorFill | styleCheck
X=25
[34f]
Meter=Image
MeterStyle=styleAnchorFill
X=25
SolidColor=45,204,231,255
[35a]
Meter=Image
MeterStyle=styleAnchor
X=24
LeftMouseDownAction=[!CommandMeasure s "anchorSelect(35)"]
RightMouseDownAction=[!CommandMeasure s "anchorDelete(35)"]
[35c]
Meter=Image
MeterStyle=styleAnchorFill | styleCheck
X=25
[35f]
Meter=Image
MeterStyle=styleAnchorFill
X=25
SolidColor=237,129,3,255
[36a]
Meter=Image
MeterStyle=styleAnchor
X=24
LeftMouseDownAction=[!CommandMeasure s "anchorSelect(36)"]
RightMouseDownAction=[!CommandMeasure s "anchorDelete(36)"]
[36c]
Meter=Image
MeterStyle=styleAnchorFill | styleCheck
X=25
[36f]
Meter=Image
MeterStyle=styleAnchorFill
X=25
SolidColor=225,12,161,255
[0_35]
Meter=Image
MeterStyle=styleGradient
SolidColor=225,12,161,255
SolidColor2=225,181,12,255
X=32
W=112
[37a]
Meter=Image
MeterStyle=styleAnchor
X=136
LeftMouseDownAction=[!CommandMeasure s "anchorSelect(37)"]
RightMouseDownAction=[!CommandMeasure s "anchorDelete(37)"]
[37c]
Meter=Image
MeterStyle=styleAnchorFill | styleCheck
X=137
[37f]
Meter=Image
MeterStyle=styleAnchorFill
X=137
SolidColor=225,181,12,255
[35_50]
Meter=Image
MeterStyle=styleGradient
SolidColor=225,181,12,255
SolidColor2=223,123,6,253.55113636364
X=144
W=48
[38a]
Meter=Image
MeterStyle=styleAnchor
X=184
LeftMouseDownAction=[!CommandMeasure s "anchorSelect(38)"]
RightMouseDownAction=[!CommandMeasure s "anchorDelete(38)"]
[38c]
Meter=Image
MeterStyle=styleAnchorFill | styleCheck
X=185
[38f]
Meter=Image
MeterStyle=styleAnchorFill
X=185
SolidColor=223,123,6,253.55113636364
[50_76]
Meter=Image
MeterStyle=styleGradient
SolidColor=223,123,6,253.55113636364
SolidColor2=247,3,152,255
X=192
W=84
[39a]
Meter=Image
MeterStyle=styleAnchor
X=267
LeftMouseDownAction=[!CommandMeasure s "anchorSelect(39)"]
RightMouseDownAction=[!CommandMeasure s "anchorDelete(39)"]
[39c]
Meter=Image
MeterStyle=styleAnchorFill | styleCheck
X=268
[39f]
Meter=Image
MeterStyle=styleAnchorFill
X=268
SolidColor=247,3,152,255
[76_100]
Meter=Image
MeterStyle=styleGradient
SolidColor=247,3,152,255
SolidColor2=223,16,241,255
X=275
W=77
[40a]
Meter=Image
MeterStyle=styleAnchor
X=344
LeftMouseDownAction=[!CommandMeasure s "anchorSelect(40)"]
RightMouseDownAction=[!CommandMeasure s "anchorDelete(40)"]
[40c]
Meter=Image
MeterStyle=styleAnchorFill | styleCheck
X=345
[40f]
Meter=Image
MeterStyle=styleAnchorFill
X=345
SolidColor=223,16,241,255
