[Variables]
langoverride=1
Translation=German
starttext=Beginnen
languagedomain=de
friends=Freunde
Translated=übersetzt ins Deutsche von MaskedJudas
welcometo=Willkommen zu
selectlanguage=Sprache wählen
developed=entwickelt
opengallery=Gallerie öffnen
programs=Programme
systemtools=System Tools
alarm1=Wecker
Set=stellen
Snooze=abstellen
Videos=Videos
Music=Musik
TV=TV
Pictures=Bilder
About=über
openfolder=öffnen
new=neue
no=0
Picturesfoldername=Bilder-Ordner
applications=Anwendungen
Quickplay=Quickplay
Collection=Sammlung
Library=Bibliothek
editnotes=ändern
games=Spiele
spotlight=spotlight
LaunchGamesforWindowsLive=Starte Games for Windows Live
GotoGamesforWindows=Gehe zu Games for Windows
Monday=Montag
Tuesday=Dienstag
Wednesday=Mittwoch
Thursday=Donnerstag
Friday=Freitag
Saturday=Samstag
Sunday=Sonntag
January=Januar
February=Februar
March=März
April=April
May=Mai
June=Juni
July=Juli
August=August
September=September
October=Oktober
November=November
December=Dezember
Januaryshort=Jan.
Februaryshort=Feb.
Marchshort=März

Aprilshort=April
Mayshort=Mai
Juneshort=Juni
Julyshort=Juli
Augustshort=August
Septembershort=Sept.
Octobershort=Okt.
Novembershort=Nov.
Decembershort=Dez.
Gallery=Gallerie
Panels=Paneele
Skins=Skin
Credit=Credit
OpenTrash=Papierkorb öffnen
Items=Elemente
Size=Größe 
Battery=Batterie
ACLine=AC Line
Power=Energie
Uptime=Uptime
Memory=Speicher
CORE=Kern
Phase=Phase
harddrives=Festplatten
Free=Freier
Space=Speicher
Used=Belegter
drives1=Disk
settings=Einstellungen
tools=Tools
downloads=Downloads
Network=Netzwerk
Setaswallpaper=als Hintergrundbild
RecycleBin=Papierkorb
MostlyCloudy=meist wolkig
LightSnow=Leichter Schnee
LightRain=Leichter Regen
LightRainShower=Leichte Schauer
Cloudy=wolkig
Drizzle=Nieselregen
Lgt=Lgt
And=und
Partly=teils
Mostly=meist
with=mit
Clear=klar
Fair=heiter
PartlyCloudy=teils wolkig
Cloudy=wolkig
FreezingRain=gefrierender Regen
Rain=Regen
Thunder=Gewitter
intheVicinity=in der Nдhe
Shower=Schauer
Snow=Schnee
Sunny=sonnig
Windy=windig
Haze=trьb
Fog=Nebel
WidespreadDust=verbreitet Dunst
Set=Set
T-Storm=Gewitter
LightDrizzle=Leichter Nieselregen
WintryMiX=winterlich wechselhaft
Light=Leichter
--

Weather=Wetter
notconfigured=Nicht konfiguriert 
Updates=Updates
Currentversion=Aktuelle Version
NoUpdatesAvailable=0 Updates verfügbar
NewUpdateAvailable=Neues Update
news=rss
feeds=feeds
systemstorage=system storage
BinaryClock=Binary Clock
noresize=This panel isn't resizable ಠ_ಠ
countdown=Countdown
start=start
stop=stop
settimer=set
reset=reset
IPAddress=IP Addresse
Empty=Freien
Processor=Prozessor
Volume=Volume
systeminfo=System Info
ME=ICH
Wireless=Wireless
Folders=Folders
Maps=Karten
Search=Suchen
MoonPhase=Mondphase
Stocks=Stocks
Tonight=Heute
Mon=Mon
Tue=Dien
Wed=Mit
Thu=Don
Fri=Frei
Sat=Sam
Sun=Son
Calculator=Rechner
Camera=Screenshot
Notestitle=Notizen

;GALLERY
DONATERPANELS=DONATOR PANELS
TIME=Zeit
PCINFO=PC Info
SHORTCUTS=Shortcuts
INTERNET=Internet
TOOLS1=Tools
INSTALLEDPANELS=INSTALLIERTE PANELS
INSTALLEDTHEMES=INSTALLIERTE THEMEN
ALLTEXTITEMS=ALLE TEXTITEMS
INSTALLED=INESTALLIERT
CUSTOMIZE=ANPASSEN
textitemscolor=TextItems Farbe
Viewgift=Geschenk öffnen

;Better ignore these 2
panels1=Paneele
textitems=text items

Preview=Preview
Close=Schließen [x]
Apply=Übernehmen
MoreAddonsGallery=Mehr Add-ons

all=alle
unreademails=E-Mails
inboX=inbox
resourceuseage=ressourcennutzung
resource=ressourcen
SYSTEMMONITORING=SYSTEMÜBERWACHUNG
Processorload=Prozessor-Last
Systemmemory=Arbeitsspeicher
Virtualmemory=Virtueller Speicher
Primaryharddrive=Festplatte
Secondaryharddrive=Festplatte 2
information=information
system=system
info=info
dateandtime=date and time
networkoptions=network options
poweroptions=power options
audiooptions=audio options
themeoptions=theme options
displayoptions=display options
useraccounts=user accounts
windowsupdate=Windows update
monitorsconnected=monitor(s) connected
loggedinas=Logged in as
installupdatesevery=Install updates: Every 
today=Heute
forecast=vorhersage
BaroMeter=Barometer
Humidity=Luftfeuchtigkeit
Visibility=Sicht
Wind=Wind
Windchill=Wind chill
Winddirection=Windrichtung
Sunrise=Sonnenaufgang
Sunset=Sonnenuntergang

world=Welt
worldclock=Welt Zeit
Localtime=Ortszeit
Translator=Übersetzer
Stocks=Bestände
PowerPlan=Strom Plan
Select=Wählen
Balanced=Balanced
HighPerf=High performance
PowerSaver=Power saver

Radio=Radio
Playlists=Playlists

Style=Style
Settings=Einstellungen
normalcolorTR=Farbe 1
hovercolorTR=Farbe 2
textcolorTR=Text Farbe
textitemscolorTR=Text Farbe 2
bordercolorTR=Grenze Farbe
borderstyleTR=Grenze Style
aeroglass=Aero Glass
roundedTR=Rundlich
centertext=Center Text
changecolor=Farbe ändern
opacityTR=Opazität
resizepanels=Größe

moreaddons=Mehr Add-ons
donatorpanels=Spender Panels
donateifyoulike=Spenden, wenn sie wollen
Calendar=Kalender
Devices=Geräte
Sound=Sound
ControlPanel=Einstellung.
Radio=Radio
Playlists=Playlisten
ColorConverter=Farbe Konverter
Convert=Konverter
ImageConverter=Bild Konverter
SunClock=Sonnenuhr
Eject=Auswerfen
timelineview=Zeitleiste Ansicht
timeline=Zeitleiste

;;;;dont translate this
Thanks=Danke
Donation=Wir haben viel an Omnimo gearbeitet, wenn Sie Ihre Dankbarkeit zeigen wollen, spenden sie bitte zur Erhaltung der Server-Kosten und für zukünftige Projekte.

off=aus

donothing=Der gewählte Vorgang wird automatisch in 10 Sekunden durchgeführt werden.

Sleep=Stand-by
Logoff=Abmelden
Shutdown=Herunterfahren
Restart=Neustarten
Hibernate=Hibernieren
cancel=Abbrechen
gamesexplorer=Spiele
internestshortcuts=Internet-Paneele
todayis=Heute

clickhereforgallery=Galerie öffnen
changegallerytheme=Change gallery theme

individualpanelcolor=Individuelle Farbe

Addons=Add-ons
Computer=Computer
viewdefaultpanels=view default panels
downloadpanels=download panels
people=Leute
todayis=Heute
internetshortcuts=Internet shortcuts

SetString=Setzen
CloseString=Schließen
WeatherForecast=Wettervorhersage
Lock=Sperren
Headers=Headers
TrayIcons=Tray icons
Fahrenheit=Fahrenheit
24HourTime=24 Stunden Zeit
RSSDecoding=Dekodierung
ArrowStyle=Button-Themen
LayoutThemes=Omnimo Themen
Checkforupdates=Software-Update
Goodmorning=Guten Morgen
Goodafternoon=Guten Tag
Goodevening=Guten Abend
Greetings=Hallo
sunasinstar=Sonne
Pressure=Barometer
Browserballot=Browser wählen
Connected=Verbunden
storage=Speicher
Desktop=Desktop
Finance=Finanzen
Photos=Fotos
Reader=RSS
languagename=Sprache
default=[Zurücksetzen]
Font=Schrift
font1=Schrift 1
font2=Schrift 2
font3=Schrift 3
noupdates=Keine Updates
newupdate=Neues Update!
extras=Extras
Styles=Styles
quickaccess=Sidebar
time=Zeit
weather=Wetter
mail=Post
morepcsettings=PC-Einstellungen
Wifi=Wi-Fi
Mute=Deaktivieren
extrawidth=30
brightness=Helligkeit

Layouts=Anordnungen
Toggle=Wechseln
Advanced=Fortgeschritten
Simple=Einfach
ResizeAllPanels=Größe aller Panels
FontString=Schrift
TogglePanelIcons=Panel-Icons
SidebarColors=Sidebar-Farben
Menu=Menü
High=Hoch
Low=Niedrig
MiddleClickToDelete=Mittlere Maustaste klicken, um zu löschen

CreatePanel=Panel erstellen
ViewPanels=Panelle ansehen
donothing1=Die ausgewählte Aktion wird in
donothing2=Sekunden durchgeführt werden


DominantRSS=http://www.n-tv.de/rss
DominantRSSName=n-tv

viewall=Alle anzeigen
videotutorials=Video-Tutorials
