[Variables]

{Launcher}

;=============================================Tab 1====================================

Tab1=ULTILITIES

Label|App1/Tab1=AoD Folder
Icon|App1/Tab1="501st.png"
Path|App1/Tab1="C:\Users\arbuc\Documents\AoD"

Label|App2/Tab1=Speccy
Icon|App2/Tab1=Speccy
Path|App2/Tab1="C:\Program Files\Speccy\Speccy64.exe"

Label|App3/Tab1=Splashtop
Icon|App3/Tab1=Splashtop
Path|App3/Tab1="C:\Program Files (x86)\Splashtop\Splashtop Remote\Client for STP\clientoobe.exe"

Label|App4/Tab1=TeamViewer
Icon|App4/Tab1=TeamViewer
Path|App4/Tab1="C:\Program Files (x86)\TeamViewer\TeamViewer.exe"

Label|App5/Tab1=Kodi
Icon|App5/Tab1=Kodi
Path|App5/Tab1=C:\Users\%USERNAME%\Desktop\Kodi - Shortcut.lnk

Label|App6/Tab1=SanDisk SSD Dashboard
Icon|App6/Tab1=SD
Path|App6/Tab1="C:\Program Files (x86)\SanDisk\SSD Dashboard\SanDiskSSDDashboard.exe"

Label|App7/Tab1=Excel
Icon|App7/Tab1=Microsoft Excel
Path|App7/Tab1="C:\Program Files (x86)\Microsoft Office\root\Office16\EXCEL.EXE"

Label|App8/Tab1=Powerpoint
Icon|App8/Tab1=Microsoft Office Powerpoint
Path|App8/Tab1="C:\Program Files (x86)\Microsoft Office\root\Office16\POWERPNT.EXE"

Label|App9/Tab1=Outlook
Icon|App9/Tab1=Microsoft Outlook
Path|App9/Tab1="C:\Program Files (x86)\Microsoft Office\root\Office16\OUTLOOK.EXE"

Label|App10/Tab1=Word
Icon|App10/Tab1=Microsoft Word
Path|App10/Tab1="C:\Program Files (x86)\Microsoft Office\root\Office16\WINWORD.EXE"

;=============================================Tab 2====================================

Tab2=Websites

Label|App1/Tab2=Rainmeter
Icon|App1/Tab2=Rainmeter
Path|App1/Tab2="https://docs.rainmeter.net/manual/"

Label|App2/Tab2=
Icon|App2/Tab2=
Path|App2/Tab2=

Label|App3/Tab2=
Icon|App3/Tab2=
Path|App3/Tab2=

Label|App4/Tab2=Office 365
Icon|App4/Tab2=O365
Path|App4/Tab2="https://login.microsoftonline.com/"

Label|App5/Tab2=Skype
Icon|App5/Tab2=skype
Path|App5/Tab2="C:\Program Files (x86)\Microsoft Office\root\Office16\lync.exe"

Label|App6/Tab2=
Icon|App6/Tab2=
Path|App6/Tab2=

Label|App7/Tab2=
Icon|App7/Tab2=
Path|App7/Tab2=

Label|App8/Tab2=
Icon|App8/Tab2=
Path|App8/Tab2=

Label|App9/Tab2=
Icon|App9/Tab2=
Path|App9/Tab2=

Label|App10/Tab2=
Icon|App10/Tab2=
Path|App10/Tab2=

;=============================================Tab 3====================================

Tab3=WINDOWS

Label|App1/Tab3=Command Prompt(Admin)
Icon|App1/Tab3=cmd
Path|App1/Tab3=C:\Windows\System32\cmd.exe

Label|App2/Tab3=Powershell
Icon|App2/Tab3=Powershell
Path|App2/Tab3=C:\Windows\System32\WindowsPowerShell\v1.0\powershell_ise.exe

Label|App3/Tab3=Snipping Tool
Icon|App3/Tab3=Capture
Path|App3/Tab3=%windir%\system32\SnippingTool.exe

Label|App4/Tab3=Character Map
Icon|App4/Tab3=charmap
Path|App4/Tab3=%windir%\system32\charmap.exe

Label|App5/Tab3=
Icon|App5/Tab3=
Path|App5/Tab3=

Label|App6/Tab3=Computer Managament
Icon|App6/Tab3=ComMan
Path|App6/Tab3=%windir%\system32\compmgmt.msc

Label|App7/Tab3=
Icon|App7/Tab3=
Path|App7/Tab3=

Label|App8/Tab3=Remote Desktop Connection
Icon|App8/Tab3=remote
Path|App8/Tab3=%windir%\system32\mstsc.exe

Label|App9/Tab3=Visual Studios
Icon|App9/Tab3=VisualStudios
Path|App9/Tab3="C:\Program Files (x86)\Microsoft Visual Studio\2017\Enterprise\Common7\IDE\devenv.exe"

Label|App10/Tab3=
Icon|App10/Tab3=
Path|App10/Tab3=

;=============================================Tab 4====================================

Tab4=TOOLS

Label|App1/Tab4=RGB Color Codes Chart
Icon|App1/Tab4=RGB
Path|App1/Tab4="http://www.rapidtables.com/web/color/RGB_Color.htm"

Label|App2/Tab4=GIF Maker
Icon|App2/Tab4=gif
Path|App2/Tab4="https://ezgif.com/split"

Label|App3/Tab4=Ratio Calculator
Icon|App3/Tab4=percent
Path|App3/Tab4="https://www.calculatorsoup.com/calculators/math/ratios.php"

Label|App4/Tab4=Text to Speech
Icon|App4/Tab4=TTS
Path|App4/Tab4="http://www.oddcast.com/home/demos/tts/tts_example.php"

Label|App5/Tab4=KeepVid
Icon|App5/Tab4=keepvid
Path|App5/Tab4="http://keepvid.com/"

Label|App6/Tab4=Listen To YouTube
Icon|App6/Tab4=youtubemusic
Path|App6/Tab4="http://www.listentoyoutube.com/"

Label|App7/Tab4=Video Cutter
Icon|App7/Tab4=cutter
Path|App7/Tab4="http://online-video-cutter.com/"

Label|App8/Tab4=GIMP
Icon|App8/Tab4=GIMP
Path|App8/Tab4="C:\Program Files\GIMP 2\bin\gimp-2.8.exe"

Label|App9/Tab4=
Icon|App9/Tab4=
Path|App9/Tab4=

Label|App10/Tab4=
Icon|App10/Tab4=
Path|App10/Tab4=

;=============================================Tab 5====================================

Tab5=INTERNET

Label|App1/Tab5=Google Chrome
Icon|App1/Tab5=Google Chrome
Path|App1/Tab5="C:\Program Files (x86)\Google\Chrome\Application\chrome.exe"

Label|App2/Tab5=Brave
Icon|App2/Tab5=Brave
Path|App2/Tab5="C:\Users\%USERNAME%\AppData\Local\brave\Brave.exe"

Label|App3/Tab5=Internet Explorer
Icon|App3/Tab5=IE
Path|App3/Tab5="C:\Program Files\internet explorer\iexplore.exe"

Label|App4/Tab5=Mircosoft Edge
Icon|App4/Tab5=Edge
Path|App4/Tab5=C:\Users\%USERNAME%\Desktop\Microsoft Edge - Shortcut.lnk

Label|App5/Tab5=Speedtest
Icon|App5/Tab5=Speedtest
Path|App5/Tab5="http://beta.speedtest.net/"

Label|App6/Tab5=
Icon|App6/Tab5=
Path|App6/Tab5=

Label|App7/Tab5=
Icon|App7/Tab5=
Path|App7/Tab5=

Label|App8/Tab5=
Icon|App8/Tab5=
Path|App8/Tab5=

Label|App9/Tab5=
Icon|App9/Tab5=
Path|App9/Tab5=

Label|App10/Tab5=
Icon|App10/Tab5=
Path|App10/Tab5=

;=============================================Tab 6====================================

Tab6=

Label|App1/Tab6=
Icon|App1/Tab6=
Path|App1/Tab6=

Label|App2/Tab6=
Icon|App2/Tab6=
Path|App2/Tab6=

Label|App3/Tab6=
Icon|App3/Tab6=
Path|App3/Tab6=

Label|App4/Tab6=
Icon|App4/Tab6=
Path|App4/Tab6=

Label|App5/Tab6=StarWars.com
Icon|App5/Tab6=StarWars
Path|App5/Tab6="http://www.starwars.com/"

Label|App6/Tab6=Mandalorian Mercs
Icon|App6/Tab6=Mandalorain Mercs
Path|App6/Tab6="http://mandalorianmercs.org/"

Label|App7/Tab6=501st Legion
Icon|App7/Tab6=501st
Path|App7/Tab6="https://www.501st.com/"

Label|App8/Tab6=
Icon|App8/Tab6=
Path|App8/Tab6=

Label|App9/Tab6=
Icon|App9/Tab6=
Path|App9/Tab6=

Label|App10/Tab6=
Icon|App10/Tab6=
Path|App10/Tab6=

Label|App11/Tab6=
Icon|App11/Tab6=
Path|App11/Tab6=

Label|App12/Tab6=
Icon|App12/Tab6=
Path|App12/Tab6=




{ Files }

NameF1="%USERNAME%"
LinkF1="C:\Users\%USERNAME%"
NameF2="Documents"
LinkF2="C:\Users\%USERNAME%\Documents"
NameF3="Pictures"
LinkF3="C:\Users\%USERNAME%\Pictures"
NameF4="Music"
LinkF4="C:\Users\%USERNAME%\Music"
NameF5="Videos"
LinkF5="C:\Users\%USERNAME%\Videos"
NameF6="Downloads"
LinkF6="C:\Users\%USERNAME%\Downloads"
NameF7="Dropbox"
LinkF7="C:\Users\%USERNAME%\Dropbox"
NameF8="Desktop"
LinkF8="C:\Users\%USERNAME%\Desktop"
NameF9="God Mode"
LinkF9="shell:::{ED7BA470-8E54-465E-825C-99712043E01C}"
NameF10="Command Prompt"
LinkF10="C:\Users\%Username%\Desktop\cmd.exe - Shortcut.lnk"
NameF11="Rainmeter"
LinkF11="C:\Users\%USERNAME%\Documents\Rainmeter\Skins"
NameF12="AppData"
LinkF12="C:\Users\%USERNAME%\AppData"
