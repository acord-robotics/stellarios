<Name>Battery</Name><IconPath>#ROOTCONFIGPATH#\Overlay\Widgets\Battery\Icon.png</IconPath><LaunchPath>NXT-OS\Overlay\Widgets\Battery</LaunchPath><Ini>Widget.ini</Ini>
<Name>Clock</Name><IconPath>#ROOTCONFIGPATH#\Overlay\Widgets\Clock\Icon.png</IconPath><LaunchPath>NXT-OS\Overlay\Widgets\Clock</LaunchPath><Ini>Widget.ini</Ini>
<Name>Timer</Name><IconPath>#ROOTCONFIGPATH#\Overlay\Widgets\Timer\Icon.png</IconPath><LaunchPath>NXT-OS\Overlay\Widgets\Timer</LaunchPath><Ini>Widget.ini</Ini>
<Name>Stopwatch</Name><IconPath>#ROOTCONFIGPATH#\Overlay\Widgets\Stopwatch\Icon.png</IconPath><LaunchPath>NXT-OS\Overlay\Widgets\Stopwatch</LaunchPath><Ini>Widget.ini</Ini>
<Name>Calendar</Name><IconPath>#ROOTCONFIGPATH#\Overlay\Widgets\Calendar\Icon.png</IconPath><LaunchPath>NXT-OS\Overlay\Widgets\Calendar</LaunchPath><Ini>Widget.ini</Ini>
<Name>Weather</Name><IconPath>#ROOTCONFIGPATH#\Overlay\Widgets\Weather\Icon.png</IconPath><LaunchPath>NXT-OS\Overlay\Widgets\Weather</LaunchPath><Ini>Widget.ini</Ini>
<Name>Sticky Note</Name><IconPath>#ROOTCONFIGPATH#\Overlay\Widgets\Sticky\Icon.png</IconPath><LaunchPath>NXT-OS\Overlay\Widgets\Sticky</LaunchPath><Ini>Widget.ini</Ini>
<Name>Calculator</Name><IconPath>#ROOTCONFIGPATH#\Overlay\Widgets\Calculator\Icon.png</IconPath><LaunchPath>NXT-OS\Overlay\Widgets\Calculator</LaunchPath><Ini>Widget.ini</Ini>
<Name>Reminders</Name><IconPath>#ROOTCONFIGPATH#\Overlay\Widgets\Reminders\Icon.png</IconPath><LaunchPath>NXT-OS\Overlay\Widgets\Reminders</LaunchPath><Ini>Widget.ini</Ini>
<Name>Media Buttons</Name><IconPath>#ROOTCONFIGPATH#\Overlay\Widgets\MediaKeys\Icon.png</IconPath><LaunchPath>NXT-OS\Overlay\Widgets\MediaKeys</LaunchPath><Ini>Widget.ini</Ini>
<Name>Resource Gauge</Name><IconPath>#ROOTCONFIGPATH#\Overlay\Widgets\ResourceMonitor\Icon.png</IconPath><LaunchPath>NXT-OS\Overlay\Widgets\ResourceMonitor</LaunchPath><Ini>Widget.ini</Ini>
<Name>Network Monitor</Name><IconPath>#ROOTCONFIGPATH#\Overlay\Widgets\NetworkMonitor\Icon.png</IconPath><LaunchPath>NXT-OS\Overlay\Widgets\NetworkMonitor</LaunchPath><Ini>Widget.ini</Ini>
<Name>Switch Sound</Name><IconPath>#ROOTCONFIGPATH#\Overlay\Widgets\SwitchSound\Icon.png</IconPath><LaunchPath>NXT-OS\Overlay\Widgets\SwitchSound</LaunchPath><Ini>Widget.ini</Ini>
<Name>HDD Meter 1</Name><IconPath>#ROOTCONFIGPATH#\Overlay\Widgets\HDD1\Icon.png</IconPath><LaunchPath>NXT-OS\Overlay\Widgets\HDD1</LaunchPath><Ini>Widget.ini</Ini>
<Name>HDD Meter 2</Name><IconPath>#ROOTCONFIGPATH#\Overlay\Widgets\HDD2\Icon.png</IconPath><LaunchPath>NXT-OS\Overlay\Widgets\HDD2</LaunchPath><Ini>Widget.ini</Ini>
<Name>HDD Meter 3</Name><IconPath>#ROOTCONFIGPATH#\Overlay\Widgets\HDD3\Icon.png</IconPath><LaunchPath>NXT-OS\Overlay\Widgets\HDD3</LaunchPath><Ini>Widget.ini</Ini>
<Name>HDD Meter 4</Name><IconPath>#ROOTCONFIGPATH#\Overlay\Widgets\HDD4\Icon.png</IconPath><LaunchPath>NXT-OS\Overlay\Widgets\HDD4</LaunchPath><Ini>Widget.ini</Ini>