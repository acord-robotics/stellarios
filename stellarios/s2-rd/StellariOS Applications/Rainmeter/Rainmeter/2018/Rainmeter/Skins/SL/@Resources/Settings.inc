[Variables]
; The Color of the tab. Default: 73,85,98
Tab.Color=73,85,98
; The color of the background. Default: 108,122,137
Background.Color=108,122,137
; The color of the icons. (Set this too 255,255,255 if your icons have color) Default: 255,255,255
Icon.Color=255,255,255
; The color of the arrow. Default: 255,255,255
Arrow.Color=255,255,255
; The amount of icons to show. Range: 1-15. Default: 3
IconsToShow=4
; Set this to 1 if you want SlideLauncher to close after clicking on an icon otherwise set it to 0. Default: 0
CloseOnLaunch=1

; Icon Section
; Place icons in @Resources\Icons
; The IconName is the name of the iconfile as it appears in the icons folder
; The icon action is the path of the app that you want to launch Ex: C:\Program Files (x86)\Steam\Steam.exe

IconName1=download (1).jpg
IconAction1=C:\Program Files (x86)\Steam\steamapps\common\StarMade\starmade-launcher.exe

IconName2=pic.php.jpg
IconAction2=C:\Program Files (x86)\Steam\steamapps\common\Take On Mars\TKOM.exe

IconName3=spore_logo_by_hakeryk2.jpg
IconAction3=C:\Program Files\iTunes\iTunes.exe

IconName4=Capture.PNG
IconAction4=C:\Program Files (x86)\Steam\steamapps\common\Signs of Life\Signs of Life.exe

IconName5=Blank.png
IconAction5=

IconName5=Blank.png
IconAction5=

IconName6=Blank.png
IconAction6=

IconName7=Blank.png
IconAction7=

IconName8=Blank.png
IconAction8=

IconName9=Blank.png
IconAction9=

IconName10=Blank.png
IconAction10=

IconName11=Blank.png
IconAction11=

IconName12=Blank.png
IconAction12=

IconName13=Blank.png
IconAction13=

IconName14=Blank.png
IconAction14=

IconName15=Blank.png
IconAction15=