[Variables]

;----------[CLOCK SETTINGS]----------

;display settings

ClockFont=Nexa Light
ClockSize=72
ClockColor=240,241,235

;Seconds display settings

SecondsFont=AR BLANCA
SecondsSize=120
SecondsColor=35,36,90,150

;Hide or change the colors of the top and bottom bars

TopBarColor=35,36,90
HideTopBar=0
BottomBarColor=28,29,34
HideBottomBar=1

;For 12h clocks : the position of the "AM/PM" string, 0=left, 1=center, 2=right (default=0)
AMPMPos=2

;----------[CALENDAR SETTINGS]----------

;weekday display settings

WeekFont=AR BLANCA
WeekFontSize=64
WeekFontColor=35,36,90

;day&month display settings

DayFont=Nexa Light
DayFontSize=24
DayFontColor=240,241,235

;This one defines how low you want the date and month to be proportionately to the size of the weekday (default=1.15)
;example : if WeekFontSize=64 and DayHeight=1.15, the day&month are gonna be 64*1.15=74 pixels down
DayHeight=1.08