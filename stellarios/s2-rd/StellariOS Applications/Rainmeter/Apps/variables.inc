[Variables]

ImagesPath=#SKINSPATH#Apps\Images

font=Arial

BGApps=C:\Users\arbuc\Documents\AoD\OD\OneDrive\Desktop\Pictures\Captureol.PNG

Hidden=1
Hidden2=1
Hidden3=1
;Hidden4=1
;Hidden5=1
;Hidden6=1


App1Icon=C:\Users\arbuc\Downloads\013aeeded97316f9710488bdfa7d5d4148864a90a7-765x1024.jpg
App1Path=C:\Program Files (x86)\Google\Chrome\Application\chrome.exe


App2Icon=C:\Users\arbuc\Downloads\index.jpg
App2Path=


App3Icon=C:\Users\arbuc\Videos\DQmRKmPYvN8Ltkfzfg7KYP1DyKafGbxGn5ekubhWgS2tDox.jpg
App3Path=

App4Icon=C:\Users\arbuc\Documents\AoD\Misc\New folder\Peepso is back!.PNG
App4Path=


App5Icon=C:\Users\arbuc\OneDrive\Documents\Rainmeter\Skins\BMO\@Resources\Images\BMO.png
App5Path=


App6Icon=C:\Users\arbuc\Downloads\thJ29I7XGK.jpg
App6Path=


App7Icon=C:\Users\arbuc\Downloads\square_portal_by_mrdeanage-d52uwga.jpg
App7Path=


App8Icon=C:\Users\arbuc\Documents\AoD\OD\OneDrive\Desktop\Desktop\observation_deck___wallpaper_by_z_design-d2q7jic.jpg
App8Path=


App9Icon=C:\Users\arbuc\Downloads\cropped-Alliance-of-droids-logo-200x200.bmp
App9Path=C:\Program Files (x86)\Google\Chrome\Application\chrome.exe


App10Icon=C:\Users\arbuc\Downloads\16179738_352502265136833_2924495466891691359_o.jpg
App10Path=


App11Icon=C:\Users\arbuc\Videos\au-galaxy-tab-s3-sm-t825-sm-t825yzkaxsa-frontblack-68131175.jpg
App11Path=


App12Icon=C:\Users\arbuc\Videos\base-pdp-refresh.png
App12Path=


App13Icon=C:\Users\arbuc\OneDrive\Documents\Rainmeter\Skins\Apps\Images\add1.png
App13Path=

App14Icon=C:\Users\arbuc\Documents\AoD\Misc\Icons\walle10.gif
App14Path=


App15Icon=C:\Users\arbuc\OneDrive\Documents\Rainmeter\Skins\Apps\Images\downloads.png
App15Path=


App16Icon=C:\Users\arbuc\Documents\AoD\Misc\Icons\images.jpglol.jpg
App16Path=


App17Icon=C:\Users\arbuc\Documents\AoD\Misc\Icons\c3po-clipart-9.jpg
App17Path=


App18Icon=C:\Users\arbuc\Documents\AoD\Misc\Icons\images.jpgjjh.jpg
App18Path=

App19Icon=C:\Users\arbuc\Documents\AoD\OD\OneDrive\Desktop\Desktop\Archives\r2_d2_by_drboxhead-da0egwz.jpg
App19Path=

App20Icon=C:\Users\arbuc\OneDrive\Documents\Rainmeter\Skins\Apps\Images\pc.png
App20Path=

App21Icon=C:\Users\arbuc\Documents\AoD\Misc\964e53bcfc655eb0205ffdd6f3fb99dcBETA.jpg
App21Path=

App22Icon=C:\Users\arbuc\Documents\AoD\Blog\Posts\Portal & SP\Documentation\Hyperspace City\index.jpg
App22Path=

App23Icon=C:\Users\arbuc\OneDrive\Documents\Rainmeter\Skins\Apps\Images\Round Corners\documents.png
App23Path=

App24Icon=C:\Users\arbuc\Documents\AoD\Misc\Dj\New Logo.png
App24Path=

App25Icon=C:\Users\arbuc\Documents\AoD\Misc\Icons\images.jpgjgtee.jpg
App25Path=

App26Icon=C:\Users\arbuc\Documents\AoD\Misc\Icons\r2d2-clipart-free-6.jpg
App26Path=

App27Icon=C:\Users\arbuc\Documents\AoD\Misc\Icons\r2d2-clipart-4.png
App27Path=

App28Icon=C:\Users\arbuc\Documents\AoD\Misc\Icons\image_r2d2-baby-helmet-design_3.jpg
App28Path=

App29Icon=C:\Users\arbuc\Documents\AoD\Misc\Icons\images.jpggfs.jpg
App29Path=

App30Icon=C:\Users\arbuc\Documents\AoD\Misc\61b2a150de8aad58c65292a629512b4b.jpg
App30Path=

App31Icon=C:\Users\arbuc\Documents\AoD\Misc\Icons\databank_r3s6_01_169_9e67ecfc.jpeg
App31Path=

App32Icon=C:\Users\arbuc\Documents\AoD\Misc\Icons\star-wars-r2d2-gold-jewelry.jpg
App32Path=

App33Icon=C:\Users\arbuc\Documents\AoD\Misc\Icons\66896e6edd22320c34ec744b6a9bca4f--culture-pop-star-wars-droids.jpg
App33Path=

App34Icon=C:\Users\arbuc\Documents\AoD\Misc\Icons\index.jpg
App34Path=

App35Icon=C:\Users\arbuc\Documents\AoD\Misc\Icons\images.jpg
App35Path=

App36Icon=C:\Users\arbuc\Documents\AoD\Misc\Icons\images.jpgj.jpg
App36Path=

App37Icon=C:\Users\arbuc\Documents\AoD\Misc\Icons\n172.gif
App37Path=

App38Icon=C:\Users\arbuc\Documents\AoD\Misc\Icons\walle1.gif
App38Path=

App39Icon=C:\Users\arbuc\Documents\AoD\Misc\Icons\34e87c0b7daf9e4fc5f57fcf9bd36e00.jpg
App39Path=

App40Icon=C:\Users\arbuc\Documents\AoD\Misc\Icons\466a75497a50235d501f32867f4accd1--doctor-who-tardis-the-doctor.jpg
App40Path=

App41Icon=C:\Users\arbuc\Documents\AoD\Misc\Icons\doctor-who-cyberman-clipart-1.jpg
App41Path=

App42Icon=C:\Users\arbuc\Documents\AoD\Misc\Icons\R3S6-SWE.png
App42Path=

App43Icon=C:\Users\arbuc\Downloads\Icons\r2d2-512.png
App43Path=

App44Icon=C:\Users\arbuc\Downloads\Icons\014_-_death_star-512.png
App44Path=

App45Icon=C:\Users\arbuc\Downloads\Icons\stickers-muraux-enfants-bebes-r2d2.jpg
App45Path=

App46Icon=C:\Users\arbuc\Downloads\Icons\951210_1.jpg
App46Path=

App47Icon=C:\Users\arbuc\Downloads\Icons\4e2d58cb448584f81c2f0f5a52c6b010.jpg
App47Path=

App48Icon=C:\Users\arbuc\Downloads\Icons\427bcd31068551.564006b30d466.gif
App48Path=

App49Icon=C:\Users\arbuc\Downloads\Icons\images.png
App49Path=

App50Icon=C:\Users\arbuc\Downloads\Icons\images.jpg
App50Path=

App51Icon=C:\Users\arbuc\Downloads\Icons\images (1).jpg
App51Path=

App52Icon=C:\Users\arbuc\Downloads\Icons\images (1).png
App52Path=

App53Icon=C:\Users\arbuc\Downloads\Icons\images (2).png
App53Path=

App54Icon=C:\Users\arbuc\Downloads\Icons\images (3).png
App54Path=

App55Icon=C:\Users\arbuc\Downloads\Icons\R2D2StarWarsScrapbookingPaper.jpg
App55Path=

App56Icon=C:\Users\arbuc\Downloads\Icons\images (5).png
App56Path=

App57Icon=C:\Users\arbuc\Downloads\Icons\images (4).png
App57Path=

App58Icon=C:\Users\arbuc\Downloads\Icons\background-iphone-pastel-colors-star-wars-Favim.com-3942828.png
App58Path=

App59Icon=C:\Users\arbuc\Downloads\Icons\blocks-clipart-lego-star-wars-10.jpg
App59Path=

App60Icon=C:\Users\arbuc\Documents\AoD\Misc\Icons\doctor-who-cyberman-clipart-1.jpg
App60Path=

MouseScrollUpAction=[!CommandMeasure MeasurePath "IndexUp"][!Update]
MouseScrollDownAction=[!CommandMeasure MeasurePath "IndexDown"][!Update]

