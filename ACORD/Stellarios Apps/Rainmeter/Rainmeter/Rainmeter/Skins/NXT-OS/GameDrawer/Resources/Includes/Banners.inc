[TileAnimation]
Measure=Plugin
Plugin=ActionTimer
ActionList1=Zoom0_I_0|Zoom0_I_1|Wait 20|Zoom0_I_2|Wait 20|Zoom0_I_3
ActionList2=Zoom0_O_0|Zoom0_O_1|Wait 20|Zoom0_O_2|Wait 20|Zoom0_O_3
Zoom0_I_0=[!CommandMeasure TileAnimation "Stop 2"]
Zoom0_I_1=[!SetOption "Game0" "W" "294"][!SetOption "Game0" "H" "138"][!SetOption "Game0" "Padding" "4,2,4,2"][!UpdateMeter "Game0"][!Redraw]
Zoom0_I_2=[!SetOption "Game0" "W" "298"][!SetOption "Game0" "H" "140"][!SetOption "Game0" "Padding" "2,1,2,1"][!UpdateMeter "Game0"][!Redraw]
Zoom0_I_3=[!SetOption "Game0" "W" "302"][!SetOption "Game0" "H" "144"][!SetOption "Game0" "Padding" "0,0,0,0"][!UpdateMeter "Game0"][!Redraw]
Zoom0_O_0=[!CommandMeasure TileAnimation "Stop 1"]
Zoom0_O_1=[!SetOption "Game0" "W" "298"][!SetOption "Game0" "H" "140"][!SetOption "Game0" "Padding" "2,1,2,1"][!UpdateMeter "Game0"][!Redraw]
Zoom0_O_2=[!SetOption "Game0" "W" "294"][!SetOption "Game0" "H" "138"][!SetOption "Game0" "Padding" "4,2,4,2"][!UpdateMeter "Game0"][!Redraw]
Zoom0_O_3=[!SetOption "Game0" "W" "290"][!SetOption "Game0" "H" "136"][!SetOption "Game0" "Padding" "6,3,6,3"][!UpdateMeter "Game0"][!Redraw]

ActionList3=Zoom1_I_0|Zoom1_I_1|Wait 20|Zoom1_I_2|Wait 20|Zoom1_I_3
ActionList4=Zoom1_O_0|Zoom1_O_1|Wait 20|Zoom1_O_2|Wait 20|Zoom1_O_3
Zoom1_I_0=[!CommandMeasure TileAnimation "Stop 4"]
Zoom1_I_1=[!SetOption "Game1" "W" "294"][!SetOption "Game1" "H" "138"][!SetOption "Game1" "Padding" "4,2,4,2"][!UpdateMeter "Game1"][!Redraw]
Zoom1_I_2=[!SetOption "Game1" "W" "298"][!SetOption "Game1" "H" "140"][!SetOption "Game1" "Padding" "2,1,2,1"][!UpdateMeter "Game1"][!Redraw]
Zoom1_I_3=[!SetOption "Game1" "W" "302"][!SetOption "Game1" "H" "144"][!SetOption "Game1" "Padding" "0,0,0,0"][!UpdateMeter "Game1"][!Redraw]
Zoom1_O_0=[!CommandMeasure TileAnimation "Stop 3"]
Zoom1_O_1=[!SetOption "Game1" "W" "298"][!SetOption "Game1" "H" "140"][!SetOption "Game1" "Padding" "2,1,2,1"][!UpdateMeter "Game1"][!Redraw]
Zoom1_O_2=[!SetOption "Game1" "W" "294"][!SetOption "Game1" "H" "138"][!SetOption "Game1" "Padding" "4,2,4,2"][!UpdateMeter "Game1"][!Redraw]
Zoom1_O_3=[!SetOption "Game1" "W" "290"][!SetOption "Game1" "H" "136"][!SetOption "Game1" "Padding" "6,3,6,3"][!UpdateMeter "Game1"][!Redraw]

ActionList5=Zoom2_I_0|Zoom2_I_1|Wait 20|Zoom2_I_2|Wait 20|Zoom2_I_3
ActionList6=Zoom2_O_0|Zoom2_O_1|Wait 20|Zoom2_O_2|Wait 20|Zoom2_O_3
Zoom2_I_0=[!CommandMeasure TileAnimation "Stop 6"]
Zoom2_I_1=[!SetOption "Game2" "W" "294"][!SetOption "Game2" "H" "138"][!SetOption "Game2" "Padding" "4,2,4,2"][!UpdateMeter "Game2"][!Redraw]
Zoom2_I_2=[!SetOption "Game2" "W" "298"][!SetOption "Game2" "H" "140"][!SetOption "Game2" "Padding" "2,1,2,1"][!UpdateMeter "Game2"][!Redraw]
Zoom2_I_3=[!SetOption "Game2" "W" "302"][!SetOption "Game2" "H" "144"][!SetOption "Game2" "Padding" "0,0,0,0"][!UpdateMeter "Game2"][!Redraw]
Zoom2_O_0=[!CommandMeasure TileAnimation "Stop 5"]
Zoom2_O_1=[!SetOption "Game2" "W" "298"][!SetOption "Game2" "H" "140"][!SetOption "Game2" "Padding" "2,1,2,1"][!UpdateMeter "Game2"][!Redraw]
Zoom2_O_2=[!SetOption "Game2" "W" "294"][!SetOption "Game2" "H" "138"][!SetOption "Game2" "Padding" "4,2,4,2"][!UpdateMeter "Game2"][!Redraw]
Zoom2_O_3=[!SetOption "Game2" "W" "290"][!SetOption "Game2" "H" "136"][!SetOption "Game2" "Padding" "6,3,6,3"][!UpdateMeter "Game2"][!Redraw]

ActionList7=Zoom3_I_0|Zoom3_I_1|Wait 20|Zoom3_I_2|Wait 20|Zoom3_I_3
ActionList8=Zoom3_O_0|Zoom3_O_1|Wait 20|Zoom3_O_2|Wait 20|Zoom3_O_3
Zoom3_I_0=[!CommandMeasure TileAnimation "Stop 8"]
Zoom3_I_1=[!SetOption "Game3" "W" "294"][!SetOption "Game3" "H" "138"][!SetOption "Game3" "Padding" "4,2,4,2"][!UpdateMeter "Game3"][!Redraw]
Zoom3_I_2=[!SetOption "Game3" "W" "298"][!SetOption "Game3" "H" "140"][!SetOption "Game3" "Padding" "2,1,2,1"][!UpdateMeter "Game3"][!Redraw]
Zoom3_I_3=[!SetOption "Game3" "W" "302"][!SetOption "Game3" "H" "144"][!SetOption "Game3" "Padding" "0,0,0,0"][!UpdateMeter "Game3"][!Redraw]
Zoom3_O_0=[!CommandMeasure TileAnimation "Stop 7"]
Zoom3_O_1=[!SetOption "Game3" "W" "298"][!SetOption "Game3" "H" "140"][!SetOption "Game3" "Padding" "2,1,2,1"][!UpdateMeter "Game3"][!Redraw]
Zoom3_O_2=[!SetOption "Game3" "W" "294"][!SetOption "Game3" "H" "138"][!SetOption "Game3" "Padding" "4,2,4,2"][!UpdateMeter "Game3"][!Redraw]
Zoom3_O_3=[!SetOption "Game3" "W" "290"][!SetOption "Game3" "H" "136"][!SetOption "Game3" "Padding" "6,3,6,3"][!UpdateMeter "Game3"][!Redraw]

ActionList9=Zoom4_I_0|Zoom4_I_1|Wait 20|Zoom4_I_2|Wait 20|Zoom4_I_3
ActionList10=Zoom4_O_0|Zoom4_O_1|Wait 20|Zoom4_O_2|Wait 20|Zoom4_O_3
Zoom4_I_0=[!CommandMeasure TileAnimation "Stop 10"]
Zoom4_I_1=[!SetOption "Game4" "W" "294"][!SetOption "Game4" "H" "138"][!SetOption "Game4" "Padding" "4,2,4,2"][!UpdateMeter "Game4"][!Redraw]
Zoom4_I_2=[!SetOption "Game4" "W" "298"][!SetOption "Game4" "H" "140"][!SetOption "Game4" "Padding" "2,1,2,1"][!UpdateMeter "Game4"][!Redraw]
Zoom4_I_3=[!SetOption "Game4" "W" "302"][!SetOption "Game4" "H" "144"][!SetOption "Game4" "Padding" "0,0,0,0"][!UpdateMeter "Game4"][!Redraw]
Zoom4_O_0=[!CommandMeasure TileAnimation "Stop 9"]
Zoom4_O_1=[!SetOption "Game4" "W" "298"][!SetOption "Game4" "H" "140"][!SetOption "Game4" "Padding" "2,1,2,1"][!UpdateMeter "Game4"][!Redraw]
Zoom4_O_2=[!SetOption "Game4" "W" "294"][!SetOption "Game4" "H" "138"][!SetOption "Game4" "Padding" "4,2,4,2"][!UpdateMeter "Game4"][!Redraw]
Zoom4_O_3=[!SetOption "Game4" "W" "290"][!SetOption "Game4" "H" "136"][!SetOption "Game4" "Padding" "6,3,6,3"][!UpdateMeter "Game4"][!Redraw]

ActionList11=Zoom5_I_0|Zoom5_I_1|Wait 20|Zoom5_I_2|Wait 20|Zoom5_I_3
ActionList12=Zoom5_O_0|Zoom5_O_1|Wait 20|Zoom5_O_2|Wait 20|Zoom5_O_3
Zoom5_I_0=[!CommandMeasure TileAnimation "Stop 12"]
Zoom5_I_1=[!SetOption "Game5" "W" "294"][!SetOption "Game5" "H" "138"][!SetOption "Game5" "Padding" "4,2,4,2"][!UpdateMeter "Game5"][!Redraw]
Zoom5_I_2=[!SetOption "Game5" "W" "298"][!SetOption "Game5" "H" "140"][!SetOption "Game5" "Padding" "2,1,2,1"][!UpdateMeter "Game5"][!Redraw]
Zoom5_I_3=[!SetOption "Game5" "W" "302"][!SetOption "Game5" "H" "144"][!SetOption "Game5" "Padding" "0,0,0,0"][!UpdateMeter "Game5"][!Redraw]
Zoom5_O_0=[!CommandMeasure TileAnimation "Stop 11"]
Zoom5_O_1=[!SetOption "Game5" "W" "298"][!SetOption "Game5" "H" "140"][!SetOption "Game5" "Padding" "2,1,2,1"][!UpdateMeter "Game5"][!Redraw]
Zoom5_O_2=[!SetOption "Game5" "W" "294"][!SetOption "Game5" "H" "138"][!SetOption "Game5" "Padding" "4,2,4,2"][!UpdateMeter "Game5"][!Redraw]
Zoom5_O_3=[!SetOption "Game5" "W" "290"][!SetOption "Game5" "H" "136"][!SetOption "Game5" "Padding" "6,3,6,3"][!UpdateMeter "Game5"][!Redraw]

ActionList13=Zoom6_I_0|Zoom6_I_1|Wait 20|Zoom6_I_2|Wait 20|Zoom6_I_3
ActionList14=Zoom6_O_0|Zoom6_O_1|Wait 20|Zoom6_O_2|Wait 20|Zoom6_O_3
Zoom6_I_0=[!CommandMeasure TileAnimation "Stop 14"]
Zoom6_I_1=[!SetOption "Game6" "W" "294"][!SetOption "Game6" "H" "138"][!SetOption "Game6" "Padding" "4,2,4,2"][!UpdateMeter "Game6"][!Redraw]
Zoom6_I_2=[!SetOption "Game6" "W" "298"][!SetOption "Game6" "H" "140"][!SetOption "Game6" "Padding" "2,1,2,1"][!UpdateMeter "Game6"][!Redraw]
Zoom6_I_3=[!SetOption "Game6" "W" "302"][!SetOption "Game6" "H" "144"][!SetOption "Game6" "Padding" "0,0,0,0"][!UpdateMeter "Game6"][!Redraw]
Zoom6_O_0=[!CommandMeasure TileAnimation "Stop 13"]
Zoom6_O_1=[!SetOption "Game6" "W" "298"][!SetOption "Game6" "H" "140"][!SetOption "Game6" "Padding" "2,1,2,1"][!UpdateMeter "Game6"][!Redraw]
Zoom6_O_2=[!SetOption "Game6" "W" "294"][!SetOption "Game6" "H" "138"][!SetOption "Game6" "Padding" "4,2,4,2"][!UpdateMeter "Game6"][!Redraw]
Zoom6_O_3=[!SetOption "Game6" "W" "290"][!SetOption "Game6" "H" "136"][!SetOption "Game6" "Padding" "6,3,6,3"][!UpdateMeter "Game6"][!Redraw]

ActionList15=Zoom7_I_0|Zoom7_I_1|Wait 20|Zoom7_I_2|Wait 20|Zoom7_I_3
ActionList16=Zoom7_O_0|Zoom7_O_1|Wait 20|Zoom7_O_2|Wait 20|Zoom7_O_3
Zoom7_I_0=[!CommandMeasure TileAnimation "Stop 16"]
Zoom7_I_1=[!SetOption "Game7" "W" "294"][!SetOption "Game7" "H" "138"][!SetOption "Game7" "Padding" "4,2,4,2"][!UpdateMeter "Game7"][!Redraw]
Zoom7_I_2=[!SetOption "Game7" "W" "298"][!SetOption "Game7" "H" "140"][!SetOption "Game7" "Padding" "2,1,2,1"][!UpdateMeter "Game7"][!Redraw]
Zoom7_I_3=[!SetOption "Game7" "W" "302"][!SetOption "Game7" "H" "144"][!SetOption "Game7" "Padding" "0,0,0,0"][!UpdateMeter "Game7"][!Redraw]
Zoom7_O_0=[!CommandMeasure TileAnimation "Stop 15"]
Zoom7_O_1=[!SetOption "Game7" "W" "298"][!SetOption "Game7" "H" "140"][!SetOption "Game7" "Padding" "2,1,2,1"][!UpdateMeter "Game7"][!Redraw]
Zoom7_O_2=[!SetOption "Game7" "W" "294"][!SetOption "Game7" "H" "138"][!SetOption "Game7" "Padding" "4,2,4,2"][!UpdateMeter "Game7"][!Redraw]
Zoom7_O_3=[!SetOption "Game7" "W" "290"][!SetOption "Game7" "H" "136"][!SetOption "Game7" "Padding" "6,3,6,3"][!UpdateMeter "Game7"][!Redraw]

ActionList17=Zoom8_I_0|Zoom8_I_1|Wait 20|Zoom8_I_2|Wait 20|Zoom8_I_3
ActionList18=Zoom8_O_0|Zoom8_O_1|Wait 20|Zoom8_O_2|Wait 20|Zoom8_O_3
Zoom8_I_0=[!CommandMeasure TileAnimation "Stop 18"]
Zoom8_I_1=[!SetOption "Game8" "W" "294"][!SetOption "Game8" "H" "138"][!SetOption "Game8" "Padding" "4,2,4,2"][!UpdateMeter "Game8"][!Redraw]
Zoom8_I_2=[!SetOption "Game8" "W" "298"][!SetOption "Game8" "H" "140"][!SetOption "Game8" "Padding" "2,1,2,1"][!UpdateMeter "Game8"][!Redraw]
Zoom8_I_3=[!SetOption "Game8" "W" "302"][!SetOption "Game8" "H" "144"][!SetOption "Game8" "Padding" "0,0,0,0"][!UpdateMeter "Game8"][!Redraw]
Zoom8_O_0=[!CommandMeasure TileAnimation "Stop 17"]
Zoom8_O_1=[!SetOption "Game8" "W" "298"][!SetOption "Game8" "H" "140"][!SetOption "Game8" "Padding" "2,1,2,1"][!UpdateMeter "Game8"][!Redraw]
Zoom8_O_2=[!SetOption "Game8" "W" "294"][!SetOption "Game8" "H" "138"][!SetOption "Game8" "Padding" "4,2,4,2"][!UpdateMeter "Game8"][!Redraw]
Zoom8_O_3=[!SetOption "Game8" "W" "290"][!SetOption "Game8" "H" "136"][!SetOption "Game8" "Padding" "6,3,6,3"][!UpdateMeter "Game8"][!Redraw]

[Game1B]
Meter=Image
MeterStyle=GameBackStyle
[Game1T]
Meter=String
MeterStyle=GameTextStyle
[Game1C]
Meter=String
MeterStyle=GameCloseButtonStyle
[Game1]
Meter=Image
MeterStyle=GameBannerStyle

[Game2B]
Meter=Image
MeterStyle=GameBackStyle
[Game2T]
Meter=String
MeterStyle=GameTextStyle
[Game2C]
Meter=String
MeterStyle=GameCloseButtonStyle
[Game2]
Meter=Image
MeterStyle=GameBannerStyle

[Game3B]
Meter=Image
MeterStyle=GameBackStyle
[Game3T]
Meter=String
MeterStyle=GameTextStyle
[Game3C]
Meter=String
MeterStyle=GameCloseButtonStyle
[Game3]
Meter=Image
MeterStyle=GameBannerStyle

[Game4B]
Meter=Image
MeterStyle=GameBackStyle
[Game4T]
Meter=String
MeterStyle=GameTextStyle
[Game4C]
Meter=String
MeterStyle=GameCloseButtonStyle
[Game4]
Meter=Image
MeterStyle=GameBannerStyle

[Game5B]
Meter=Image
MeterStyle=GameBackStyle
[Game5T]
Meter=String
MeterStyle=GameTextStyle
[Game5C]
Meter=String
MeterStyle=GameCloseButtonStyle
[Game5]
Meter=Image
MeterStyle=GameBannerStyle

[Game6B]
Meter=Image
MeterStyle=GameBackStyle
[Game6T]
Meter=String
MeterStyle=GameTextStyle
[Game6C]
Meter=String
MeterStyle=GameCloseButtonStyle
[Game6]
Meter=Image
MeterStyle=GameBannerStyle

[Game7B]
Meter=Image
MeterStyle=GameBackStyle
[Game7T]
Meter=String
MeterStyle=GameTextStyle
[Game7C]
Meter=String
MeterStyle=GameCloseButtonStyle
[Game7]
Meter=Image
MeterStyle=GameBannerStyle

[Game8B]
Meter=Image
MeterStyle=GameBackStyle
[Game8T]
Meter=String
MeterStyle=GameTextStyle
[Game8C]
Meter=String
MeterStyle=GameCloseButtonStyle
[Game8]
Meter=Image
MeterStyle=GameBannerStyle
