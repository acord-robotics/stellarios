; auto-generated by sFactoryBars
[0]
Meter=Roundline
MeterStyle=styleLine
StartAngle=10.995574287564
X=227
Y=80
LineLength=((([mBand0]+((1-0)=0?0:[mBand1]+[mBand79]))/3=0)?-1:((([mBand0]+((1-0)=0?0:[mBand1]+[mBand79]))/3-[mBand0])*1+[mBand0])*80+0)
DynamicVariables=1
[1]
Meter=Roundline
MeterStyle=styleLine
StartAngle=10.917034471225
X=215.46651292801
Y=80.45315194123
LineLength=((([mBand1]+((1-0)=0?0:[mBand2]+[mBand0]))/3=0)?-1:((([mBand1]+((1-0)=0?0:[mBand2]+[mBand0]))/3-[mBand1])*1+[mBand1])*80+0)
DynamicVariables=1
[2]
Meter=Roundline
MeterStyle=styleLine
StartAngle=10.838494654885
X=204.00413363909
Y=81.809813932515
LineLength=((([mBand2]+((1-0)=0?0:[mBand3]+[mBand1]))/3=0)?-1:((([mBand2]+((1-0)=0?0:[mBand3]+[mBand1]))/3-[mBand2])*1+[mBand2])*80+0)
DynamicVariables=1
[3]
Meter=Roundline
MeterStyle=styleLine
StartAngle=10.759954838545
X=192.68353151318
Y=84.061621701542
LineLength=((([mBand3]+((1-0)=0?0:[mBand4]+[mBand2]))/3=0)?-1:((([mBand3]+((1-0)=0?0:[mBand4]+[mBand2]))/3-[mBand3])*1+[mBand3])*80+0)
DynamicVariables=1
[4]
Meter=Roundline
MeterStyle=styleLine
StartAngle=10.681415022205
X=181.57450182688
Y=87.194692104612
LineLength=((([mBand4]+((1-0)=0?0:[mBand5]+[mBand3]))/3=0)?-1:((([mBand4]+((1-0)=0?0:[mBand5]+[mBand3]))/3-[mBand4])*1+[mBand4])*80+0)
DynamicVariables=1
[5]
Meter=Roundline
MeterStyle=styleLine
StartAngle=10.602875205866
X=170.74553544233
Y=91.189708720841
LineLength=((([mBand5]+((1-0)=0?0:[mBand6]+[mBand4]))/3=0)?-1:((([mBand5]+((1-0)=0?0:[mBand6]+[mBand4]))/3-[mBand5])*1+[mBand5])*80+0)
DynamicVariables=1
[6]
Meter=Roundline
MeterStyle=styleLine
StartAngle=10.524335389526
X=160.26339653829
Y=96.02204094431
LineLength=((([mBand6]+((1-0)=0?0:[mBand7]+[mBand5]))/3=0)?-1:((([mBand6]+((1-0)=0?0:[mBand7]+[mBand5]))/3-[mBand6])*1+[mBand6])*80+0)
DynamicVariables=1
[7]
Meter=Roundline
MeterStyle=styleLine
StartAngle=10.445795573186
X=150.19271098676
Y=101.66189583995
LineLength=((([mBand7]+((1-0)=0?0:[mBand8]+[mBand6]))/3=0)?-1:((([mBand7]+((1-0)=0?0:[mBand8]+[mBand6]))/3-[mBand7])*1+[mBand7])*80+0)
DynamicVariables=1
[8]
Meter=Roundline
MeterStyle=styleLine
StartAngle=10.367255756846
X=140.59556791301
Y=108.07450182688
LineLength=((([mBand8]+((1-0)=0?0:[mBand9]+[mBand7]))/3=0)?-1:((([mBand8]+((1-0)=0?0:[mBand9]+[mBand7]))/3-[mBand8])*1+[mBand8])*80+0)
DynamicVariables=1
[9]
Meter=Roundline
MeterStyle=styleLine
StartAngle=10.288715940507
X=131.53113689546
Y=115.2203230568
LineLength=((([mBand9]+((1-0)=0?0:[mBand10]+[mBand8]))/3=0)?-1:((([mBand9]+((1-0)=0?0:[mBand10]+[mBand8]))/3-[mBand9])*1+[mBand9])*80+0)
DynamicVariables=1
[10]
Meter=Roundline
MeterStyle=styleLine
StartAngle=10.210176124167
X=123.05530316558
Y=123.05530316558
LineLength=((([mBand10]+((1-0)=0?0:[mBand11]+[mBand9]))/3=0)?-1:((([mBand10]+((1-0)=0?0:[mBand11]+[mBand9]))/3-[mBand10])*1+[mBand10])*80+0)
DynamicVariables=1
[11]
Meter=Roundline
MeterStyle=styleLine
StartAngle=10.131636307827
X=115.2203230568
Y=131.53113689546
LineLength=((([mBand11]+((1-0)=0?0:[mBand12]+[mBand10]))/3=0)?-1:((([mBand11]+((1-0)=0?0:[mBand12]+[mBand10]))/3-[mBand11])*1+[mBand11])*80+0)
DynamicVariables=1
[12]
Meter=Roundline
MeterStyle=styleLine
StartAngle=10.053096491487
X=108.07450182688
Y=140.59556791301
LineLength=((([mBand12]+((1-0)=0?0:[mBand13]+[mBand11]))/3=0)?-1:((([mBand12]+((1-0)=0?0:[mBand13]+[mBand11]))/3-[mBand12])*1+[mBand12])*80+0)
DynamicVariables=1
[13]
Meter=Roundline
MeterStyle=styleLine
StartAngle=9.9745566751476
X=101.66189583995
Y=150.19271098676
LineLength=((([mBand13]+((1-0)=0?0:[mBand14]+[mBand12]))/3=0)?-1:((([mBand13]+((1-0)=0?0:[mBand14]+[mBand12]))/3-[mBand13])*1+[mBand13])*80+0)
DynamicVariables=1
[14]
Meter=Roundline
MeterStyle=styleLine
StartAngle=9.8960168588078
X=96.02204094431
Y=160.26339653829
LineLength=((([mBand14]+((1-0)=0?0:[mBand15]+[mBand13]))/3=0)?-1:((([mBand14]+((1-0)=0?0:[mBand15]+[mBand13]))/3-[mBand14])*1+[mBand14])*80+0)
DynamicVariables=1
[15]
Meter=Roundline
MeterStyle=styleLine
StartAngle=9.8174770424681
X=91.189708720841
Y=170.74553544233
LineLength=((([mBand15]+((1-0)=0?0:[mBand16]+[mBand14]))/3=0)?-1:((([mBand15]+((1-0)=0?0:[mBand16]+[mBand14]))/3-[mBand15])*1+[mBand15])*80+0)
DynamicVariables=1
[16]
Meter=Roundline
MeterStyle=styleLine
StartAngle=9.7389372261284
X=87.194692104612
Y=181.57450182688
LineLength=((([mBand16]+((1-0)=0?0:[mBand17]+[mBand15]))/3=0)?-1:((([mBand16]+((1-0)=0?0:[mBand17]+[mBand15]))/3-[mBand16])*1+[mBand16])*80+0)
DynamicVariables=1
[17]
Meter=Roundline
MeterStyle=styleLine
StartAngle=9.6603974097886
X=84.061621701542
Y=192.68353151318
LineLength=((([mBand17]+((1-0)=0?0:[mBand18]+[mBand16]))/3=0)?-1:((([mBand17]+((1-0)=0?0:[mBand18]+[mBand16]))/3-[mBand17])*1+[mBand17])*80+0)
DynamicVariables=1
[18]
Meter=Roundline
MeterStyle=styleLine
StartAngle=9.5818575934489
X=81.809813932515
Y=204.00413363909
LineLength=((([mBand18]+((1-0)=0?0:[mBand19]+[mBand17]))/3=0)?-1:((([mBand18]+((1-0)=0?0:[mBand19]+[mBand17]))/3-[mBand18])*1+[mBand18])*80+0)
DynamicVariables=1
[19]
Meter=Roundline
MeterStyle=styleLine
StartAngle=9.5033177771091
X=80.45315194123
Y=215.46651292801
LineLength=((([mBand19]+((1-0)=0?0:[mBand20]+[mBand18]))/3=0)?-1:((([mBand19]+((1-0)=0?0:[mBand20]+[mBand18]))/3-[mBand19])*1+[mBand19])*80+0)
DynamicVariables=1
[20]
Meter=Roundline
MeterStyle=styleLine
StartAngle=9.4247779607694
X=80
Y=227
LineLength=((([mBand20]+((1-0)=0?0:[mBand21]+[mBand19]))/3=0)?-1:((([mBand20]+((1-0)=0?0:[mBand21]+[mBand19]))/3-[mBand20])*1+[mBand20])*80+0)
DynamicVariables=1
[21]
Meter=Roundline
MeterStyle=styleLine
StartAngle=9.3462381444296
X=80.45315194123
Y=238.53348707199
LineLength=((([mBand21]+((1-0)=0?0:[mBand22]+[mBand20]))/3=0)?-1:((([mBand21]+((1-0)=0?0:[mBand22]+[mBand20]))/3-[mBand21])*1+[mBand21])*80+0)
DynamicVariables=1
[22]
Meter=Roundline
MeterStyle=styleLine
StartAngle=9.2676983280899
X=81.809813932515
Y=249.99586636091
LineLength=((([mBand22]+((1-0)=0?0:[mBand23]+[mBand21]))/3=0)?-1:((([mBand22]+((1-0)=0?0:[mBand23]+[mBand21]))/3-[mBand22])*1+[mBand22])*80+0)
DynamicVariables=1
[23]
Meter=Roundline
MeterStyle=styleLine
StartAngle=9.1891585117501
X=84.061621701542
Y=261.31646848682
LineLength=((([mBand23]+((1-0)=0?0:[mBand24]+[mBand22]))/3=0)?-1:((([mBand23]+((1-0)=0?0:[mBand24]+[mBand22]))/3-[mBand23])*1+[mBand23])*80+0)
DynamicVariables=1
[24]
Meter=Roundline
MeterStyle=styleLine
StartAngle=9.1106186954104
X=87.194692104612
Y=272.42549817312
LineLength=((([mBand24]+((1-0)=0?0:[mBand25]+[mBand23]))/3=0)?-1:((([mBand24]+((1-0)=0?0:[mBand25]+[mBand23]))/3-[mBand24])*1+[mBand24])*80+0)
DynamicVariables=1
[25]
Meter=Roundline
MeterStyle=styleLine
StartAngle=9.0320788790707
X=91.189708720841
Y=283.25446455767
LineLength=((([mBand25]+((1-0)=0?0:[mBand26]+[mBand24]))/3=0)?-1:((([mBand25]+((1-0)=0?0:[mBand26]+[mBand24]))/3-[mBand25])*1+[mBand25])*80+0)
DynamicVariables=1
[26]
Meter=Roundline
MeterStyle=styleLine
StartAngle=8.9535390627309
X=96.02204094431
Y=293.73660346171
LineLength=((([mBand26]+((1-0)=0?0:[mBand27]+[mBand25]))/3=0)?-1:((([mBand26]+((1-0)=0?0:[mBand27]+[mBand25]))/3-[mBand26])*1+[mBand26])*80+0)
DynamicVariables=1
[27]
Meter=Roundline
MeterStyle=styleLine
StartAngle=8.8749992463912
X=101.66189583995
Y=303.80728901324
LineLength=((([mBand27]+((1-0)=0?0:[mBand28]+[mBand26]))/3=0)?-1:((([mBand27]+((1-0)=0?0:[mBand28]+[mBand26]))/3-[mBand27])*1+[mBand27])*80+0)
DynamicVariables=1
[28]
Meter=Roundline
MeterStyle=styleLine
StartAngle=8.7964594300514
X=108.07450182688
Y=313.40443208699
LineLength=((([mBand28]+((1-0)=0?0:[mBand29]+[mBand27]))/3=0)?-1:((([mBand28]+((1-0)=0?0:[mBand29]+[mBand27]))/3-[mBand28])*1+[mBand28])*80+0)
DynamicVariables=1
[29]
Meter=Roundline
MeterStyle=styleLine
StartAngle=8.7179196137117
X=115.2203230568
Y=322.46886310454
LineLength=((([mBand29]+((1-0)=0?0:[mBand30]+[mBand28]))/3=0)?-1:((([mBand29]+((1-0)=0?0:[mBand30]+[mBand28]))/3-[mBand29])*1+[mBand29])*80+0)
DynamicVariables=1
[30]
Meter=Roundline
MeterStyle=styleLine
StartAngle=8.6393797973719
X=123.05530316558
Y=330.94469683442
LineLength=((([mBand30]+((1-0)=0?0:[mBand31]+[mBand29]))/3=0)?-1:((([mBand30]+((1-0)=0?0:[mBand31]+[mBand29]))/3-[mBand30])*1+[mBand30])*80+0)
DynamicVariables=1
[31]
Meter=Roundline
MeterStyle=styleLine
StartAngle=8.5608399810322
X=131.53113689546
Y=338.7796769432
LineLength=((([mBand31]+((1-0)=0?0:[mBand32]+[mBand30]))/3=0)?-1:((([mBand31]+((1-0)=0?0:[mBand32]+[mBand30]))/3-[mBand31])*1+[mBand31])*80+0)
DynamicVariables=1
[32]
Meter=Roundline
MeterStyle=styleLine
StartAngle=8.4823001646924
X=140.59556791301
Y=345.92549817312
LineLength=((([mBand32]+((1-0)=0?0:[mBand33]+[mBand31]))/3=0)?-1:((([mBand32]+((1-0)=0?0:[mBand33]+[mBand31]))/3-[mBand32])*1+[mBand32])*80+0)
DynamicVariables=1
[33]
Meter=Roundline
MeterStyle=styleLine
StartAngle=8.4037603483527
X=150.19271098676
Y=352.33810416005
LineLength=((([mBand33]+((1-0)=0?0:[mBand34]+[mBand32]))/3=0)?-1:((([mBand33]+((1-0)=0?0:[mBand34]+[mBand32]))/3-[mBand33])*1+[mBand33])*80+0)
DynamicVariables=1
[34]
Meter=Roundline
MeterStyle=styleLine
StartAngle=8.325220532013
X=160.26339653829
Y=357.97795905569
LineLength=((([mBand34]+((1-0)=0?0:[mBand35]+[mBand33]))/3=0)?-1:((([mBand34]+((1-0)=0?0:[mBand35]+[mBand33]))/3-[mBand34])*1+[mBand34])*80+0)
DynamicVariables=1
[35]
Meter=Roundline
MeterStyle=styleLine
StartAngle=8.2466807156732
X=170.74553544233
Y=362.81029127916
LineLength=((([mBand35]+((1-0)=0?0:[mBand36]+[mBand34]))/3=0)?-1:((([mBand35]+((1-0)=0?0:[mBand36]+[mBand34]))/3-[mBand35])*1+[mBand35])*80+0)
DynamicVariables=1
[36]
Meter=Roundline
MeterStyle=styleLine
StartAngle=8.1681408993335
X=181.57450182688
Y=366.80530789539
LineLength=((([mBand36]+((1-0)=0?0:[mBand37]+[mBand35]))/3=0)?-1:((([mBand36]+((1-0)=0?0:[mBand37]+[mBand35]))/3-[mBand36])*1+[mBand36])*80+0)
DynamicVariables=1
[37]
Meter=Roundline
MeterStyle=styleLine
StartAngle=8.0896010829937
X=192.68353151318
Y=369.93837829846
LineLength=((([mBand37]+((1-0)=0?0:[mBand38]+[mBand36]))/3=0)?-1:((([mBand37]+((1-0)=0?0:[mBand38]+[mBand36]))/3-[mBand37])*1+[mBand37])*80+0)
DynamicVariables=1
[38]
Meter=Roundline
MeterStyle=styleLine
StartAngle=8.011061266654
X=204.00413363909
Y=372.19018606749
LineLength=((([mBand38]+((1-0)=0?0:[mBand39]+[mBand37]))/3=0)?-1:((([mBand38]+((1-0)=0?0:[mBand39]+[mBand37]))/3-[mBand38])*1+[mBand38])*80+0)
DynamicVariables=1
[39]
Meter=Roundline
MeterStyle=styleLine
StartAngle=7.9325214503142
X=215.46651292801
Y=373.54684805877
LineLength=((([mBand39]+((1-0)=0?0:[mBand40]+[mBand38]))/3=0)?-1:((([mBand39]+((1-0)=0?0:[mBand40]+[mBand38]))/3-[mBand39])*1+[mBand39])*80+0)
DynamicVariables=1
[40]
Meter=Roundline
MeterStyle=styleLine
StartAngle=7.8539816339745
X=227
Y=374
LineLength=((([mBand40]+((1-0)=0?0:[mBand41]+[mBand39]))/3=0)?-1:((([mBand40]+((1-0)=0?0:[mBand41]+[mBand39]))/3-[mBand40])*1+[mBand40])*80+0)
DynamicVariables=1
[41]
Meter=Roundline
MeterStyle=styleLine
StartAngle=7.7754418176347
X=238.53348707199
Y=373.54684805877
LineLength=((([mBand41]+((1-0)=0?0:[mBand42]+[mBand40]))/3=0)?-1:((([mBand41]+((1-0)=0?0:[mBand42]+[mBand40]))/3-[mBand41])*1+[mBand41])*80+0)
DynamicVariables=1
[42]
Meter=Roundline
MeterStyle=styleLine
StartAngle=7.696902001295
X=249.99586636091
Y=372.19018606749
LineLength=((([mBand42]+((1-0)=0?0:[mBand43]+[mBand41]))/3=0)?-1:((([mBand42]+((1-0)=0?0:[mBand43]+[mBand41]))/3-[mBand42])*1+[mBand42])*80+0)
DynamicVariables=1
[43]
Meter=Roundline
MeterStyle=styleLine
StartAngle=7.6183621849552
X=261.31646848682
Y=369.93837829846
LineLength=((([mBand43]+((1-0)=0?0:[mBand44]+[mBand42]))/3=0)?-1:((([mBand43]+((1-0)=0?0:[mBand44]+[mBand42]))/3-[mBand43])*1+[mBand43])*80+0)
DynamicVariables=1
[44]
Meter=Roundline
MeterStyle=styleLine
StartAngle=7.5398223686155
X=272.42549817312
Y=366.80530789539
LineLength=((([mBand44]+((1-0)=0?0:[mBand45]+[mBand43]))/3=0)?-1:((([mBand44]+((1-0)=0?0:[mBand45]+[mBand43]))/3-[mBand44])*1+[mBand44])*80+0)
DynamicVariables=1
[45]
Meter=Roundline
MeterStyle=styleLine
StartAngle=7.4612825522758
X=283.25446455767
Y=362.81029127916
LineLength=((([mBand45]+((1-0)=0?0:[mBand46]+[mBand44]))/3=0)?-1:((([mBand45]+((1-0)=0?0:[mBand46]+[mBand44]))/3-[mBand45])*1+[mBand45])*80+0)
DynamicVariables=1
[46]
Meter=Roundline
MeterStyle=styleLine
StartAngle=7.382742735936
X=293.73660346171
Y=357.97795905569
LineLength=((([mBand46]+((1-0)=0?0:[mBand47]+[mBand45]))/3=0)?-1:((([mBand46]+((1-0)=0?0:[mBand47]+[mBand45]))/3-[mBand46])*1+[mBand46])*80+0)
DynamicVariables=1
[47]
Meter=Roundline
MeterStyle=styleLine
StartAngle=7.3042029195963
X=303.80728901324
Y=352.33810416005
LineLength=((([mBand47]+((1-0)=0?0:[mBand48]+[mBand46]))/3=0)?-1:((([mBand47]+((1-0)=0?0:[mBand48]+[mBand46]))/3-[mBand47])*1+[mBand47])*80+0)
DynamicVariables=1
[48]
Meter=Roundline
MeterStyle=styleLine
StartAngle=7.2256631032565
X=313.40443208699
Y=345.92549817312
LineLength=((([mBand48]+((1-0)=0?0:[mBand49]+[mBand47]))/3=0)?-1:((([mBand48]+((1-0)=0?0:[mBand49]+[mBand47]))/3-[mBand48])*1+[mBand48])*80+0)
DynamicVariables=1
[49]
Meter=Roundline
MeterStyle=styleLine
StartAngle=7.1471232869168
X=322.46886310454
Y=338.7796769432
LineLength=((([mBand49]+((1-0)=0?0:[mBand50]+[mBand48]))/3=0)?-1:((([mBand49]+((1-0)=0?0:[mBand50]+[mBand48]))/3-[mBand49])*1+[mBand49])*80+0)
DynamicVariables=1
[50]
Meter=Roundline
MeterStyle=styleLine
StartAngle=7.068583470577
X=330.94469683442
Y=330.94469683442
LineLength=((([mBand50]+((1-0)=0?0:[mBand51]+[mBand49]))/3=0)?-1:((([mBand50]+((1-0)=0?0:[mBand51]+[mBand49]))/3-[mBand50])*1+[mBand50])*80+0)
DynamicVariables=1
[51]
Meter=Roundline
MeterStyle=styleLine
StartAngle=6.9900436542373
X=338.7796769432
Y=322.46886310454
LineLength=((([mBand51]+((1-0)=0?0:[mBand52]+[mBand50]))/3=0)?-1:((([mBand51]+((1-0)=0?0:[mBand52]+[mBand50]))/3-[mBand51])*1+[mBand51])*80+0)
DynamicVariables=1
[52]
Meter=Roundline
MeterStyle=styleLine
StartAngle=6.9115038378975
X=345.92549817312
Y=313.40443208699
LineLength=((([mBand52]+((1-0)=0?0:[mBand53]+[mBand51]))/3=0)?-1:((([mBand52]+((1-0)=0?0:[mBand53]+[mBand51]))/3-[mBand52])*1+[mBand52])*80+0)
DynamicVariables=1
[53]
Meter=Roundline
MeterStyle=styleLine
StartAngle=6.8329640215578
X=352.33810416005
Y=303.80728901324
LineLength=((([mBand53]+((1-0)=0?0:[mBand54]+[mBand52]))/3=0)?-1:((([mBand53]+((1-0)=0?0:[mBand54]+[mBand52]))/3-[mBand53])*1+[mBand53])*80+0)
DynamicVariables=1
[54]
Meter=Roundline
MeterStyle=styleLine
StartAngle=6.7544242052181
X=357.97795905569
Y=293.73660346171
LineLength=((([mBand54]+((1-0)=0?0:[mBand55]+[mBand53]))/3=0)?-1:((([mBand54]+((1-0)=0?0:[mBand55]+[mBand53]))/3-[mBand54])*1+[mBand54])*80+0)
DynamicVariables=1
[55]
Meter=Roundline
MeterStyle=styleLine
StartAngle=6.6758843888783
X=362.81029127916
Y=283.25446455767
LineLength=((([mBand55]+((1-0)=0?0:[mBand56]+[mBand54]))/3=0)?-1:((([mBand55]+((1-0)=0?0:[mBand56]+[mBand54]))/3-[mBand55])*1+[mBand55])*80+0)
DynamicVariables=1
[56]
Meter=Roundline
MeterStyle=styleLine
StartAngle=6.5973445725386
X=366.80530789539
Y=272.42549817312
LineLength=((([mBand56]+((1-0)=0?0:[mBand57]+[mBand55]))/3=0)?-1:((([mBand56]+((1-0)=0?0:[mBand57]+[mBand55]))/3-[mBand56])*1+[mBand56])*80+0)
DynamicVariables=1
[57]
Meter=Roundline
MeterStyle=styleLine
StartAngle=6.5188047561988
X=369.93837829846
Y=261.31646848682
LineLength=((([mBand57]+((1-0)=0?0:[mBand58]+[mBand56]))/3=0)?-1:((([mBand57]+((1-0)=0?0:[mBand58]+[mBand56]))/3-[mBand57])*1+[mBand57])*80+0)
DynamicVariables=1
[58]
Meter=Roundline
MeterStyle=styleLine
StartAngle=6.4402649398591
X=372.19018606749
Y=249.99586636091
LineLength=((([mBand58]+((1-0)=0?0:[mBand59]+[mBand57]))/3=0)?-1:((([mBand58]+((1-0)=0?0:[mBand59]+[mBand57]))/3-[mBand58])*1+[mBand58])*80+0)
DynamicVariables=1
[59]
Meter=Roundline
MeterStyle=styleLine
StartAngle=6.3617251235193
X=373.54684805877
Y=238.53348707199
LineLength=((([mBand59]+((1-0)=0?0:[mBand60]+[mBand58]))/3=0)?-1:((([mBand59]+((1-0)=0?0:[mBand60]+[mBand58]))/3-[mBand59])*1+[mBand59])*80+0)
DynamicVariables=1
[60]
Meter=Roundline
MeterStyle=styleLine
StartAngle=6.2831853071796
X=374
Y=227
LineLength=((([mBand60]+((1-0)=0?0:[mBand61]+[mBand59]))/3=0)?-1:((([mBand60]+((1-0)=0?0:[mBand61]+[mBand59]))/3-[mBand60])*1+[mBand60])*80+0)
DynamicVariables=1
[61]
Meter=Roundline
MeterStyle=styleLine
StartAngle=6.2046454908398
X=373.54684805877
Y=215.46651292801
LineLength=((([mBand61]+((1-0)=0?0:[mBand62]+[mBand60]))/3=0)?-1:((([mBand61]+((1-0)=0?0:[mBand62]+[mBand60]))/3-[mBand61])*1+[mBand61])*80+0)
DynamicVariables=1
[62]
Meter=Roundline
MeterStyle=styleLine
StartAngle=6.1261056745001
X=372.19018606749
Y=204.00413363909
LineLength=((([mBand62]+((1-0)=0?0:[mBand63]+[mBand61]))/3=0)?-1:((([mBand62]+((1-0)=0?0:[mBand63]+[mBand61]))/3-[mBand62])*1+[mBand62])*80+0)
DynamicVariables=1
[63]
Meter=Roundline
MeterStyle=styleLine
StartAngle=6.0475658581604
X=369.93837829846
Y=192.68353151318
LineLength=((([mBand63]+((1-0)=0?0:[mBand64]+[mBand62]))/3=0)?-1:((([mBand63]+((1-0)=0?0:[mBand64]+[mBand62]))/3-[mBand63])*1+[mBand63])*80+0)
DynamicVariables=1
[64]
Meter=Roundline
MeterStyle=styleLine
StartAngle=5.9690260418206
X=366.80530789539
Y=181.57450182688
LineLength=((([mBand64]+((1-0)=0?0:[mBand65]+[mBand63]))/3=0)?-1:((([mBand64]+((1-0)=0?0:[mBand65]+[mBand63]))/3-[mBand64])*1+[mBand64])*80+0)
DynamicVariables=1
[65]
Meter=Roundline
MeterStyle=styleLine
StartAngle=5.8904862254809
X=362.81029127916
Y=170.74553544233
LineLength=((([mBand65]+((1-0)=0?0:[mBand66]+[mBand64]))/3=0)?-1:((([mBand65]+((1-0)=0?0:[mBand66]+[mBand64]))/3-[mBand65])*1+[mBand65])*80+0)
DynamicVariables=1
[66]
Meter=Roundline
MeterStyle=styleLine
StartAngle=5.8119464091411
X=357.97795905569
Y=160.26339653829
LineLength=((([mBand66]+((1-0)=0?0:[mBand67]+[mBand65]))/3=0)?-1:((([mBand66]+((1-0)=0?0:[mBand67]+[mBand65]))/3-[mBand66])*1+[mBand66])*80+0)
DynamicVariables=1
[67]
Meter=Roundline
MeterStyle=styleLine
StartAngle=5.7334065928014
X=352.33810416005
Y=150.19271098676
LineLength=((([mBand67]+((1-0)=0?0:[mBand68]+[mBand66]))/3=0)?-1:((([mBand67]+((1-0)=0?0:[mBand68]+[mBand66]))/3-[mBand67])*1+[mBand67])*80+0)
DynamicVariables=1
[68]
Meter=Roundline
MeterStyle=styleLine
StartAngle=5.6548667764616
X=345.92549817312
Y=140.59556791301
LineLength=((([mBand68]+((1-0)=0?0:[mBand69]+[mBand67]))/3=0)?-1:((([mBand68]+((1-0)=0?0:[mBand69]+[mBand67]))/3-[mBand68])*1+[mBand68])*80+0)
DynamicVariables=1
[69]
Meter=Roundline
MeterStyle=styleLine
StartAngle=5.5763269601219
X=338.7796769432
Y=131.53113689546
LineLength=((([mBand69]+((1-0)=0?0:[mBand70]+[mBand68]))/3=0)?-1:((([mBand69]+((1-0)=0?0:[mBand70]+[mBand68]))/3-[mBand69])*1+[mBand69])*80+0)
DynamicVariables=1
[70]
Meter=Roundline
MeterStyle=styleLine
StartAngle=5.4977871437821
X=330.94469683442
Y=123.05530316558
LineLength=((([mBand70]+((1-0)=0?0:[mBand71]+[mBand69]))/3=0)?-1:((([mBand70]+((1-0)=0?0:[mBand71]+[mBand69]))/3-[mBand70])*1+[mBand70])*80+0)
DynamicVariables=1
[71]
Meter=Roundline
MeterStyle=styleLine
StartAngle=5.4192473274424
X=322.46886310454
Y=115.2203230568
LineLength=((([mBand71]+((1-0)=0?0:[mBand72]+[mBand70]))/3=0)?-1:((([mBand71]+((1-0)=0?0:[mBand72]+[mBand70]))/3-[mBand71])*1+[mBand71])*80+0)
DynamicVariables=1
[72]
Meter=Roundline
MeterStyle=styleLine
StartAngle=5.3407075111026
X=313.40443208699
Y=108.07450182688
LineLength=((([mBand72]+((1-0)=0?0:[mBand73]+[mBand71]))/3=0)?-1:((([mBand72]+((1-0)=0?0:[mBand73]+[mBand71]))/3-[mBand72])*1+[mBand72])*80+0)
DynamicVariables=1
[73]
Meter=Roundline
MeterStyle=styleLine
StartAngle=5.2621676947629
X=303.80728901324
Y=101.66189583995
LineLength=((([mBand73]+((1-0)=0?0:[mBand74]+[mBand72]))/3=0)?-1:((([mBand73]+((1-0)=0?0:[mBand74]+[mBand72]))/3-[mBand73])*1+[mBand73])*80+0)
DynamicVariables=1
[74]
Meter=Roundline
MeterStyle=styleLine
StartAngle=5.1836278784232
X=293.73660346171
Y=96.02204094431
LineLength=((([mBand74]+((1-0)=0?0:[mBand75]+[mBand73]))/3=0)?-1:((([mBand74]+((1-0)=0?0:[mBand75]+[mBand73]))/3-[mBand74])*1+[mBand74])*80+0)
DynamicVariables=1
[75]
Meter=Roundline
MeterStyle=styleLine
StartAngle=5.1050880620834
X=283.25446455767
Y=91.189708720841
LineLength=((([mBand75]+((1-0)=0?0:[mBand76]+[mBand74]))/3=0)?-1:((([mBand75]+((1-0)=0?0:[mBand76]+[mBand74]))/3-[mBand75])*1+[mBand75])*80+0)
DynamicVariables=1
[76]
Meter=Roundline
MeterStyle=styleLine
StartAngle=5.0265482457437
X=272.42549817312
Y=87.194692104612
LineLength=((([mBand76]+((1-0)=0?0:[mBand77]+[mBand75]))/3=0)?-1:((([mBand76]+((1-0)=0?0:[mBand77]+[mBand75]))/3-[mBand76])*1+[mBand76])*80+0)
DynamicVariables=1
[77]
Meter=Roundline
MeterStyle=styleLine
StartAngle=4.9480084294039
X=261.31646848682
Y=84.061621701542
LineLength=((([mBand77]+((1-0)=0?0:[mBand78]+[mBand76]))/3=0)?-1:((([mBand77]+((1-0)=0?0:[mBand78]+[mBand76]))/3-[mBand77])*1+[mBand77])*80+0)
DynamicVariables=1
[78]
Meter=Roundline
MeterStyle=styleLine
StartAngle=4.8694686130642
X=249.99586636091
Y=81.809813932515
LineLength=((([mBand78]+((1-0)=0?0:[mBand79]+[mBand77]))/3=0)?-1:((([mBand78]+((1-0)=0?0:[mBand79]+[mBand77]))/3-[mBand78])*1+[mBand78])*80+0)
DynamicVariables=1
[79]
Meter=Roundline
MeterStyle=styleLine
StartAngle=4.7909287967244
X=238.53348707199
Y=80.45315194123
LineLength=((([mBand79]+((1-0)=0?0:[mBand0]+[mBand78]))/3=0)?-1:((([mBand79]+((1-0)=0?0:[mBand0]+[mBand78]))/3-[mBand79])*1+[mBand79])*80+0)
DynamicVariables=1