[Variables]
WS01=Task Manager
WS02=Ressourcenmonitor
WS03=Geräte-Manager
WS04=Festplattenadministrator
WS05=Soundmanager
WS06=Netzwerkverbindungen
WS07=Ereignisanzeige
WS08=Energiekonfiguration
WS09=DirectX-Diagnose
WS10=Disk Optimizer
WS11=Speicherplatz löschen
WS12=Deinstallation der Anwendung
WS13=Firewall
WS14=Registrierungseditor
WS15=Mauseinstellungen
WS16=Zeit- und Datumseinstellungen
WS17=Konfiguration starten
WS18=Windows-Konfiguration
WS19=Systemsteuerung
WS20=Systeminformationen
WS21=Mein Ordner für Dokumente
WS22=Mein Musikordner
WS23=Mein Fotoordner
WS24=Mein Videoordner
WS25=Ordner herunterladen
WS26=Desktop-Ordner
WS27=Papierkorb
WS28=Über Windows
Ajustes=EINSTELLUNGEN
Juegos=SPIELE
Marcadores=MARKERS
InfoWCH=Nur die Wetterbedingungen der Anwendung My Weather werden in die lokale Sprache übersetzt. SmartPhone-Texte werden in englischer Sprache verfasst
InfoTT1=Bild vergrößern
InfoTT2=Die Daten werden in Grad Celsius empfangen, der Druck in hPa und der Wind in km / h
InfoPL1=Andere Spieler benötigen externe Plugins
InfoPL2=Klicken Sie hier, um weitere Informationen zu erhalten
InfoPL3=MP3-Ordner eingeben
