[Variables]
Viento_Dir="CALM":"0","VAR":"- -"
Niveles="calm":" "
Semana=
LunaEstado=

DirViento="W":"West","E":"East","N":"North","S":"South","NNE":"north east northeast","NE":"northeast","ENE":"east northeast","ESE":"Este Sureste","SE":"south east","SSE":"south east southeast","SSW":"south southwest","SW":"southwest","WSW":"west southwest","WNW":"west northwest","NW":"northwest","NNW":"north west","calm":"calm","VAR":"Variable"

MedidaViento="km/h":"Kilometers per hour","mph":"Miles per hour"

EnPunto=O'clock
Voz01=It's
Voz02=The temperature outside is
Voz03=degrees
Voz04=and time is
Voz05=The pressure is of
Voz06=and the humidity of
Voz07=The wind speed is
Voz08=of the
Voz09=Chance of rain
Voz10=Tonight
Voz11=with a low of
