[mDireccion]
Measure=Plugin
Plugin=FileView
Path=#CarpetaMP3#
Count=10
HideExtensions=1

[mNumCarpetas]
Measure=Plugin
Plugin=FileView
Path=[mDireccion]
Type=FolderCount
Group=Carpetas

[mNumArchivos]
Measure=Plugin
Plugin=FileView
Path=[mDireccion]
Type=FileCount
Group=Carpetas

[mIndice1Nombre]
Measure=Plugin
Plugin=FileView
Path=[mDireccion]
Type=FileName
Index=1
Group=Carpetas

[mIndice2Nombre]
Measure=Plugin
Plugin=FileView
Path=[mDireccion]
Type=FileName
Index=2
Group=Carpetas

[mIndice3Nombre]
Measure=Plugin
Plugin=FileView
Path=[mDireccion]
Type=FileName
Index=3
Group=Carpetas

[mIndice4Nombre]
Measure=Plugin
Plugin=FileView
Path=[mDireccion]
Type=FileName
Index=4
Group=Carpetas

[mIndice5Nombre]
Measure=Plugin
Plugin=FileView
Path=[mDireccion]
Type=FileName
Index=5
Group=Carpetas

[mIndice6Nombre]
Measure=Plugin
Plugin=FileView
Path=[mDireccion]
Type=FileName
Index=6
Group=Carpetas

[mIndice7Nombre]
Measure=Plugin
Plugin=FileView
Path=[mDireccion]
Type=FileName
Index=7
Group=Carpetas

[mIndice8Nombre]
Measure=Plugin
Plugin=FileView
Path=[mDireccion]
Type=FileName
Index=8
Group=Carpetas

[mIndice9Nombre]
Measure=Plugin
Plugin=FileView
Path=[mDireccion]
Type=FileName
Index=9
Group=Carpetas

[mIndice10Nombre]
Measure=Plugin
Plugin=FileView
Path=[mDireccion]
Type=FileName
Index=10
Group=Carpetas
