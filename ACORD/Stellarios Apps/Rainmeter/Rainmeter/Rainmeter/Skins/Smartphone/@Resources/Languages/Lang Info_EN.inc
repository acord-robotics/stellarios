[Variables]
WS01=Task Manager
WS02=Resource Monitor
WS03=Device Manager
WS04=Disk Administrator
WS05=Sound manager
WS06=Network Connections
WS07=Event Viewer
WS08=Energy configuration
WS09=DirectX Diagnostics
WS10=Disk Optimizer
WS11=Space clearing
WS12=Application uninstaller
WS13=Firewall
WS14=Registry Editor
WS15=Mouse settings
WS16=Time and date settings
WS17=Start configuration
WS18=Windows Configuration
WS19=Control Panel
WS20=System information
WS21=My Documents Folder
WS22=My Music Folder
WS23=My Photos Folder
WS24=My Videos Folder
WS25=Download Folder
WS26=Desktop Folder
WS27=Trash
WS28=About Windows
Ajustes=SETTINGS
Juegos=GAMES
Marcadores=MARKERS
InfoWCH=Only the weather conditions of the My Weather application are translated into the local language. SmartPhone texts will be in English
InfoTT1=Enlarge image
InfoTT2=The data is received in degrees Celsius, the pressure in hPa and the wind in km / h
InfoPL1=Other players need external plugins
InfoPL2=Click here for more information
InfoPL3=Enter MP3 Folder
