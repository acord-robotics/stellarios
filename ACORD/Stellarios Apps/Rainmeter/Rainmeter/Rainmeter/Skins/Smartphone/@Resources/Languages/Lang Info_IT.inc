[Variables]
WS01=Task Manager
WS02=Monitoraggio risorse
WS03=Gestione periferiche
WS04=Disk Administrator
WS05=Gestore suoni
WS06=Connessioni di rete
WS07=Visualizzatore eventi
WS08=Configurazione energetica
WS09=Diagnostica DirectX
WS10=Ottimizzatore disco
WS11=Spazio vuoto
WS12=Programma di disinstallazione dell'applicazione
WS13=Firewall
WS14=Editor del registro
WS15=Impostazioni del mouse
WS16=Impostazioni di data e ora
WS17=Avvia configurazione
WS18=Configurazione di Windows
WS19=Pannello di controllo
WS20=Informazioni di sistema
WS21=Cartella Documenti
WS22=Cartella My Music
WS23=Cartella Foto personali
WS24=Cartella My Videos
WS25=Scarica cartella
WS26=Cartella desktop
WS27=Cestino
WS28=Informazioni su Windows
Ajustes=IMPOSTAZIONI
Juegos=GIOCHI
Marcadores=MARKERS
InfoWCH=Solo le condizioni meteorologiche dell'applicazione My Weather sono tradotte nella lingua locale. I testi di SmartPhone saranno in inglese
InfoTT1=Ingrandisci immagine
InfoTT2=I dati vengono ricevuti in gradi Celsius, la pressione in hPa e il vento in km / h
InfoPL1=Gli altri giocatori hanno bisogno di plugin esterni
InfoPL2=Clicca qui per maggiori informazioni
InfoPL3=Entra nella cartella MP3
