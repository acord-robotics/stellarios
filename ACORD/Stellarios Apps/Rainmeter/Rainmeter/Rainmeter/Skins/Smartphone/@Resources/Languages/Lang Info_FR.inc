[Variables]
WS01=Gestionnaire de tâches
WS02=Moniteur de ressources
WS03=Gestionnaire de périphériques
WS04=Administrateur de disque
WS05=Gestionnaire de son
WS06=Connexions réseau
WS07=Observateur d'événements
WS08=Configuration énergétique
WS09=Diagnostics DirectX
WS10=Optimiseur de disque
WS11=espace de compensation
WS12=programme de désinstallation d'application
WS13=pare-feu
WS14=Éditeur du registre
WS15=Paramètres de la souris
WS16=Paramètres heure et date
WS17=Démarrer la configuration
WS18=Configuration Windows
WS19=Panneau de configuration
WS20=Informations système
WS21=dossier Mes documents
WS22=mon dossier de musique
WS23=dossier Mes photos
WS24=dossier Mes vidéos
WS25=Dossier de téléchargement
WS26=dossier du bureau
WS27=Corbeille
WS28=à propos de Windows
Ajustes=Paramètres
Juegos=JEUX
Marcadores=MARQUEURS
InfoWCH=Seules les conditions météorologiques de l'application My Weather sont traduites dans la langue du pays. SmartPhone textes seront en anglais
InfoTT1=Agrandir l'image
InfoTT2=Les données sont reçues en degrés Celsius, la pression en hPa et le vent en km / h
InfoPL1=Les autres joueurs ont besoin de plugins externes
InfoPL2=Cliquez ici pour plus d'informations
InfoPL3=Entrer le dossier MP3
