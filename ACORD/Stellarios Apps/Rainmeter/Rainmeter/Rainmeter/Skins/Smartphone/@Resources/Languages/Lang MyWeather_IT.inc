[Variables]
Viento_Dir="W":"W","E":"E","N":"N","S":"S","CALM":"0","VAR":"- -"

Niveles="Low":"Lento","Moderate":"Moderato","High":"Forte","Very":"Molto","Extreme":"Estremo","steady":"Costante","rising":"Crescita","falling":"Caduta","rapidly":"Rapido","calm":" "

Semana="Monday":"Lunedi","Tuesday":"Martedì","Wednesday":"Mercoledì","Thursday":"Giovedi","Friday":"Venerdì","Saturday":"Sabato","Sunday":"Domenica"

LunaEstado="Full":"Piena","Waning Gibbous":"Gibbosa calante","Last Quarter":"Ultimo quarto","Waning Crescent":"Luna calante","New":"Nuova","Waxing Crescent":"Luna crescente","First Quarter":"Primo quarto","Waxing Gibbous":"Gibbosa crescente","Moon":""

DirViento="W":"ovest","E":"Est","N":"Nord","S":"a sud","NNE":"nord-est","NE":"nord-est","ENE":"nord-est","ESE":"est sud-est","SE":"sud-est","SSE":"sud-est","SSW":"sud-ovest","SW":"sud-ovest","WSW":"ovest sud-ovest","WNW":"ovest nord ovest","NW":"nordovest","NNW":"nord-ovest nord","calm":"in calma","VAR":"Variable"

MedidaViento="km/h":"Chilometri all'ora","mph":"miglia all'ora"

EnPunto=In punto
Voz01=Sono
Voz02=La temperatura esterna è
Voz03=gradi
Voz04=e il tempo è
Voz05=La pressione è di
Voz06=e l'umidità di
Voz07=La velocità del vento è
Voz08=del
Voz09=Possibilità di pioggia
Voz10=Stasera
Voz11=con un minimo di






