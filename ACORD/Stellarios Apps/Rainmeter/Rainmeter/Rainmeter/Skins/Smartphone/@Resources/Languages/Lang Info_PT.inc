[Variables]
WS01=Gerenciador de Tarefas
WS02=Monitor de Recursos
WS03=Gerenciador de Dispositivos
WS04=Administrador de Discos
WS05=Gerenciador de som
WS06=Conexões de Rede
WS07=Visualizador de Eventos
WS08=configuração de energia
WS09=Diagnóstico do DirectX
WS10=Otimizador de Disco
WS11=Limpeza do espaço
WS12=desinstalador de aplicativos
WS13=Firewall
WS14=Editor do Registro
WS15=configurações do mouse
WS16=Configurações de hora e data
WS17=Iniciar configuração
WS18=Configuração do Windows
WS19=Painel de Controle
WS20=Informação do sistema
WS21=Minha pasta de documentos
WS22=Minha pasta de músicas
WS23=Minha Pasta de Fotos
WS24=minha pasta de vídeos
WS25=Download da Pasta
WS26=Pasta Desktop
WS27=Lixo
WS28=Sobre o Windows
Ajustes=CONFIGURAÇÕES
Juegos=JOGOS
Marcadores=MARCADORES
InfoWCH=Apenas as condições meteorológicas da aplicação My Weather são traduzidas para o idioma local. Os textos do SmartPhone estarão em inglês
InfoTT1=Ampliar imagem
InfoTT2=Os dados são recebidos em graus Celsius, a pressão em hPa e o vento em km / h
InfoPL1=Outros jogadores precisam de plugins externos
InfoPL2=Clique aqui para mais informações
InfoPL3=Digite a pasta MP3
