[Variables]
Bb01=https://www.facebook.com/
Bb02=https://twitter.com/
Bb03=https://www.instagram.com/
Bb04=https://www.pinterest.com/
Bb05=https://www.reddit.com/
Bb06=https://www.linkedin.com/
Bb07=https://www.tumblr.com/
Bb08=https://www.flickr.com/
Bb09=https://www.tiktok.com/
Bb10=https://www.snapchat.com/
Bb11=https://www.wikipedia.org/
Bb12=https://weheartit.com/
Bb13=https://forum.rainmeter.net/
Bb14=https://www.deviantart.com/customization/skins/sysmonitor/rainmeter/newest/
Bb15=https://web.telegram.org/
Bb16=https://web.whatsapp.com/
Bb17=
Bb18=
Bb19=
Bb20=
Bb21=
Bb22=
Bb23=
Bb24=
Bb25=
Bb26=
Bb27=
Bb28=
