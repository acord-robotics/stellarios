[Variables]
Viento_Dir="W":"W","E":"D","N":"N","S":"S","CALM":"0","VAR":"- -"

Niveles="Low":"Niedrig","Moderate":"Moderate","High":"Hohe","Very":"Sehr","Extreme":"Extrem","steady":"Stabil","rising":"Hochladen","falling":"Hinunter gehen","rapidly":"Schnell","calm":" "

Semana="Monday":"Montag","Tuesday":"Dienstag","Wednesday":"Mittwoch","Thursday":"Donnerstag","Friday":"Freitag","Saturday":"Samstag","Sunday":"Sonntag"

LunaEstado="Full":"Vollmond","Waning Gibbous":"Abnehmender Mond","Last Quarter":"Halbmond (abnehmend)","Waning Crescent":"Mondsichel (abnehmend)","New":"Neumond","Waxing Crescent":"Mondsichel (zunehmend)","First Quarter":"Halbmond (zunehmend)","Waxing Gibbous":"Zunehmender Mond","Moon":""

DirViento="W":"westen","E":"osten","N":"norden","S":"süden","NNE":"nordosten","NE":"osten","ENE":"osten","ESE":"osten","SE":"südosten","SSE":"südosten","SSW":"südwesten","SW":"westen","WSW":"westen","WNW":"nordwesten","NW":"nordwesten","NNW":"nordwesten","calm":"ruhig","VAR":"Variabel"

MedidaViento="km/h":"Kilometer pro Stunde","mph":"Meilen pro Stunde"

EnPunto=Auf Punkt
Voz01=sind die
Voz02=Die Temperatur draußen ist
Voz03=grad
Voz04=und die Zeit ist
Voz05=Der Druck ist von
Voz06=und die Luftfeuchtigkeit von
Voz07=Die Windgeschwindigkeit is
Voz08=von der
Voz09=Chance für Regen
Voz10=Heute abend
Voz11=mit einem Minimum von
