[VarStyle]
InlineSetting =Face  | Open Sans
InlineSetting2=Size  | 10
InlineSetting3=Color | 255,255,255
InlineSetting4=Weight| 500
StringAlign=CenterCenter
SolidColor=15,15,15
Antialias=1
X=r
H=20

[ColorVar]
Meter=String
MeterStyle=VarStyle
Text=#Color#
Y=([Color:Y]+12.5)
W=150
X=405

[FontVar]
Meter=String
MeterStyle=VarStyle
Text=#Font#
Y=([Font:Y]+12.5)
W=150

[RoundSub]
Measure=String
String=#Round#
Substitute="0":"No","1":"Yes"

[RoundVar]
Meter=String
MeasureName=RoundSub
MeterStyle=VarStyle
Text=%1
Y=([Round:Y]+12.5)
W=60
X=450

[AlbumArtScaleVar]
Meter=String
MeterStyle=VarStyle
Text=#AScale#
Y=([AlbumArtScale:Y]+12.5)
W=60

[ButtonScaleVar]
Meter=String
MeterStyle=VarStyle
Text=#BScale#
Y=([ButtonScale:Y]+12.5)
W=60

[ProgressScaleVar]
Meter=String
MeterStyle=VarStyle
Text=#PScale#
Y=([ProgressScale:Y]+12.5)
W=60

[BarWidthVar]
Meter=String
MeterStyle=VarStyle
Text=#BarWidth#
Y=([BarWidth:Y]+12.5)
W=60

[BarHeightVar]
Meter=String
MeterStyle=VarStyle
Text=#BarHeight#
Y=([BarHeight:Y]+12.5)
W=60

[BarSpacingVar]
Meter=String
MeterStyle=VarStyle
Text=#BarSpacing#
Y=([BarSpacing:Y]+12.5)
W=60

[BarsVar]
Meter=String
MeterStyle=VarStyle
Text=#Bars#
Y=([Bars:Y]+12.5)
W=60

[TrackAlignVar]
Meter=String
MeterStyle=VarStyle
Text=#Align#
Y=([TrackAlign:Y]+12.5)
W=60