[Variables]

;-------------------------------------------------------------
;-------------------------------------------------------------

;Please understand me i can not able to translate the skin to each language,but you can translate at yours.
;If you want to help me translate into your language,see the instruction,translate to your language,and please share fuly translated language with me,
;and i will add it in the next update. :)

;HOW TO TRANSLATE TO YOUR LANGUAGE?
;Replace the word that is right to the colon [:] with your language translation.
;Leave the quotation marks intact and separate each section with a comma [,].
;It`s simple,just look below :)

;NOTES:
;But if just in case,something is not clear,you'll see clearly below,
;how it looks translated language,for example,German. :)
;Date="Sunday":"Sonntag","Monday":"Montag","Tuesday":"Dienstag","Wednesday":"Mittwoch","Thursday":"Donnerstag","Friday":"Freitag","Saturday":"Samstag"Date="Sunday":"Sonntag","Monday":"Montag","Tuesday":"Dienstag","Wednesday":"Mittwoch","Thursday":"Donnerstag","Friday":"Freitag","Saturday":"Samstag","January":"Januar","February":"Februar","March":"März","Aprril":"April","May":"May","Jun":"Juni","July":"Juli","August":"August","September":"September","October":"Oktober","November":"November","December":"Dezember"
;Conditions="Thunderstorms":"Gewitter","Windy Rain":"Wind und Regen","T-Storms":"Gewitter","Rain Snow":"Schneeregen","Sleet":"Graupel","Snow/Rain Icy Mix":"Gefrorener Schneeregen","Freezing Drizzle":"Gefrierender Niesel","Drizzle":"Niesel","Freezing Rain":"Gefrierender Regen","T-Showers":"Platzregen","Showers":"Regenschauer","Light Rain":"Leichter Regen","Heavy Rain":"Heftiger Regen","Snow Flurries":"Vereinzelte Schneefall","Light Snow":"Leichter Schneefall","Snowflakes":"Schneeflocken","Heavy Snow":"Heftiger Schneefall","Hail":"Hagel","Dust":"Staub","Fog":"Nebel","Haze":"Dunst","Smoke":"Rauch","Windy":"Windig","Frigid":"Kühl","Partly Cloudy":"Teilweise bewölkt","Mostly Cloudy":"Stark bewölkt","Clear":"Klar","Sunny":"Sonnig","Fair":"Heiter","Mostly Clear":"Klar","Mostly Sunny":"Meist Sonnig","Hot":"Heiß","Isolated Thunder":"Vereinzelt Donner","Scattered T-Storms":"Vereinzelte Gewitter","Scattered Rain":"Vereinzelt Regen","Scattered Snow":"Vereinzelt Schneefall","Windy/Snowy":"Windig/Schneefall","Scattered wers":"Vereinzelte Regenschauer","Snowy":"Schneefall","and":"und","Shower":"Schauer","Mostly":"Meist","Scattered":"Vereinzelt","Rain":"Regen","Snow":"Schneefall","Wind":"Wind","Early":"Morgens","Late":"Abends","PM":"Nachmittags","AM":"Vormittags","Sun":"Sonne","Clouds":"Wolken","Cloudy":"Bewölkt","Cloud":"Wolke","Light":"Leicht","Snow Shower":"Schneefall","Widespread":"Verbreitet","Few":"Wenig","Isolated":"Vereinzelt","Mist":"Leichter Nebel","Thunder":"Donner","with":"Mit","In the Vicinity":"In der Nähe"

;-------------------------------------------------------------
;-------------------------------------------------------------

;Translate to your language below:

Date="Sunday":"Sunday","Monday":"Monday","Tuesday":"Tuesday","Wednesday":"Wednesday","Thursday":"Thursday","Friday":"Friday","Saturday":"Saturday","January":"January","February":"February","March":"March","April":"April","May":"May","June":"June","July":"July","August":"August","September":"September","October":"October","November":"November","December":"December"

on disk=on disk

in trash=in trash

Item/s=Item/s

day/s until=day/s until