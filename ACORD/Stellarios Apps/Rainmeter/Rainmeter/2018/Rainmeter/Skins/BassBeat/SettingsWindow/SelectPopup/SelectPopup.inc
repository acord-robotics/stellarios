[0]
Meter=String
MeterStyle=s
Text=Default
LeftMouseDownAction=[!SetVariable AudioDeviceID "" "#ROOTCONFIG#\SettingsWindow"][!WriteKeyValue Variables AudioDeviceID "" "C:\Users\arbuc\OneDrive\Documents\Rainmeter\Skins\BassBeat\Settings.inc"][!SetOption AudioDeviceID_Select Text "Default" "#ROOTCONFIG#\SettingsWindow"][!Refresh "#ROOTCONFIG#\SettingsWindow"][!DeactivateConfig]
[1]
Meter=String
MeterStyle=s
Text=Headset (HP-6117 Hands-Free)
LeftMouseDownAction=[!SetVariable AudioDeviceID "{0.0.0.00000000}.{3efbb57b-39e4-438e-835d-25e1383258c0}" "#ROOTCONFIG#\SettingsWindow"][!WriteKeyValue Variables AudioDeviceID "{0.0.0.00000000}.{3efbb57b-39e4-438e-835d-25e1383258c0}" "C:\Users\arbuc\OneDrive\Documents\Rainmeter\Skins\BassBeat\Settings.inc"][!SetOption AudioDeviceID_Select Text "Headset (HP-6117 Hands-Free)" "#ROOTCONFIG#\SettingsWindow"][!Refresh "#ROOTCONFIG#\SettingsWindow"][!DeactivateConfig]
[2]
Meter=String
MeterStyle=s
Text=Speakers (Realtek High Definition Audio(SST))
LeftMouseDownAction=[!SetVariable AudioDeviceID "{0.0.0.00000000}.{a1dbcac2-2c1c-4cb8-84a1-0b9f5d334921}" "#ROOTCONFIG#\SettingsWindow"][!WriteKeyValue Variables AudioDeviceID "{0.0.0.00000000}.{a1dbcac2-2c1c-4cb8-84a1-0b9f5d334921}" "C:\Users\arbuc\OneDrive\Documents\Rainmeter\Skins\BassBeat\Settings.inc"][!SetOption AudioDeviceID_Select Text "Speakers (Realtek High Definition Audio(SST))" "#ROOTCONFIG#\SettingsWindow"][!Refresh "#ROOTCONFIG#\SettingsWindow"][!DeactivateConfig]
[3]
Meter=String
MeterStyle=s
Text=Headphones (HP-6117 Stereo)
LeftMouseDownAction=[!SetVariable AudioDeviceID "{0.0.0.00000000}.{cdc3393a-1221-40b3-9bd9-de844c572f6e}" "#ROOTCONFIG#\SettingsWindow"][!WriteKeyValue Variables AudioDeviceID "{0.0.0.00000000}.{cdc3393a-1221-40b3-9bd9-de844c572f6e}" "C:\Users\arbuc\OneDrive\Documents\Rainmeter\Skins\BassBeat\Settings.inc"][!SetOption AudioDeviceID_Select Text "Headphones (HP-6117 Stereo)" "#ROOTCONFIG#\SettingsWindow"][!Refresh "#ROOTCONFIG#\SettingsWindow"][!DeactivateConfig]
