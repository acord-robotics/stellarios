[Variables]
MinBarValue=0.01

[MeasureAudioSmoothed1]
Measure=Calc
Formula=#MinBarValue# + (MeasureBand1 + MeasureBand1 + MeasureBand2)/10
AverageSize=#AverageSize#
[MeasureAudioSmoothed2]
Measure=Calc
Formula=#MinBarValue# + (MeasureBand1 + MeasureBand2 + MeasureBand3)/9
AverageSize=#AverageSize#
[MeasureAudioSmoothed3]
Measure=Calc
Formula=#MinBarValue# + (MeasureBand2 + MeasureBand3 + MeasureBand4)/8
AverageSize=#AverageSize#
[MeasureAudioSmoothed4]
Measure=Calc
Formula=#MinBarValue# + (MeasureBand3 + MeasureBand4 + MeasureBand5)/7
AverageSize=#AverageSize#
[MeasureAudioSmoothed5]
Measure=Calc
Formula=#MinBarValue# + (MeasureBand4 + MeasureBand5 + MeasureBand6)/6
AverageSize=#AverageSize#
[MeasureAudioSmoothed6]
Measure=Calc
Formula=#MinBarValue# + (MeasureBand5 + MeasureBand6 + MeasureBand7)/5
AverageSize=#AverageSize#
[MeasureAudioSmoothed7]
Measure=Calc
Formula=#MinBarValue# + (MeasureBand6 + MeasureBand7 + MeasureBand8)/4
AverageSize=#AverageSize#
[MeasureAudioSmoothed8]
Measure=Calc
Formula=#MinBarValue# + (MeasureBand7 + MeasureBand8 + MeasureBand9)/3
AverageSize=#AverageSize#
[MeasureAudioSmoothed9]
Measure=Calc
Formula=#MinBarValue# + (MeasureBand8 + MeasureBand9 + MeasureBand10)/3
AverageSize=#AverageSize#
[MeasureAudioSmoothed10]
Measure=Calc
Formula=#MinBarValue# + (MeasureBand9 + MeasureBand10 + MeasureBand11)/3.25
AverageSize=#AverageSize#
[MeasureAudioSmoothed11]
Measure=Calc
Formula=#MinBarValue# + (MeasureBand10 + MeasureBand11 + MeasureBand12)/3.25
AverageSize=#AverageSize#
[MeasureAudioSmoothed12]
Measure=Calc
Formula=#MinBarValue# + (MeasureBand11 + MeasureBand12 + MeasureBand13)/3
AverageSize=#AverageSize#
[MeasureAudioSmoothed13]
Measure=Calc
Formula=#MinBarValue# + (MeasureBand12 + MeasureBand13 + MeasureBand14)/3
AverageSize=#AverageSize#
[MeasureAudioSmoothed14]
Measure=Calc
Formula=#MinBarValue# + (MeasureBand13 + MeasureBand14 + MeasureBand15)/3
AverageSize=#AverageSize#
[MeasureAudioSmoothed15]
Measure=Calc
Formula=#MinBarValue# + (MeasureBand14 + MeasureBand15 + MeasureBand16)/3
AverageSize=#AverageSize#
[MeasureAudioSmoothed16]
Measure=Calc
Formula=#MinBarValue# + (MeasureBand15 + MeasureBand16 + MeasureBand17)/3.25
AverageSize=#AverageSize#
[MeasureAudioSmoothed17]
Measure=Calc
Formula=#MinBarValue# + (MeasureBand16 + MeasureBand17 + MeasureBand18)/3.25
AverageSize=#AverageSize#
[MeasureAudioSmoothed18]
Measure=Calc
Formula=#MinBarValue# + (MeasureBand17 + MeasureBand18 + MeasureBand19)/3
AverageSize=#AverageSize#
[MeasureAudioSmoothed19]
Measure=Calc
Formula=#MinBarValue# + (MeasureBand18 + MeasureBand19 + MeasureBand20)/3
AverageSize=#AverageSize#
[MeasureAudioSmoothed20]
Measure=Calc
Formula=#MinBarValue# + (MeasureBand19 + MeasureBand20 + MeasureBand21)/3
AverageSize=#AverageSize#
[MeasureAudioSmoothed21]
Measure=Calc
Formula=#MinBarValue# + (MeasureBand20 + MeasureBand21 + MeasureBand22)/3
AverageSize=#AverageSize#
[MeasureAudioSmoothed22]
Measure=Calc
Formula=#MinBarValue# + (MeasureBand21 + MeasureBand22 + MeasureBand23)/3
AverageSize=#AverageSize#
[MeasureAudioSmoothed23]
Measure=Calc
Formula=#MinBarValue# + (MeasureBand22 + MeasureBand23 + MeasureBand24)/3
AverageSize=#AverageSize#
[MeasureAudioSmoothed24]
Measure=Calc
Formula=#MinBarValue# + (MeasureBand23 + MeasureBand24 + MeasureBand25)/3
AverageSize=#AverageSize#
[MeasureAudioSmoothed25]
Measure=Calc
Formula=#MinBarValue# + (MeasureBand24 + MeasureBand25 + MeasureBand26)/3
AverageSize=#AverageSize#
[MeasureAudioSmoothed26]
Measure=Calc
Formula=#MinBarValue# + (MeasureBand25 + MeasureBand26 + MeasureBand27)/3
AverageSize=#AverageSize#
[MeasureAudioSmoothed27]
Measure=Calc
Formula=#MinBarValue# + (MeasureBand26 + MeasureBand27 + MeasureBand28)/3
AverageSize=#AverageSize#
[MeasureAudioSmoothed28]
Measure=Calc
Formula=#MinBarValue# + (MeasureBand27 + MeasureBand28 + MeasureBand29)/3
AverageSize=#AverageSize#
[MeasureAudioSmoothed29]
Measure=Calc
Formula=#MinBarValue# + (MeasureBand28 + MeasureBand29 + MeasureBand30)/3
AverageSize=#AverageSize#
[MeasureAudioSmoothed30]
Measure=Calc
Formula=#MinBarValue# + (MeasureBand29 + MeasureBand30 + MeasureBand31)/3
AverageSize=#AverageSize#
[MeasureAudioSmoothed31]
Measure=Calc
Formula=#MinBarValue# + (MeasureBand30 + MeasureBand31 + MeasureBand32)/3
AverageSize=#AverageSize#
[MeasureAudioSmoothed32]
Measure=Calc
Formula=#MinBarValue# + (MeasureBand31 + MeasureBand32 + MeasureBand33)/3
AverageSize=#AverageSize#
[MeasureAudioSmoothed33]
Measure=Calc
Formula=#MinBarValue# + (MeasureBand32 + MeasureBand33 + MeasureBand34)/3
AverageSize=#AverageSize#
[MeasureAudioSmoothed34]
Measure=Calc
Formula=#MinBarValue# + (MeasureBand33 + MeasureBand34 + MeasureBand35)/3
AverageSize=#AverageSize#
[MeasureAudioSmoothed35]
Measure=Calc
Formula=#MinBarValue# + (MeasureBand34 + MeasureBand35 + MeasureBand36)/3
AverageSize=#AverageSize#
[MeasureAudioSmoothed36]
Measure=Calc
Formula=#MinBarValue# + (MeasureBand35 + MeasureBand36 + MeasureBand37)/3
AverageSize=#AverageSize#
[MeasureAudioSmoothed37]
Measure=Calc
Formula=#MinBarValue# + (MeasureBand36 + MeasureBand37 + MeasureBand38)/3
AverageSize=#AverageSize#
[MeasureAudioSmoothed38]
Measure=Calc
Formula=#MinBarValue# + (MeasureBand37 + MeasureBand38 + MeasureBand39)/3
AverageSize=#AverageSize#
[MeasureAudioSmoothed39]
Measure=Calc
Formula=#MinBarValue# + (MeasureBand38 + MeasureBand39 + MeasureBand40)/3
AverageSize=#AverageSize#
[MeasureAudioSmoothed40]
Measure=Calc
Formula=#MinBarValue# + (MeasureBand39 + MeasureBand40 + MeasureBand41)/3
AverageSize=#AverageSize#
[MeasureAudioSmoothed41]
Measure=Calc
Formula=#MinBarValue# + (MeasureBand40 + MeasureBand41 + MeasureBand42)/3
AverageSize=#AverageSize#
[MeasureAudioSmoothed42]
Measure=Calc
Formula=#MinBarValue# + (MeasureBand41 + MeasureBand42 + MeasureBand43)/3
AverageSize=#AverageSize#
[MeasureAudioSmoothed43]
Measure=Calc
Formula=#MinBarValue# + (MeasureBand42 + MeasureBand43 + MeasureBand44)/3
AverageSize=#AverageSize#
[MeasureAudioSmoothed44]
Measure=Calc
Formula=#MinBarValue# + (MeasureBand43 + MeasureBand44 + MeasureBand45)/3
AverageSize=#AverageSize#
[MeasureAudioSmoothed45]
Measure=Calc
Formula=#MinBarValue# + (MeasureBand44 + MeasureBand45 + MeasureBand46)/3
AverageSize=#AverageSize#
[MeasureAudioSmoothed46]
Measure=Calc
Formula=#MinBarValue# + (MeasureBand45 + MeasureBand46 + MeasureBand47)/3
AverageSize=#AverageSize#
[MeasureAudioSmoothed47]
Measure=Calc
Formula=#MinBarValue# + (MeasureBand46 + MeasureBand47 + MeasureBand48)/3
AverageSize=#AverageSize#
[MeasureAudioSmoothed48]
Measure=Calc
Formula=#MinBarValue# + (MeasureBand47 + MeasureBand48 + MeasureBand49)/3
AverageSize=#AverageSize#
[MeasureAudioSmoothed49]
Measure=Calc
Formula=#MinBarValue# + (MeasureBand48 + MeasureBand49 + MeasureBand50)/3
AverageSize=#AverageSize#
[MeasureAudioSmoothed50]
Measure=Calc
Formula=#MinBarValue# + (MeasureBand49 + MeasureBand50 + MeasureBand51)/3
AverageSize=#AverageSize#
[MeasureAudioSmoothed51]
Measure=Calc
Formula=#MinBarValue# + (MeasureBand50 + MeasureBand51 + MeasureBand52)/3
AverageSize=#AverageSize#
[MeasureAudioSmoothed52]
Measure=Calc
Formula=#MinBarValue# + (MeasureBand51 + MeasureBand52 + MeasureBand53)/3
AverageSize=#AverageSize#
[MeasureAudioSmoothed53]
Measure=Calc
Formula=#MinBarValue# + (MeasureBand52 + MeasureBand53 + MeasureBand54)/3
AverageSize=#AverageSize#
[MeasureAudioSmoothed54]
Measure=Calc
Formula=#MinBarValue# + (MeasureBand53 + MeasureBand54 + MeasureBand55)/3
AverageSize=#AverageSize#
[MeasureAudioSmoothed55]
Measure=Calc
Formula=#MinBarValue# + (MeasureBand54 + MeasureBand55 + MeasureBand56)/3
AverageSize=#AverageSize#
[MeasureAudioSmoothed56]
Measure=Calc
Formula=#MinBarValue# + (MeasureBand55 + MeasureBand56 + MeasureBand57)/3
AverageSize=#AverageSize#
[MeasureAudioSmoothed57]
Measure=Calc
Formula=#MinBarValue# + (MeasureBand56 + MeasureBand57 + MeasureBand58)/3
AverageSize=#AverageSize#
[MeasureAudioSmoothed58]
Measure=Calc
Formula=#MinBarValue# + (MeasureBand57 + MeasureBand58 + MeasureBand59)/3
AverageSize=#AverageSize#
[MeasureAudioSmoothed59]
Measure=Calc
Formula=#MinBarValue# + (MeasureBand58 + MeasureBand59 + MeasureBand60)/3
AverageSize=#AverageSize#
[MeasureAudioSmoothed60]
Measure=Calc
Formula=#MinBarValue# + (MeasureBand59 + MeasureBand60 + MeasureBand61)/3
AverageSize=#AverageSize#
[MeasureAudioSmoothed61]
Measure=Calc
Formula=#MinBarValue# + (MeasureBand60 + MeasureBand61 + MeasureBand62)/3
AverageSize=#AverageSize#
[MeasureAudioSmoothed62]
Measure=Calc
Formula=#MinBarValue# + (MeasureBand61 + MeasureBand62 + MeasureBand63)/3
AverageSize=#AverageSize#
[MeasureAudioSmoothed63]
Measure=Calc
Formula=#MinBarValue# + (MeasureBand62 + MeasureBand63 + MeasureBand64)/3
AverageSize=#AverageSize#
[MeasureAudioSmoothed64]
Measure=Calc
Formula=#MinBarValue# + (MeasureBand63 + MeasureBand64 + MeasureBand65)/3
AverageSize=#AverageSize#
[MeasureAudioSmoothed65]
Measure=Calc
Formula=#MinBarValue# + (MeasureBand64 + MeasureBand65 + MeasureBand66)/3
AverageSize=#AverageSize#
[MeasureAudioSmoothed66]
Measure=Calc
Formula=#MinBarValue# + (MeasureBand65 + MeasureBand66 + MeasureBand67)/3
AverageSize=#AverageSize#
[MeasureAudioSmoothed67]
Measure=Calc
Formula=#MinBarValue# + (MeasureBand66 + MeasureBand67 + MeasureBand68)/3
AverageSize=#AverageSize#
[MeasureAudioSmoothed68]
Measure=Calc
Formula=#MinBarValue# + (MeasureBand67 + MeasureBand68 + MeasureBand69)/3
AverageSize=#AverageSize#
[MeasureAudioSmoothed69]
Measure=Calc
Formula=#MinBarValue# + (MeasureBand68 + MeasureBand69 + MeasureBand70)/3
AverageSize=#AverageSize#
[MeasureAudioSmoothed70]
Measure=Calc
Formula=#MinBarValue# + (MeasureBand69 + MeasureBand70 + MeasureBand71)/3
AverageSize=#AverageSize#
[MeasureAudioSmoothed71]
Measure=Calc
Formula=#MinBarValue# + (MeasureBand70 + MeasureBand71 + MeasureBand72)/3
AverageSize=#AverageSize#
[MeasureAudioSmoothed72]
Measure=Calc
Formula=#MinBarValue# + (MeasureBand71 + MeasureBand72 + MeasureBand73)/3
AverageSize=#AverageSize#
[MeasureAudioSmoothed73]
Measure=Calc
Formula=#MinBarValue# + (MeasureBand72 + MeasureBand73 + MeasureBand74)/3
AverageSize=#AverageSize#
[MeasureAudioSmoothed74]
Measure=Calc
Formula=#MinBarValue# + (MeasureBand73 + MeasureBand74 + MeasureBand75)/3
AverageSize=#AverageSize#
[MeasureAudioSmoothed75]
Measure=Calc
Formula=#MinBarValue# + (MeasureBand74 + MeasureBand75 + MeasureBand76)/3
AverageSize=#AverageSize#
[MeasureAudioSmoothed76]
Measure=Calc
Formula=#MinBarValue# + (MeasureBand75 + MeasureBand76 + MeasureBand77)/3
AverageSize=#AverageSize#
[MeasureAudioSmoothed77]
Measure=Calc
Formula=#MinBarValue# + (MeasureBand76 + MeasureBand77 + MeasureBand78)/3
AverageSize=#AverageSize#
[MeasureAudioSmoothed78]
Measure=Calc
Formula=#MinBarValue# + (MeasureBand77 + MeasureBand78 + MeasureBand79)/3
AverageSize=#AverageSize#
[MeasureAudioSmoothed79]
Measure=Calc
Formula=#MinBarValue# + (MeasureBand78 + MeasureBand79 + MeasureBand80)/3
AverageSize=#AverageSize#
[MeasureAudioSmoothed80]
Measure=Calc
Formula=#MinBarValue# + (MeasureBand79 + MeasureBand80 + MeasureBand81)/3
AverageSize=#AverageSize#
[MeasureAudioSmoothed81]
Measure=Calc
Formula=#MinBarValue# + (MeasureBand80 + MeasureBand81 + MeasureBand82)/3
AverageSize=#AverageSize#
[MeasureAudioSmoothed82]
Measure=Calc
Formula=#MinBarValue# + (MeasureBand81 + MeasureBand82 + MeasureBand83)/3
AverageSize=#AverageSize#
[MeasureAudioSmoothed83]
Measure=Calc
Formula=#MinBarValue# + (MeasureBand82 + MeasureBand83 + MeasureBand84)/3
AverageSize=#AverageSize#
[MeasureAudioSmoothed84]
Measure=Calc
Formula=#MinBarValue# + (MeasureBand83 + MeasureBand84 + MeasureBand85)/3
AverageSize=#AverageSize#
[MeasureAudioSmoothed85]
Measure=Calc
Formula=#MinBarValue# + (MeasureBand84 + MeasureBand85 + MeasureBand86)/3
AverageSize=#AverageSize#
[MeasureAudioSmoothed86]
Measure=Calc
Formula=#MinBarValue# + (MeasureBand85 + MeasureBand86 + MeasureBand87)/3
AverageSize=#AverageSize#
[MeasureAudioSmoothed87]
Measure=Calc
Formula=#MinBarValue# + (MeasureBand86 + MeasureBand87 + MeasureBand88)/3
AverageSize=#AverageSize#
[MeasureAudioSmoothed88]
Measure=Calc
Formula=#MinBarValue# + (MeasureBand87 + MeasureBand88 + MeasureBand89)/3
AverageSize=#AverageSize#
[MeasureAudioSmoothed89]
Measure=Calc
Formula=#MinBarValue# + (MeasureBand88 + MeasureBand89 + MeasureBand90)/3
AverageSize=#AverageSize#
[MeasureAudioSmoothed90]
Measure=Calc
Formula=#MinBarValue# + (MeasureBand89 + MeasureBand90 + MeasureBand91)/3
AverageSize=#AverageSize#
[MeasureAudioSmoothed91]
Measure=Calc
Formula=#MinBarValue# + (MeasureBand90 + MeasureBand91 + MeasureBand92)/3
AverageSize=#AverageSize#
[MeasureAudioSmoothed92]
Measure=Calc
Formula=#MinBarValue# + (MeasureBand91 + MeasureBand92 + MeasureBand93)/3
AverageSize=#AverageSize#
[MeasureAudioSmoothed93]
Measure=Calc
Formula=#MinBarValue# + (MeasureBand92 + MeasureBand93 + MeasureBand94)/3
AverageSize=#AverageSize#
[MeasureAudioSmoothed94]
Measure=Calc
Formula=#MinBarValue# + (MeasureBand93 + MeasureBand94 + MeasureBand95)/4
AverageSize=#AverageSize#
[MeasureAudioSmoothed95]
Measure=Calc
Formula=#MinBarValue# + (MeasureBand94 + MeasureBand95 + MeasureBand96)/5
AverageSize=#AverageSize#
[MeasureAudioSmoothed96]
Measure=Calc
Formula=#MinBarValue# + (MeasureBand95 + MeasureBand96 + MeasureBand97)/6
AverageSize=#AverageSize#
[MeasureAudioSmoothed97]
Measure=Calc
Formula=#MinBarValue# + (MeasureBand96 + MeasureBand97 + MeasureBand98)/7
AverageSize=#AverageSize#
[MeasureAudioSmoothed98]
Measure=Calc
Formula=#MinBarValue# + (MeasureBand97 + MeasureBand98 + MeasureBand99)/8
AverageSize=#AverageSize#
[MeasureAudioSmoothed99]
Measure=Calc
Formula=#MinBarValue# + (MeasureBand98 + MeasureBand99 + MeasureBand100)/9
AverageSize=#AverageSize#
[MeasureAudioSmoothed100]
Measure=Calc
Formula=#MinBarValue# + (MeasureBand99 + MeasureBand100 + MeasureBand100)/10
AverageSize=#AverageSize#