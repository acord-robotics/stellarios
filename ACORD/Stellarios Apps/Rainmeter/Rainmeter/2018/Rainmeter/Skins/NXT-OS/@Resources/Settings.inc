;                          M@@@@@@@r                          
;                       ;@@@h    ,@@@B                       
;                     3@@@r         M@@@:                       /$$      /$$                               /$$                     /$$
;                   9@@@,     ;r:     h@@@;                    | $$  /$ | $$                              |__/                    | $$
;                 #@@#      B@@@@@s     r@@@3                  | $$ /$$$| $$  /$$$$$$   /$$$$$$  /$$$$$$$  /$$ /$$$$$$$   /$$$$$$ | $$
;              ;@@@G     ,#@@@@@@@@@h     ,@@@S                | $$/$$ $$ $$ |____  $$ /$$__  $$| $$__  $$| $$| $$__  $$ /$$__  $$| $$
;            r@@@s     r@@@@@@Gh#@@@@@B      #@@#              | $$$$_  $$$$  /$$$$$$$| $$  \__/| $$  \ $$| $$| $$  \ $$| $$  \ $$|__/
;          2@@@;     3@@@@@@S     @@@@@@#,     G@@@;           | $$$/ \  $$$ /$$__  $$| $$      | $$  | $$| $$| $$  | $$| $$  | $$    
;        B@@@:     H@@@@@@@@;     @@@@@@@@@;     3@@@r         | $$/   \  $$|  $$$$$$$| $$      | $$  | $$| $$| $$  | $$|  $$$$$$$ /$$
;     :@@@B     :#@@@@@@@@@@s     @@@@@@@@@@@3     r@@@h       |__/     \__/ \_______/|__/      |__/  |__/|__/|__/  |__/ \____  $$|__/
;   ;@@@2     ;@@@@@@@@@@@@@s     @@@@@@@@@@@@@H     :@@@G                                                               /$$  \ $$   
; ;@@@r     s@@@@@@@@@@@@@@@s     @@@@@@@@@@@@@@@#:     B@@B                                                            |  $$$$$$/    
;@@@B     ;@@@@@@@@@@@@@@@@@s     @@@@@@@@@@@@@@@@@@      @@@                                                            \______/    
;#@@@      @@@@@@@@@@@@@@@@@r     @@@@@@@@@@@@@@@@@G      @@@   Do not modify this file. Please use the settings windows in NXT-OS to edit setttings.
;  B@@B     :B@@@@@@@@@@@@@@r     @@@@@@@@@@@@@@@3     r@@@r    Many settings in this file have to be changed through other interfaces, such as the 
;    B@@@:     H@@@@@@@@@@@@@3;,;#@@@@@@@@@@@@@;     h@@@r      ones built in to widgets. 
;      h@@@;     3@@@@@@@@@@@@@@@@@@@@@@@@@@#:     G@@@,     
;        r@@@3     ;@@@@@@@@h     @@@@@@@@G      @@@#           Modifying this file could lead to problems with NXT-OS.
;          ,@@@G     :#@@@@@G     @@@@@@h     ;@@@H          
;             #@@#      G@@@@@@@@@@@@@r     s@@@s            
;               9@@@;     h@@@@@@@@@;     H@@@;              
;                 s@@@r     r@@@@#      M@@@                 
;                   ;@@@S            :@@@G                   
;                     :@@@B        r@@@h                     
;                        B@@@,   3@@@r                       
;                          ;@@@@@@G                          



[Variables]
Animate.Hud=1
Animation.Dock=12
Animation.FPS=16
Animation.Hud=40
Animation.Notify=50

CenterClock.AlbumDisplay=0
CenterClock.AtbgStyle=0
CenterClock.Behavior=Hdd
CenterClock.DriveLetter=C
CenterClock.Glass=1
CenterClock.NoArtStyle=0
CenterClock.Scale=0.56
CenterClock.SmoothSeconds=0
CenterClock.TickStyle=13

Color.Clipboard=0
Color.ClockDot=255,255,255
Color.ClockMain=255,255,255
Color.ClockSecHand=255,255,255,180
Color.ClockSecondary=255,255,255,180
Color.Dock=255,255,255,85
Color.DockFolderBackground=255,255,255
Color.DockFolderText=80,80,80
Color.DockFolderTint=80,80,80
Color.DockIcon=255,255,255
Color.Glass=0,0,0,150
Color.Main=255,255,255
Color.Notification=0
Color.Scout=1
Color.TopLabel=0

Dock.CenterAction=[Shell:::{2559a1f8-21d7-11d4-bdaf-00c04f60b9f0}]
Dock.CenterActionStock=Overlay Launcher
Dock.CenterIcon=Resources\Images\Center\Center.png
Dock.Scale=0.51
Dock.ShowCenterGlass=0
Dock.ShowGlass=0

GameDrawer.Bnet=1
GameDrawer.CloseOnGame=0
GameDrawer.DrawerMode=0
GameDrawer.GameTabPosition=3
GameDrawer.Offset=0
GameDrawer.Steam=0
GameDrawer.SteamPath=C:\Program Files (x86)\Steam
GameDrawer.SteamShortcuts=0
GameDrawer.SteamUserDataID=275924434

GameMode.Enable=1
GameMode.Mode=0
GameMode.Blacklist=chrome|firefox|McUICnt|Microsoft.Photos|
GameMode.Known=SoftwareUpdate|starbound|Minecraft.Windows|javaw|Asphalt8|Steam|
GameMode.Detect=35

LockScreen.Dots=1
LockScreen.Enable=0
LockScreen.SecondDots=0
LockScreen.ShowBG=0
LockScreen.Wallpaper=C:\Users\arbuc\Documents\AoD\star-wars-cyberpunk-ap.jpg
LockScreen.WallpaperB=0
LockScreen.Tint=255

Monitor.MainNum=P
Monitor.MainX=#PSCREENAREAX#
Monitor.MainY=#PSCREENAREAY#
Monitor.MainW=#PSCREENAREAWIDTH#
Monitor.MainH=#PSCREENAREAHEIGHT#

Notification.Battery=0
Notification.CapsLock=0
Notification.Duration=5
Notification.HudDuration=2
Notification.MicCheck=0
Notification.Music=0
Notification.NumLock=0
Notification.Speakers=0
Notification.Update=0

Overlay.Widget.HDD.1=C
Overlay.Widget.HDD.2=D
Overlay.Widget.HDD.3=E
Overlay.Widget.HDD.4=F
Overlay.Widget.Sticky.Text=

Scout.IndexExtensions=lnk;
Scout.IndexInterval=2
Scout.IndexTargets=%SystemDrive%\ProgramData\Microsoft\Windows\Start Menu\Programs|%AppData%\Microsoft\Windows\Start Menu\Programs|
Scout.IndexTime=5
Scout.IndexTimeMod=12
Scout.IndexWin=0
Scout.LastIndex=1553124326
Scout.NextIndex=1553331600
Scout.ShowPath=1

Sound.DockClick=1
Sound.DockScroll=1
Sound.GameHover=1
Sound.GameItemClick=1
Sound.GameLaunch=1
Sound.GameShift=1
Sound.GameTabClick=1
Sound.LockSound=1
Sound.TopClick=1

System.AutoVis=iTunes
System.ClipboardKey=V
System.ClipboardKeyModifier2=ALT
System.ClipboardKeyModifier=CTRL
System.ClipboardKeyState=0
System.DateFormat=%A, %B %#d
System.DateLang=Local
System.DisplayPos=0
System.InputForce=1
System.InstallFinished=1
System.InstallType=Full
System.LockTimeout=0
System.OverlayLauncherKey=F10
System.OverlayLauncherKeyModifier=ALT
System.OverlayLauncherKeyState=0
System.OverlayWidgetsKey=F1
System.OverlayWidgetsKeyModifier=ALT
System.OverlayWidgetsKeyState=0
System.Player=iTunes
System.PlayerPlugin=NowPlaying
System.ScoutKey=F2
System.ScoutKeyModifier=ALT
System.ScoutKeyState=0
System.TimeFormat=0
System.UpdateCheck=5
System.UpdateCheckMod=12
System.UserName=AoD
System.VisualizerMode=0
System.WeatherCode=USCA0273
System.WeatherUnit=0

Top.Quick.AutoHide=0
Top.Quick.Order=command|visualizer|scout|overlaywidgets|overlaylauncher|lock|add|power|rainmeter|dash|drawer|
Top.Quick.ShowLabel=0
Top.Scale=0.65
Top.Widget.Clock.Align=CenterTop
Top.Widget.HDD.Drive1=C
Top.Widget.HDD.Drive2=D
Top.Widget.HDD.Drive3=F
Top.Widget.TextClock.Align=CenterTop
Top.Widget.TextClock.BoldSetting=#FirstWordBold#
Top.Widget.TextClock.Case=None
Top.Widget.TextClock.Date=1
Top.Widget.TextClock.Space=" "
Top.WidgetEditMode=0

Visualizer.Style=Bars
Visualizer.Smoothing=0
Visualizer.NumBars=80
Visualizer.FFTSize=128
Visualizer.FFTOverlap=64
Visualizer.FFTAttack=10
Visualizer.FFTDecay=125
Visualizer.FreqMin=20
Visualizer.FreqMax=160
Visualizer.Sensitivity=55
