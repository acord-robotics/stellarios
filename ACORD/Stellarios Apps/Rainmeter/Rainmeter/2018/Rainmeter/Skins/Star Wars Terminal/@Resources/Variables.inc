[Variables]

{ Colors }

Color1=0,255,255
Color2=0,200,200
ColorW=255,255,255
ColorG=217,250,250
ColorR=255,0,0
ColorB=0,0,0

{ Font }

Font1=Slider
Font2=Star Jedi
Font3=Aurebesh
Font4=Aurebesh Condensed
Font5=Digital
Font6=Jedi
Font7=Gliscor Gothic

{ Rebel Report }

RSStitle=StarWars.com
RSS=http://universetoday.com/feed

{ Server Check }

Name1=Star Wars.com
Site1=www.starwars.com
Port1=443

Name2=Google
Site2=8.8.8.8
Port2=443

Name3=YouTube
Site3=www.youtube.com
Port3=443

Sound=C:\Users\arbuc\OneDrive\Documents\Rainmeter\Skins\Star Wars Terminal\@Resources\sounds\buzzer.wav 

{ Assault & Fighter Status }

Drive1=C:
Drive2=D:
Drive3=E:
Drive4=F:

BarColor=0,0,0
BarSColor=5,27,52
BarBGColor=0,187,255

{ Controls }

Layout1=Star Wars Terminal Blank
Layout2=Star Wars Terminal Main
Layout3=Star Wars Terminal Min

{ Countdown }

Event=The Last Jedi
Year=2017
Month=12
Date=14
Hour=19
Minute=00
Second=00

ImageCD=C:\Users\arbuc\OneDrive\Documents\Rainmeter\Skins\Star Wars Terminal\@Resources\Images/Countdown/TheLastJedi.png
ImageLink=http://www.starwars.com/films/star-wars-episode-viii-the-last-jedi

{FalconNet}

LineUp=71,187,228
LineDown=255,156,91

{ Weather }

Metric=C
Location=USSC0383

{ Music }

MediaP=WMP
RSSTitlt=Space News
