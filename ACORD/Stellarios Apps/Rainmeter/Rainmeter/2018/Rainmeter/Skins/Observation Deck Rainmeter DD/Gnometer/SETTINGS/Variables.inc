; ----------------------
; I HIGHLY RECCOMENDED USING THE CONFIGURATION TOOL (ConfigTool.exe) TO CHANGE SETTINGS
; ConfigTool.exe is located in the same folder as this file
; ----------------------

[Variables]
Style=Vertical
font.Name=Segoe UI
font.SizeTitle=8
font.SizeOther=7
image.GreyScale=0
image.Tint=FFFFFFFF
h.Title=14
h.Other=12
h.Bar=28
h.Item=31
y.Icon=3

color.Title=FFFFFFFF
color.Highlight=EDD400FF
color.Text=FFFFFFCC
color.Dark=00000099
color.Light=00000066
color.Seperator=FFFFFF33

format.Time=locale-time
format.Date=locale-date

disks.Drive1=C:
disks.Drive2=D:
disks.Drive3=E:
disks.Drive4=F:

weather.Zip=FIXX0002
weather.Unit=C
weather.Unit2=m

mail.User=sirhuy85
mail.Pass=sirhuy1985
gcal.URL=

utorrent.User=
utorrent.Pass=

feeds.URL1=http://feeds.gawker.com/gizmodo/excerpts.xml
feeds.URL2=http://twitter.com/statuses/user_timeline/115485051.rss
feeds.URL3=http://www.xkcd.com/atom.xml
feeds.URL4=http://feeds.gawker.com/lifehacker/excerpts.xml
substitute.Item=#Normal#

network.MaxUp=1048576
network.MaxDown=10485760

launcher.App1icon=..\Icons\preferences-other.png
launcher.App1path=C:\Users\SirHuy\Documents\Rainmeter\Skins\Gnometer\SETTINGS\ConfigTool.exe
launcher.App2icon=C:\Users\SirHuy\Documents\Rainmeter\Skins\Gnometer\Launcher\Icons\Excel.png
launcher.App2path=C:\Program Files\Microsoft Office\Office14\EXCEL.EXE
launcher.App3icon=C:\Users\SirHuy\Documents\Rainmeter\Skins\Gnometer\Launcher\Icons\Outlook.png
launcher.App3path=C:\Program Files\Microsoft Office\Office14\OUTLOOK.EXE
launcher.App4icon=C:\Users\SirHuy\Documents\Rainmeter\Skins\Gnometer\Launcher\Icons\PowerPoint.png
launcher.App4path=C:\Program Files\Microsoft Office\Office14\POWERPNT.EXE
launcher.App5icon=C:\Users\SirHuy\Documents\Rainmeter\Skins\Gnometer\Launcher\Icons\Visio.png
launcher.App5path=C:\Program Files\Microsoft Office\Office14\VISIO.EXE
launcher.App6icon=C:\Users\SirHuy\Documents\Rainmeter\Skins\Gnometer\Launcher\Icons\Word.png
launcher.App6path=C:\Program Files\Microsoft Office\Office14\WINWORD.EXE
launcher.App7icon=C:\Users\SirHuy\Documents\Rainmeter\Skins\Gnometer\Launcher\Icons\emblem-art.png
launcher.App7path=C:\Windows\System32\mspaint.exe
launcher.App8icon=..\Icons\question.png
launcher.App8path=
launcher.App9icon=..\Icons\question.png
launcher.App9path=
launcher.App10icon=..\Icons\question.png
launcher.App10path=
launcher.App11icon=..\Icons\question.png
launcher.App11path=
launcher.App12icon=..\Icons\question.png
launcher.App12path=
launcher.App13icon=..\Icons\question.png
launcher.App13path=
launcher.App14icon=..\Icons\question.png
launcher.App14path=
launcher.Folder1icon=C:\Users\SirHuy\Documents\Rainmeter\Skins\Gnometer\Launcher\Icons\folder-pictures (4).png
launcher.Folder1path=D:\Comic 2
launcher.Folder2icon=C:\Users\SirHuy\Documents\Rainmeter\Skins\Gnometer\Launcher\Icons\folder-pictures.png
launcher.Folder2path=E:\Comic
launcher.Folder3icon=C:\Users\SirHuy\Documents\Rainmeter\Skins\Gnometer\Launcher\Icons\folder-downloads (3).png
launcher.Folder3path=C:\Users\SirHuy\Documents\Mipony
launcher.Folder4icon=C:\Users\SirHuy\Documents\Rainmeter\Skins\Gnometer\Launcher\Icons\folder-videos (5).png
launcher.Folder4path=C:\System_Volume_Information_1
launcher.Folder5icon=C:\Users\SirHuy\Documents\Rainmeter\Skins\Gnometer\Launcher\Icons\folder-videos (7).png
launcher.Folder5path=D:\System_Volume_Information_2
launcher.Folder6icon=C:\Users\SirHuy\Documents\Rainmeter\Skins\Gnometer\Launcher\Icons\folder-videos (2).png
launcher.Folder6path=E:\System_Volume_Information_3
launcher.Folder7icon=C:\Users\SirHuy\Documents\Rainmeter\Skins\Gnometer\Launcher\Icons\folder-documents (6).png
launcher.Folder7path=E:\System_Volume_Information_3\SirHuy's Backup
