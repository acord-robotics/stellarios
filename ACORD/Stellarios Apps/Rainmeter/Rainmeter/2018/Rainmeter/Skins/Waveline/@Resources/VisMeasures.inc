[MeasureBand0]
BandIdx=0
Measure=Plugin
Plugin=AudioLevel
Parent=MeasureAudio
Type=Band

[MeasureBand0Calc]
Measure=Calc
Formula=([MeasureBand0]+(#RestingHeight#/100))
DynamicVariables=1

[MeasureBand1]
BandIdx=1
Measure=Plugin
Plugin=AudioLevel
Parent=MeasureAudio
Type=Band

[MeasureBand1Calc]
Measure=Calc
Formula=([MeasureBand1]+(#RestingHeight#/100))
DynamicVariables=1

[MeasureBand2]
BandIdx=2
Measure=Plugin
Plugin=AudioLevel
Parent=MeasureAudio
Type=Band

[MeasureBand2Calc]
Measure=Calc
Formula=([MeasureBand2]+(#RestingHeight#/100))
DynamicVariables=1

[MeasureBand3]
BandIdx=3
Measure=Plugin
Plugin=AudioLevel
Parent=MeasureAudio
Type=Band

[MeasureBand3Calc]
Measure=Calc
Formula=([MeasureBand3]+(#RestingHeight#/100))
DynamicVariables=1

[MeasureBand4]
BandIdx=4
Measure=Plugin
Plugin=AudioLevel
Parent=MeasureAudio
Type=Band

[MeasureBand4Calc]
Measure=Calc
Formula=([MeasureBand4]+(#RestingHeight#/100))
DynamicVariables=1

[MeasureBand5]
BandIdx=5
Measure=Plugin
Plugin=AudioLevel
Parent=MeasureAudio
Type=Band

[MeasureBand5Calc]
Measure=Calc
Formula=([MeasureBand5]+(#RestingHeight#/100))
DynamicVariables=1

[MeasureBand6]
BandIdx=6
Measure=Plugin
Plugin=AudioLevel
Parent=MeasureAudio
Type=Band

[MeasureBand6Calc]
Measure=Calc
Formula=([MeasureBand6]+(#RestingHeight#/100))
DynamicVariables=1

[MeasureBand7]
BandIdx=7
Measure=Plugin
Plugin=AudioLevel
Parent=MeasureAudio
Type=Band

[MeasureBand7Calc]
Measure=Calc
Formula=([MeasureBand7]+(#RestingHeight#/100))
DynamicVariables=1

[MeasureBand8]
BandIdx=8
Measure=Plugin
Plugin=AudioLevel
Parent=MeasureAudio
Type=Band

[MeasureBand8Calc]
Measure=Calc
Formula=([MeasureBand8]+(#RestingHeight#/100))
DynamicVariables=1

[MeasureBand9]
BandIdx=9
Measure=Plugin
Plugin=AudioLevel
Parent=MeasureAudio
Type=Band

[MeasureBand9Calc]
Measure=Calc
Formula=([MeasureBand9]+(#RestingHeight#/100))
DynamicVariables=1

[MeasureBand10]
BandIdx=10
Measure=Plugin
Plugin=AudioLevel
Parent=MeasureAudio
Type=Band

[MeasureBand10Calc]
Measure=Calc
Formula=([MeasureBand10]+(#RestingHeight#/100))
DynamicVariables=1

[MeasureBand11]
BandIdx=11
Measure=Plugin
Plugin=AudioLevel
Parent=MeasureAudio
Type=Band

[MeasureBand11Calc]
Measure=Calc
Formula=([MeasureBand11]+(#RestingHeight#/100))
DynamicVariables=1

[MeasureBand12]
BandIdx=12
Measure=Plugin
Plugin=AudioLevel
Parent=MeasureAudio
Type=Band

[MeasureBand12Calc]
Measure=Calc
Formula=([MeasureBand12]+(#RestingHeight#/100))
DynamicVariables=1

[MeasureBand13]
BandIdx=13
Measure=Plugin
Plugin=AudioLevel
Parent=MeasureAudio
Type=Band

[MeasureBand13Calc]
Measure=Calc
Formula=([MeasureBand13]+(#RestingHeight#/100))
DynamicVariables=1

[MeasureBand14]
BandIdx=14
Measure=Plugin
Plugin=AudioLevel
Parent=MeasureAudio
Type=Band

[MeasureBand14Calc]
Measure=Calc
Formula=([MeasureBand14]+(#RestingHeight#/100))
DynamicVariables=1

[MeasureBand15]
BandIdx=15
Measure=Plugin
Plugin=AudioLevel
Parent=MeasureAudio
Type=Band

[MeasureBand15Calc]
Measure=Calc
Formula=([MeasureBand15]+(#RestingHeight#/100))
DynamicVariables=1

[MeasureBand16]
BandIdx=16
Measure=Plugin
Plugin=AudioLevel
Parent=MeasureAudio
Type=Band

[MeasureBand16Calc]
Measure=Calc
Formula=([MeasureBand16]+(#RestingHeight#/100))
DynamicVariables=1

[MeasureBand17]
BandIdx=17
Measure=Plugin
Plugin=AudioLevel
Parent=MeasureAudio
Type=Band

[MeasureBand17Calc]
Measure=Calc
Formula=([MeasureBand17]+(#RestingHeight#/100))
DynamicVariables=1

[MeasureBand18]
BandIdx=18
Measure=Plugin
Plugin=AudioLevel
Parent=MeasureAudio
Type=Band

[MeasureBand18Calc]
Measure=Calc
Formula=([MeasureBand18]+(#RestingHeight#/100))
DynamicVariables=1

[MeasureBand19]
BandIdx=19
Measure=Plugin
Plugin=AudioLevel
Parent=MeasureAudio
Type=Band

[MeasureBand19Calc]
Measure=Calc
Formula=([MeasureBand19]+(#RestingHeight#/100))
DynamicVariables=1

[MeasureBand20]
BandIdx=20
Measure=Plugin
Plugin=AudioLevel
Parent=MeasureAudio
Type=Band

[MeasureBand20Calc]
Measure=Calc
Formula=([MeasureBand20]+(#RestingHeight#/100))
DynamicVariables=1

[MeasureBand21]
BandIdx=21
Measure=Plugin
Plugin=AudioLevel
Parent=MeasureAudio
Type=Band

[MeasureBand21Calc]
Measure=Calc
Formula=([MeasureBand21]+(#RestingHeight#/100))
DynamicVariables=1

[MeasureBand22]
BandIdx=22
Measure=Plugin
Plugin=AudioLevel
Parent=MeasureAudio
Type=Band

[MeasureBand22Calc]
Measure=Calc
Formula=([MeasureBand22]+(#RestingHeight#/100))
DynamicVariables=1

[MeasureBand23]
BandIdx=23
Measure=Plugin
Plugin=AudioLevel
Parent=MeasureAudio
Type=Band

[MeasureBand23Calc]
Measure=Calc
Formula=([MeasureBand23]+(#RestingHeight#/100))
DynamicVariables=1

[MeasureBand24]
BandIdx=24
Measure=Plugin
Plugin=AudioLevel
Parent=MeasureAudio
Type=Band

[MeasureBand24Calc]
Measure=Calc
Formula=([MeasureBand24]+(#RestingHeight#/100))
DynamicVariables=1

[MeasureBand25]
BandIdx=25
Measure=Plugin
Plugin=AudioLevel
Parent=MeasureAudio
Type=Band

[MeasureBand25Calc]
Measure=Calc
Formula=([MeasureBand25]+(#RestingHeight#/100))
DynamicVariables=1

[MeasureBand26]
BandIdx=26
Measure=Plugin
Plugin=AudioLevel
Parent=MeasureAudio
Type=Band

[MeasureBand26Calc]
Measure=Calc
Formula=([MeasureBand26]+(#RestingHeight#/100))
DynamicVariables=1

[MeasureBand27]
BandIdx=27
Measure=Plugin
Plugin=AudioLevel
Parent=MeasureAudio
Type=Band

[MeasureBand27Calc]
Measure=Calc
Formula=([MeasureBand27]+(#RestingHeight#/100))
DynamicVariables=1

[MeasureBand28]
BandIdx=28
Measure=Plugin
Plugin=AudioLevel
Parent=MeasureAudio
Type=Band

[MeasureBand28Calc]
Measure=Calc
Formula=([MeasureBand28]+(#RestingHeight#/100))
DynamicVariables=1

[MeasureBand29]
BandIdx=29
Measure=Plugin
Plugin=AudioLevel
Parent=MeasureAudio
Type=Band

[MeasureBand29Calc]
Measure=Calc
Formula=([MeasureBand29]+(#RestingHeight#/100))
DynamicVariables=1

[MeasureBand30]
BandIdx=30
Measure=Plugin
Plugin=AudioLevel
Parent=MeasureAudio
Type=Band

[MeasureBand30Calc]
Measure=Calc
Formula=([MeasureBand30]+(#RestingHeight#/100))
DynamicVariables=1