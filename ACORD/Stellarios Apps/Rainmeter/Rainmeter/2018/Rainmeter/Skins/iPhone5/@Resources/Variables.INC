[Variables]

;;;;;;;;;;;;;;;;;;;;;;;;;;;;;;;;;;;;;;;;;;;;;;;;;;;;;;;;;;;;;;;;;
;;;;;;;;;;;;;;;;;;;;;;WALLPAPERS;;;;;;;;;;;;;;;;;;;;;;;;;;;;;;;;;
;;;;;;;;;;;;;;;;;;;;;;;;;;;;;;;;;;;;;;;;;;;;;;;;;;;;;;;;;;;;;;;;;
W1=Wallpaper1.png
W2=Wallpaper2.png
W3=Wallpaper3.png
W4=Wallpaper4.png


;;;;;;;;;;;;;;;;;;;;;;;;;;;;;;;;;;;;;;;;;;;;;;;;;;;;;;;;;;;;;;;;;
;;;;;;;;;;;;;;;;;;;;;;UP AND DOWN SPEEDS;;;;;;;;;;;;;;;;;;;;;;;;;
;;;;;;;;;;;;;;;;;;;;;;F O R   N E T W O R K ;;;;;;;;;;;;;;;;;;;;;
maxDownload=4194304
MaxUpload=33554432



;;;;;;;;;;;;;;;;;;;;;;;;;;;;;;;;;;;;;;;;;;;;;;;;;;;;;;;;;;;;;;;;;
;;;;;;;;;;;;;;;;;;;;;;D R I V E S;;;;;;;;;;;;;;;;;;;;;;;;;;;;;;;;
;;;;;;;;;;;;;;;;;;;;;;;;;;;;;;;;;;;;;;;;;;;;;;;;;;;;;;;;;;;;;;;;;
disk1=C:
disk2=F:
disk3=M:




;;;;;;;;;;;;;;;;;;;;;;;;;;;;;;;;;;;;;;;;;;;;;;;;;;;;;;;;;;;;;;;;;
;;;;;;;;;;;;;;;;;;;;;;GMAIL WIDGET ;;;;;;;;;;;;;;;;;;;;;;;;;;;;;;
;;;;;;;;;;;;;;;;;;;;;;;;;;;;;;;;;;;;;;;;;;;;;;;;;;;;;;;;;;;;;;;;;
;GMAIL WIDGET SETTINGS
GmailID=
GmailPassword=
colorforgmailwidget=0,0,0


;;;;;;;;;;;;;;;;;;;;;;;;;;;;;;;;;;;;;;;;;;;;;;;;;;;;;;;;;;;;;;;;;
;;;;;;;;;;;;;;;;;;;;;;A P P S & I C O N S ;;;;;;;;;;;;;;;;;;;;;;;
;;;;;;;;;;;;;;;;;;;;;;;;;;;;;;;;;;;;;;;;;;;;;;;;;;;;;;;;;;;;;;;;;

;;;;;;;;;;;;;;;;;;;;;;;;;;;;;;;;;;;;;Row 1
;App1
Icon1=#@#Mail_Icon.png
Action1=https://mail.google.com
ToolTipText1=GMail

;App2
Icon2=#@#Google_Talk_Icon.png
Action2=C:\Program Files (x86)\Google\Google Talk\googletalk.exe
ToolTipText2=Google Talk

;App3
Icon3=#@#Google_Chrome_Icon.png
Action3=www.google.com
ToolTipText3=Google Chrome

;App4
Icon4=#@#Blank_Calendar_Icon.png
Action4=https://www.icloud.com/#calendar
ToolTipText4=Calendar

;;;;;;;;;;;;;;;;;;;;;;;;;;;;;;;;;;;;;Row 2
;App5
Icon5=#@#Contacts_Icon.png
Action5=https://www.icloud.com/#contacts
ToolTipText5=Contacts

;App6
Icon6=#@#Notes_Icon.png
Action6=https://www.icloud.com/#notes
ToolTipText6=Notes

;App7
Icon7=#@#Reminders_Icon.png
Action7=https://www.icloud.com/#reminders
ToolTipText7=Reminders

;App8
Icon8=#@#Find_My_iPhone_Icon.png
Action8=https://www.icloud.com/#find
ToolTipText8=Find My iPhone

;;;;;;;;;;;;;;;;;;;;;;;;;;;;;;;;;;;;;Row 3
;App9
Icon9=#@#Calculator_Icon.png
Action9=%windir%\system32\calc.exe
ToolTipText9=Calculator

;App10=
Icon10=#@#Blank_Clock_Icon.png
Action10=Shell:::{E2E7934B-DCE5-43C4-9576-7FE4F75E7480}
ToolTipText10=Time

;App11
Icon11=#@#Weather_Icon.png
Action11=http://www.weather.com/weather/5-day/Belton+SC+29627:4:US
ToolTipText11=What's the weather like today?

;App12
Icon12=#@#Settings_Icon.png
;Action12=
ToolTipText12=Settings


;;;;;;;;;;;;;;;;;;;;;;;;;;;;;;;;;;;;;Row 4
;App13
Icon13=#@#MSecure_Icon.png
Action13="C:\Program Files (x86)\mSeven Software\mSecure\"
ToolTipText13=MSecure

;App14=
Icon14=#@#Steam_Icon.png
Action14="C:\Program Files (x86)\Steam\Steam.exe"
ToolTipText14=Steam..Get your Game ON!!!

;App15=
Icon15=#@#App_Store_Icon.png
Action15=
ToolTipText15=Install Apps

;App16=
Icon16=#@#
Action16=
ToolTipText16=


;;;;;;;;;;;;;;;;;;;;;;;;;;;;;;;;;;;;;Bottom Row
;App17=
Icon17=#@#Computer_Icon.png
Action17=Shell:::{20d04fe0-3aea-1069-a2d8-08002b30309d}
ToolTipText17=My Computer

;App18=
Icon18=#@#DropBox_Icon.png
Action18=C:\Users\shawn\Dropbox
ToolTipText18=DropBox

;App19=
Icon19=#@#
Action19=
ToolTipText19=

;App20=
Icon20=#@#Windows_Icon.png
;Action20=!Execute ["#CURRENTPATH#StartMenu\OpenStartMenu.exe"]
ToolTipText20=Windows Start Menu



;;;;;;;;;;;;;;;;;;;;;;;;;;;;;;;;;;;;;;;;;;;;;;;;;;;;;;;;;;;;;;;;;;;;;;;;;;;;;;
;;;;;;;;;;;;;;;;;;;;;;;;;;;;;;;;;;;;;Page2;;;;;;;;;;;;;;;;;;;;;;;;;;;;;;;;;;;;
;;;;;;;;;;;;;;;;;;;;;;;;;;;;;;;;;;;;;;;;;;;;;;;;;;;;;;;;;;;;;;;;;;;;;;;;;;;;;;

;;;;;;;;;;;;;;;;;;;;;;;;;;;;;;;;;;;;;Row 1
;App21
Icon21=#@#Handbrake_Icon.png
Action21="C:\Program Files\Handbrake\Handbrake.exe"
ToolTipText21=Handbrake

;App22=
Icon22=#@#Mp3tag_Icon.png
Action22="C:\Program Files (x86)\Mp3tag\Mp3tag.exe"
ToolTipText22=Mp3 Tag

;App23=
Icon23=#@#Freemake_Icon.png
Action23="C:\Program Files (x86)\Freemake\Freemake Video Converter\FreemakeVideoConverter.exe"
ToolTipText23=Freemake

;App24=
Icon24=#@#Notepad++_Icon.png
Action24="C:\Program Files (x86)\Notepad++\notepad++.exe"
ToolTipText24=Notepad ++

;;;;;;;;;;;;;;;;;;;;;;;;;;;;;;;;;;;;;Row 2
;App25=
Icon25=#@#iTunes_Icon.png
Action25="C:\Program Files (x86)\iTunes\iTunes.exe"
ToolTipText25=iTunes

;App26=
Icon26=#@#Plex_Icon.png
Action26=http://127.0.0.1:32400/web/index.html#!/dashboard
ToolTipText26=Plex Media Server

;App27=
Icon27=#@#YouTube_Icon.png
Action27=http://www.youtube.com/
ToolTipText27=YouTube

;App28=
Icon28=#@#iPod_Icon.png
Action28=!Toggle "Nano3gBlack"
ToolTipText28=

;;;;;;;;;;;;;;;;;;;;;;;;;;;;;;;;;;;;;Row 3
;App29=
Icon29=#@#Photos_Icon.png
Action29=M:\Pictures
ToolTipText29=Photos

;App30
Icon30=#@#Videos_Icon.png
Action30=M:\Movies
ToolTipText30=Movies

;App31
Icon31=#@#TVShows_Icon.png
Action31=M:\TV Shows
ToolTipText31=TV Shows

;App32
Icon32=#@#Music_Icon.png
Action32=M:\Music
ToolTipText32=Music

;;;;;;;;;;;;;;;;;;;;;;;;;;;;;;;;;;;;;Row 4
;App33=
Icon33=#@#
Action33=
ToolTipText33=

;App34
Icon34=#@#
Action34=
ToolTipText34=

;App35
Icon35=#@#
Action35=
ToolTipText35=

;App36
Icon36=#@#
Action36=
ToolTipText36=


;;;;;;;;;;;;;;;;;;;;;;;;;;;;;;;;;;;;;;;;;;;;;;;;;;;;;;;;;;;;;;;;;;;;;;;;;;;;;;
;;;;;;;;;;;;;;;;;;;;;;;;;;;;;;;;;;;;;Page3;;;;;;;;;;;;;;;;;;;;;;;;;;;;;;;;;;;;
;;;;;;;;;;;;;;;;;;;;;;;;;;;;;;;;;;;;;;;;;;;;;;;;;;;;;;;;;;;;;;;;;;;;;;;;;;;;;;

;;;;;;;;;;;;;;;;;;;;;;;;;;;;;;;;;;;;;Row 1
;App37
Icon37=#@#
Action37=
ToolTipText37=

;App38
Icon38=#@#
Action38=
ToolTipText38=

;App39
Icon39=#@#
Action39=
ToolTipText39=

;App40
Icon40=#@#
Action40=
ToolTipText40=



;;;;;;;;;;;;;;;;;;;;;;;;;;;;;;;;;;;;;;;;;;;;;;;;;;;;;;;;;;;;;;;;;
;;;;;;;;;;;;;;;;;;;;;;P O S I T I O N S;;;;;;;;;;;;;;;;;;;;;;;;;;
;;;;;;;;;;;;;;;;;;;;;;;;;;;;;;;;;;;;;;;;;;;;;;;;;;;;;;;;;;;;;;;;;
;Position1
X1=35
Y1=110

;Position2
X2=90
Y2=110

;Position3
X3=145
Y3=110

;Position4
X4=200
Y4=110

;Position5
X5=35
Y5=180

;Position6
X6=90
Y6=180

;Position7
X7=145
Y7=180

;Position8
X8=200
Y8=180

;Position9
X9=35
Y9=250

;Position10
X10=90
Y10=250

;Position11
X11=145
Y11=250

;Position12
X12=200
Y12=250

;Position13
X13=35
Y13=320

;Position14
X14=90
Y14=320

;Position15
X15=145
Y15=320

;Position16
X16=200
Y16=320

;Position17
X17=35
Y17=410

;Position18
X18=90
Y18=410

;Position19
X19=145
Y19=410

;Position20
X20=200
Y20=410

;Position21
X21=35
Y21=110

;Position22
X22=90
Y22=110

;Position23
X23=145
Y23=110

;Position24
X24=200
Y24=110

;Position25
X25=35
Y25=180

;Position26
X26=90
Y26=180

;Position27
X27=145
Y27=180

;Position28
X28=200
Y28=180

;Position29
X29=35
Y29=250

;Position30
X30=90
Y30=250

;Position31
X31=145
Y31=250

;Position32
X32=200
Y32=250



;;;;;;;;;;;;;;;;;;;;;;;;;;;;;;;;;;;;;;;;;;;;;;;;;;;;;;;;;;;;;;;;;
;;;;;;;;;;;;;;;;;;;;;;STATES FOR WIDGETS;;;;;;;;;;;;;;;;;;;;;;;;;
;;;;;;;;;;;;;;;;;;;;;;DO NOT ADJUST;;;;;;;;;;;;;;;;;;;;;;;;;;;;;;
;STATE
Hidden=1
Hidden2=1
Hidden3=1
Hidden4=1
Hidden5=1
Hidden6=1






















