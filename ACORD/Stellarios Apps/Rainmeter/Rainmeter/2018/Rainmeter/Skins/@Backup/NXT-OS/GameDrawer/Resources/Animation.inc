[TileAnimation]
Measure=Plugin
Plugin=ActionTimer
ActionList1=Zoom1_I_0|Zoom1_I_1|Wait 20|Zoom1_I_2|Wait 20|Zoom1_I_3
ActionList2=Zoom1_O_0|Zoom1_O_1|Wait 20|Zoom1_O_2|Wait 20|Zoom1_O_3
ActionList3=Zoom1_D_1|Wait 20|Zoom1_D_2|Wait 20|Zoom1_D_3|Wait 20|Zoom1_D_4|Wait 20|Zoom1_D_5|Wait 20|Zoom1_D_6
Zoom1_I_0=[!CommandMeasure TileAnimation "Stop 2"]
Zoom1_I_1=[!SetOption "Game1" "W" "244"][!SetOption "Game1" "H" "114"][!SetOption "Game1" "Padding" "4,2,4,2"][!UpdateMeter "Game1"][!Redraw]
Zoom1_I_2=[!SetOption "Game1" "W" "248"][!SetOption "Game1" "H" "116"][!SetOption "Game1" "Padding" "2,1,2,1"][!UpdateMeter "Game1"][!Redraw]
Zoom1_I_3=[!SetOption "Game1" "W" "252"][!SetOption "Game1" "H" "118"][!SetOption "Game1" "Padding" "0,0,0,0"][!UpdateMeter "Game1"][!Redraw]
Zoom1_O_0=[!CommandMeasure TileAnimation "Stop 1"]
Zoom1_O_1=[!SetOption "Game1" "W" "248"][!SetOption "Game1" "H" "116"][!SetOption "Game1" "Padding" "2,1,2,1"][!UpdateMeter "Game1"][!Redraw]
Zoom1_O_2=[!SetOption "Game1" "W" "244"][!SetOption "Game1" "H" "114"][!SetOption "Game1" "Padding" "4,2,4,2"][!UpdateMeter "Game1"][!Redraw]
Zoom1_O_3=[!SetOption "Game1" "W" "240"][!SetOption "Game1" "H" "112"][!SetOption "Game1" "Padding" "6,3,6,3"][!UpdateMeter "Game1"][!Redraw]
Zoom1_D_1=[!SetOption "Game1" "W" "248"][!SetOption "Game1" "H" "116"][!SetOption "Game1" "Padding" "2,1,2,1"][!UpdateMeter "Game1"][!Redraw]
Zoom1_D_2=[!SetOption "Game1" "W" "244"][!SetOption "Game1" "H" "114"][!SetOption "Game1" "Padding" "4,2,4,2"][!UpdateMeter "Game1"][!Redraw]
Zoom1_D_3=[!SetOption "Game1" "W" "240"][!SetOption "Game1" "H" "112"][!SetOption "Game1" "Padding" "6,3,6,3"][!UpdateMeter "Game1"][!Redraw]
Zoom1_D_4=[!SetOption "Game1" "W" "236"][!SetOption "Game1" "H" "110"][!SetOption "Game1" "Padding" "8,4,8,4"][!UpdateMeter "Game1"][!Redraw]
Zoom1_D_5=[!SetOption "Game1" "W" "232"][!SetOption "Game1" "H" "108"][!SetOption "Game1" "Padding" "10,5,10,5"][!UpdateMeter "Game1"][!Redraw]
Zoom1_D_6=[!SetOption "Game1" "W" "228"][!SetOption "Game1" "H" "106"][!SetOption "Game1" "Padding" "12,6,12,6"][!UpdateMeter "Game1"][!Redraw]
ActionList4=Zoom2_I_0|Zoom2_I_1|Wait 20|Zoom2_I_2|Wait 20|Zoom2_I_3
ActionList5=Zoom2_O_0|Zoom2_O_1|Wait 20|Zoom2_O_2|Wait 20|Zoom2_O_3
ActionList6=Zoom2_D_1|Wait 20|Zoom2_D_2|Wait 20|Zoom2_D_3|Wait 20|Zoom2_D_4|Wait 20|Zoom2_D_5|Wait 20|Zoom2_D_6
Zoom2_I_0=[!CommandMeasure TileAnimation "Stop 5"]
Zoom2_I_1=[!SetOption "Game2" "W" "244"][!SetOption "Game2" "H" "114"][!SetOption "Game2" "Padding" "4,2,4,2"][!UpdateMeter "Game2"][!Redraw]
Zoom2_I_2=[!SetOption "Game2" "W" "248"][!SetOption "Game2" "H" "116"][!SetOption "Game2" "Padding" "2,1,2,1"][!UpdateMeter "Game2"][!Redraw]
Zoom2_I_3=[!SetOption "Game2" "W" "252"][!SetOption "Game2" "H" "118"][!SetOption "Game2" "Padding" "0,0,0,0"][!UpdateMeter "Game2"][!Redraw]
Zoom2_O_0=[!CommandMeasure TileAnimation "Stop 4"]
Zoom2_O_1=[!SetOption "Game2" "W" "248"][!SetOption "Game2" "H" "116"][!SetOption "Game2" "Padding" "2,1,2,1"][!UpdateMeter "Game2"][!Redraw]
Zoom2_O_2=[!SetOption "Game2" "W" "244"][!SetOption "Game2" "H" "114"][!SetOption "Game2" "Padding" "4,2,4,2"][!UpdateMeter "Game2"][!Redraw]
Zoom2_O_3=[!SetOption "Game2" "W" "240"][!SetOption "Game2" "H" "112"][!SetOption "Game2" "Padding" "6,3,6,3"][!UpdateMeter "Game2"][!Redraw]
Zoom2_D_1=[!SetOption "Game2" "W" "248"][!SetOption "Game2" "H" "116"][!SetOption "Game2" "Padding" "2,1,2,1"][!UpdateMeter "Game2"][!Redraw]
Zoom2_D_2=[!SetOption "Game2" "W" "244"][!SetOption "Game2" "H" "114"][!SetOption "Game2" "Padding" "4,2,4,2"][!UpdateMeter "Game2"][!Redraw]
Zoom2_D_3=[!SetOption "Game2" "W" "240"][!SetOption "Game2" "H" "112"][!SetOption "Game2" "Padding" "6,3,6,3"][!UpdateMeter "Game2"][!Redraw]
Zoom2_D_4=[!SetOption "Game2" "W" "236"][!SetOption "Game2" "H" "110"][!SetOption "Game2" "Padding" "8,4,8,4"][!UpdateMeter "Game2"][!Redraw]
Zoom2_D_5=[!SetOption "Game2" "W" "232"][!SetOption "Game2" "H" "108"][!SetOption "Game2" "Padding" "10,5,10,5"][!UpdateMeter "Game2"][!Redraw]
Zoom2_D_6=[!SetOption "Game2" "W" "228"][!SetOption "Game2" "H" "106"][!SetOption "Game2" "Padding" "12,6,12,6"][!UpdateMeter "Game2"][!Redraw]
ActionList7=Zoom3_I_0|Zoom3_I_1|Wait 20|Zoom3_I_2|Wait 20|Zoom3_I_3
ActionList8=Zoom3_O_0|Zoom3_O_1|Wait 20|Zoom3_O_2|Wait 20|Zoom3_O_3
ActionList9=Zoom3_D_1|Wait 20|Zoom3_D_2|Wait 20|Zoom3_D_3|Wait 20|Zoom3_D_4|Wait 20|Zoom3_D_5|Wait 20|Zoom3_D_6
Zoom3_I_0=[!CommandMeasure TileAnimation "Stop 8"]
Zoom3_I_1=[!SetOption "Game3" "W" "244"][!SetOption "Game3" "H" "114"][!SetOption "Game3" "Padding" "4,2,4,2"][!UpdateMeter "Game3"][!Redraw]
Zoom3_I_2=[!SetOption "Game3" "W" "248"][!SetOption "Game3" "H" "116"][!SetOption "Game3" "Padding" "2,1,2,1"][!UpdateMeter "Game3"][!Redraw]
Zoom3_I_3=[!SetOption "Game3" "W" "252"][!SetOption "Game3" "H" "118"][!SetOption "Game3" "Padding" "0,0,0,0"][!UpdateMeter "Game3"][!Redraw]
Zoom3_O_0=[!CommandMeasure TileAnimation "Stop 7"]
Zoom3_O_1=[!SetOption "Game3" "W" "248"][!SetOption "Game3" "H" "116"][!SetOption "Game3" "Padding" "2,1,2,1"][!UpdateMeter "Game3"][!Redraw]
Zoom3_O_2=[!SetOption "Game3" "W" "244"][!SetOption "Game3" "H" "114"][!SetOption "Game3" "Padding" "4,2,4,2"][!UpdateMeter "Game3"][!Redraw]
Zoom3_O_3=[!SetOption "Game3" "W" "240"][!SetOption "Game3" "H" "112"][!SetOption "Game3" "Padding" "6,3,6,3"][!UpdateMeter "Game3"][!Redraw]
Zoom3_D_1=[!SetOption "Game3" "W" "248"][!SetOption "Game3" "H" "116"][!SetOption "Game3" "Padding" "2,1,2,1"][!UpdateMeter "Game3"][!Redraw]
Zoom3_D_2=[!SetOption "Game3" "W" "244"][!SetOption "Game3" "H" "114"][!SetOption "Game3" "Padding" "4,2,4,2"][!UpdateMeter "Game3"][!Redraw]
Zoom3_D_3=[!SetOption "Game3" "W" "240"][!SetOption "Game3" "H" "112"][!SetOption "Game3" "Padding" "6,3,6,3"][!UpdateMeter "Game3"][!Redraw]
Zoom3_D_4=[!SetOption "Game3" "W" "236"][!SetOption "Game3" "H" "110"][!SetOption "Game3" "Padding" "8,4,8,4"][!UpdateMeter "Game3"][!Redraw]
Zoom3_D_5=[!SetOption "Game3" "W" "232"][!SetOption "Game3" "H" "108"][!SetOption "Game3" "Padding" "10,5,10,5"][!UpdateMeter "Game3"][!Redraw]
Zoom3_D_6=[!SetOption "Game3" "W" "228"][!SetOption "Game3" "H" "106"][!SetOption "Game3" "Padding" "12,6,12,6"][!UpdateMeter "Game3"][!Redraw]
ActionList10=Zoom4_I_0|Zoom4_I_1|Wait 20|Zoom4_I_2|Wait 20|Zoom4_I_3
ActionList11=Zoom4_O_0|Zoom4_O_1|Wait 20|Zoom4_O_2|Wait 20|Zoom4_O_3
ActionList12=Zoom4_D_1|Wait 20|Zoom4_D_2|Wait 20|Zoom4_D_3|Wait 20|Zoom4_D_4|Wait 20|Zoom4_D_5|Wait 20|Zoom4_D_6
Zoom4_I_0=[!CommandMeasure TileAnimation "Stop 11"]
Zoom4_I_1=[!SetOption "Game4" "W" "244"][!SetOption "Game4" "H" "114"][!SetOption "Game4" "Padding" "4,2,4,2"][!UpdateMeter "Game4"][!Redraw]
Zoom4_I_2=[!SetOption "Game4" "W" "248"][!SetOption "Game4" "H" "116"][!SetOption "Game4" "Padding" "2,1,2,1"][!UpdateMeter "Game4"][!Redraw]
Zoom4_I_3=[!SetOption "Game4" "W" "252"][!SetOption "Game4" "H" "118"][!SetOption "Game4" "Padding" "0,0,0,0"][!UpdateMeter "Game4"][!Redraw]
Zoom4_O_0=[!CommandMeasure TileAnimation "Stop 10"]
Zoom4_O_1=[!SetOption "Game4" "W" "248"][!SetOption "Game4" "H" "116"][!SetOption "Game4" "Padding" "2,1,2,1"][!UpdateMeter "Game4"][!Redraw]
Zoom4_O_2=[!SetOption "Game4" "W" "244"][!SetOption "Game4" "H" "114"][!SetOption "Game4" "Padding" "4,2,4,2"][!UpdateMeter "Game4"][!Redraw]
Zoom4_O_3=[!SetOption "Game4" "W" "240"][!SetOption "Game4" "H" "112"][!SetOption "Game4" "Padding" "6,3,6,3"][!UpdateMeter "Game4"][!Redraw]
Zoom4_D_1=[!SetOption "Game4" "W" "248"][!SetOption "Game4" "H" "116"][!SetOption "Game4" "Padding" "2,1,2,1"][!UpdateMeter "Game4"][!Redraw]
Zoom4_D_2=[!SetOption "Game4" "W" "244"][!SetOption "Game4" "H" "114"][!SetOption "Game4" "Padding" "4,2,4,2"][!UpdateMeter "Game4"][!Redraw]
Zoom4_D_3=[!SetOption "Game4" "W" "240"][!SetOption "Game4" "H" "112"][!SetOption "Game4" "Padding" "6,3,6,3"][!UpdateMeter "Game4"][!Redraw]
Zoom4_D_4=[!SetOption "Game4" "W" "236"][!SetOption "Game4" "H" "110"][!SetOption "Game4" "Padding" "8,4,8,4"][!UpdateMeter "Game4"][!Redraw]
Zoom4_D_5=[!SetOption "Game4" "W" "232"][!SetOption "Game4" "H" "108"][!SetOption "Game4" "Padding" "10,5,10,5"][!UpdateMeter "Game4"][!Redraw]
Zoom4_D_6=[!SetOption "Game4" "W" "228"][!SetOption "Game4" "H" "106"][!SetOption "Game4" "Padding" "12,6,12,6"][!UpdateMeter "Game4"][!Redraw]
