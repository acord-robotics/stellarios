<Name>Welcome</Name><Description>The NXT-OS welcome center.</Description><Icon>NXT-OS\@Resources\Images\Icons\Welcome.png</Icon><Launch>[!ActivateConfig "NXT-OS\WelcomeCenter" "Welcome.ini"]</Launch><Active>true</Active>
<Name>Info</Name><Description>The NXT-OS info screen.</Description><Icon>NXT-OS\@Resources\Images\Icons\Info.png</Icon><Launch>[!ActivateConfig "NXT-OS\Info" "Info.ini"]</Launch><Active>true</Active>
<Name>Updates</Name><Description>The NXT-OS update center.</Description><Icon>NXT-OS\@Resources\Images\Icons\Updates.png</Icon><Launch>[!ActivateConfig "NXT-OS\System\Updater" "Updater.ini"]</Launch><Active>true</Active>
<Name>Help Center</Name><Description>The NXT-OS help center.</Description><Icon>NXT-OS\@Resources\Images\Icons\Help.png</Icon><Launch>[!ActivateConfig "NXT-OS\System\Help" "Help.ini"]</Launch><Active>true</Active>
<Name>Settings</Name><Description>The NXT-OS settings menu.</Description><Icon>NXT-OS\@Resources\Images\Icons\Settings.png</Icon><Launch>[!ActivateConfig "NXT-OS\Settings" "Settings.ini"]</Launch><Active>true</Active>
<Name>Reminders</Name><Description>The NXT-OS desktop reminders app.</Description><Icon>NXT-OS\@Resources\Images\Icons\Reminders.png</Icon><Launch>[!ActivateConfig "NXT-OS\Reminders" "Reminders.ini"]</Launch><Active>true</Active>
<Name>Notes</Name><Description>The NXT-OS desktop notes app.</Description><Icon>NXT-OS\@Resources\Images\Icons\Notes.png</Icon><Launch>[!ActivateConfig "NXT-OS\Notes" "Notes.ini"]</Launch><Active>true</Active>
<Name>Activity Monitor</Name><Description>The NXT-OS activity monitor.</Description><Icon>NXT-OS\@Resources\Images\Icons\ActivityMonitor.png</Icon><Launch>[!ActivateConfig "NXT-OS\ActivityMonitor" "ActivityMonitor.ini"]</Launch><Active>true</Active>
<Name>Calculator</Name><Description>The NXT-OS desktop calculator app.</Description><Icon>NXT-OS\@Resources\Images\Icons\Calculator.png</Icon><Launch>[!ActivateConfig "NXT-OS\Calculator" "Calculator.ini"]</Launch><Active>true</Active>