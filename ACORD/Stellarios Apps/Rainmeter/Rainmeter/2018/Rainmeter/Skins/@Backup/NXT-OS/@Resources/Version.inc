;                          M@@@@@@@r                          
;                       ;@@@h    ,@@@B                       
;                     3@@@r         M@@@:                       /$$      /$$                               /$$                     /$$
;                   9@@@,     ;r:     h@@@;                    | $$  /$ | $$                              |__/                    | $$
;                 #@@#      B@@@@@s     r@@@3                  | $$ /$$$| $$  /$$$$$$   /$$$$$$  /$$$$$$$  /$$ /$$$$$$$   /$$$$$$ | $$
;              ;@@@G     ,#@@@@@@@@@h     ,@@@S                | $$/$$ $$ $$ |____  $$ /$$__  $$| $$__  $$| $$| $$__  $$ /$$__  $$| $$
;            r@@@s     r@@@@@@Gh#@@@@@B      #@@#              | $$$$_  $$$$  /$$$$$$$| $$  \__/| $$  \ $$| $$| $$  \ $$| $$  \ $$|__/
;          2@@@;     3@@@@@@S     @@@@@@#,     G@@@;           | $$$/ \  $$$ /$$__  $$| $$      | $$  | $$| $$| $$  | $$| $$  | $$    
;        B@@@:     H@@@@@@@@;     @@@@@@@@@;     3@@@r         | $$/   \  $$|  $$$$$$$| $$      | $$  | $$| $$| $$  | $$|  $$$$$$$ /$$
;     :@@@B     :#@@@@@@@@@@s     @@@@@@@@@@@3     r@@@h       |__/     \__/ \_______/|__/      |__/  |__/|__/|__/  |__/ \____  $$|__/
;   ;@@@2     ;@@@@@@@@@@@@@s     @@@@@@@@@@@@@H     :@@@G                                                               /$$  \ $$   
; ;@@@r     s@@@@@@@@@@@@@@@s     @@@@@@@@@@@@@@@#:     B@@B                                                            |  $$$$$$/    
;@@@B     ;@@@@@@@@@@@@@@@@@s     @@@@@@@@@@@@@@@@@@      @@@                                                            \______/    
;#@@@      @@@@@@@@@@@@@@@@@r     @@@@@@@@@@@@@@@@@G      @@@   Do not modify this file. This file is used by NXT-OS' update system.
;  B@@B     :B@@@@@@@@@@@@@@r     @@@@@@@@@@@@@@@3     r@@@r     
;    B@@@:     H@@@@@@@@@@@@@3;,;#@@@@@@@@@@@@@;     h@@@r    
;      h@@@;     3@@@@@@@@@@@@@@@@@@@@@@@@@@#:     G@@@,     
;        r@@@3     ;@@@@@@@@h     @@@@@@@@G      @@@#           Modifying this file could lead to errors when NXT-OS is installing updates.
;          ,@@@G     :#@@@@@G     @@@@@@h     ;@@@H          
;             #@@#      G@@@@@@@@@@@@@r     s@@@s            
;               9@@@;     h@@@@@@@@@;     H@@@;              
;                 s@@@r     r@@@@#      M@@@                 
;                   ;@@@S            :@@@G                   
;                     :@@@B        r@@@h                     
;                        B@@@,   3@@@r                       
;                          ;@@@@@@G                          


[Variables]
SYS.Version=3.1.4
SYS.OldVersion=0
SYS.CodeName=Perpetual Megalodon
