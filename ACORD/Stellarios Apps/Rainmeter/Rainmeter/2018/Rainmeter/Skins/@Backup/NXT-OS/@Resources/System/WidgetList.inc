<Name>Battery</Name><IconPath>Widgets\Battery\Icon.png</IconPath><LaunchPath>NXT-OS\Dash\Widgets\Battery</LaunchPath><Ini>Widget.ini</Ini>
<Name>Clock</Name><IconPath>Widgets\Clock\Icon.png</IconPath><LaunchPath>NXT-OS\Dash\Widgets\Clock</LaunchPath><Ini>Widget.ini</Ini>
<Name>Timer</Name><IconPath>Widgets\Timer\Icon.png</IconPath><LaunchPath>NXT-OS\Dash\Widgets\Timer</LaunchPath><Ini>Widget.ini</Ini>
<Name>Stopwatch</Name><IconPath>Widgets\Stopwatch\Icon.png</IconPath><LaunchPath>NXT-OS\Dash\Widgets\Stopwatch</LaunchPath><Ini>Widget.ini</Ini>
<Name>Calendar</Name><IconPath>Widgets\Calendar\Icon.png</IconPath><LaunchPath>NXT-OS\Dash\Widgets\Calendar</LaunchPath><Ini>Widget.ini</Ini>
<Name>Weather</Name><IconPath>Widgets\Weather\Icon.png</IconPath><LaunchPath>NXT-OS\Dash\Widgets\Weather</LaunchPath><Ini>Widget.ini</Ini>
<Name>Sticky Note</Name><IconPath>Widgets\Sticky\Icon.png</IconPath><LaunchPath>NXT-OS\Dash\Widgets\Sticky</LaunchPath><Ini>Widget.ini</Ini>
<Name>Calculator</Name><IconPath>Widgets\Calculator\Icon.png</IconPath><LaunchPath>NXT-OS\Dash\Widgets\Calculator</LaunchPath><Ini>Widget.ini</Ini>
<Name>Reminders</Name><IconPath>Widgets\Reminders\Icon.png</IconPath><LaunchPath>NXT-OS\Dash\Widgets\Reminders</LaunchPath><Ini>Widget.ini</Ini>
<Name>Media Buttons</Name><IconPath>Widgets\MediaKeys\Icon.png</IconPath><LaunchPath>NXT-OS\Dash\Widgets\MediaKeys</LaunchPath><Ini>Widget.ini</Ini>
<Name>Resource Gauge</Name><IconPath>Widgets\ResourceMonitor\Icon.png</IconPath><LaunchPath>NXT-OS\Dash\Widgets\ResourceMonitor</LaunchPath><Ini>Widget.ini</Ini>
<Name>Network Monitor</Name><IconPath>Widgets\NetworkMonitor\Icon.png</IconPath><LaunchPath>NXT-OS\Dash\Widgets\NetworkMonitor</LaunchPath><Ini>Widget.ini</Ini>
<Name>Switch Sound</Name><IconPath>Widgets\SwitchSound\Icon.png</IconPath><LaunchPath>NXT-OS\Dash\Widgets\SwitchSound</LaunchPath><Ini>Widget.ini</Ini>
<Name>HDD Meter 1</Name><IconPath>Widgets\HDD1\Icon.png</IconPath><LaunchPath>NXT-OS\Dash\Widgets\HDD1</LaunchPath><Ini>Widget.ini</Ini>
<Name>HDD Meter 2</Name><IconPath>Widgets\HDD2\Icon.png</IconPath><LaunchPath>NXT-OS\Dash\Widgets\HDD2</LaunchPath><Ini>Widget.ini</Ini>
<Name>HDD Meter 3</Name><IconPath>Widgets\HDD3\Icon.png</IconPath><LaunchPath>NXT-OS\Dash\Widgets\HDD3</LaunchPath><Ini>Widget.ini</Ini>
<Name>HDD Meter 4</Name><IconPath>Widgets\HDD4\Icon.png</IconPath><LaunchPath>NXT-OS\Dash\Widgets\HDD4</LaunchPath><Ini>Widget.ini</Ini>