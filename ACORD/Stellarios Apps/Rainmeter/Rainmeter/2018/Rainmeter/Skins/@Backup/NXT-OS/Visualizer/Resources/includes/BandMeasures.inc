; auto-generated by sFactoryBandMeasures
[mBand0]
Measure=Plugin
Plugin=AudioLevel
Parent=mAudioOut
Type=Band
BandIdx=1
[mBand1]
Measure=Plugin
Plugin=AudioLevel
Parent=mAudioOut
Type=Band
BandIdx=2
[mBand2]
Measure=Plugin
Plugin=AudioLevel
Parent=mAudioOut
Type=Band
BandIdx=3
[mBand3]
Measure=Plugin
Plugin=AudioLevel
Parent=mAudioOut
Type=Band
BandIdx=4
[mBand4]
Measure=Plugin
Plugin=AudioLevel
Parent=mAudioOut
Type=Band
BandIdx=5
[mBand5]
Measure=Plugin
Plugin=AudioLevel
Parent=mAudioOut
Type=Band
BandIdx=6
[mBand6]
Measure=Plugin
Plugin=AudioLevel
Parent=mAudioOut
Type=Band
BandIdx=7
[mBand7]
Measure=Plugin
Plugin=AudioLevel
Parent=mAudioOut
Type=Band
BandIdx=8
[mBand8]
Measure=Plugin
Plugin=AudioLevel
Parent=mAudioOut
Type=Band
BandIdx=9
[mBand9]
Measure=Plugin
Plugin=AudioLevel
Parent=mAudioOut
Type=Band
BandIdx=10
[mBand10]
Measure=Plugin
Plugin=AudioLevel
Parent=mAudioOut
Type=Band
BandIdx=11
[mBand11]
Measure=Plugin
Plugin=AudioLevel
Parent=mAudioOut
Type=Band
BandIdx=12
[mBand12]
Measure=Plugin
Plugin=AudioLevel
Parent=mAudioOut
Type=Band
BandIdx=13
[mBand13]
Measure=Plugin
Plugin=AudioLevel
Parent=mAudioOut
Type=Band
BandIdx=14
[mBand14]
Measure=Plugin
Plugin=AudioLevel
Parent=mAudioOut
Type=Band
BandIdx=15
[mBand15]
Measure=Plugin
Plugin=AudioLevel
Parent=mAudioOut
Type=Band
BandIdx=16
[mBand16]
Measure=Plugin
Plugin=AudioLevel
Parent=mAudioOut
Type=Band
BandIdx=17
[mBand17]
Measure=Plugin
Plugin=AudioLevel
Parent=mAudioOut
Type=Band
BandIdx=18
[mBand18]
Measure=Plugin
Plugin=AudioLevel
Parent=mAudioOut
Type=Band
BandIdx=19
[mBand19]
Measure=Plugin
Plugin=AudioLevel
Parent=mAudioOut
Type=Band
BandIdx=20
[mBand20]
Measure=Plugin
Plugin=AudioLevel
Parent=mAudioOut
Type=Band
BandIdx=21
[mBand21]
Measure=Plugin
Plugin=AudioLevel
Parent=mAudioOut
Type=Band
BandIdx=22
[mBand22]
Measure=Plugin
Plugin=AudioLevel
Parent=mAudioOut
Type=Band
BandIdx=23
[mBand23]
Measure=Plugin
Plugin=AudioLevel
Parent=mAudioOut
Type=Band
BandIdx=24
[mBand24]
Measure=Plugin
Plugin=AudioLevel
Parent=mAudioOut
Type=Band
BandIdx=25
[mBand25]
Measure=Plugin
Plugin=AudioLevel
Parent=mAudioOut
Type=Band
BandIdx=26
[mBand26]
Measure=Plugin
Plugin=AudioLevel
Parent=mAudioOut
Type=Band
BandIdx=27
[mBand27]
Measure=Plugin
Plugin=AudioLevel
Parent=mAudioOut
Type=Band
BandIdx=28
[mBand28]
Measure=Plugin
Plugin=AudioLevel
Parent=mAudioOut
Type=Band
BandIdx=29
[mBand29]
Measure=Plugin
Plugin=AudioLevel
Parent=mAudioOut
Type=Band
BandIdx=30
[mBand30]
Measure=Plugin
Plugin=AudioLevel
Parent=mAudioOut
Type=Band
BandIdx=31
[mBand31]
Measure=Plugin
Plugin=AudioLevel
Parent=mAudioOut
Type=Band
BandIdx=32
[mBand32]
Measure=Plugin
Plugin=AudioLevel
Parent=mAudioOut
Type=Band
BandIdx=33
[mBand33]
Measure=Plugin
Plugin=AudioLevel
Parent=mAudioOut
Type=Band
BandIdx=34
[mBand34]
Measure=Plugin
Plugin=AudioLevel
Parent=mAudioOut
Type=Band
BandIdx=35
[mBand35]
Measure=Plugin
Plugin=AudioLevel
Parent=mAudioOut
Type=Band
BandIdx=36
[mBand36]
Measure=Plugin
Plugin=AudioLevel
Parent=mAudioOut
Type=Band
BandIdx=37
[mBand37]
Measure=Plugin
Plugin=AudioLevel
Parent=mAudioOut
Type=Band
BandIdx=38
[mBand38]
Measure=Plugin
Plugin=AudioLevel
Parent=mAudioOut
Type=Band
BandIdx=39
[mBand39]
Measure=Plugin
Plugin=AudioLevel
Parent=mAudioOut
Type=Band
BandIdx=40
[mBand40]
Measure=Plugin
Plugin=AudioLevel
Parent=mAudioOut
Type=Band
BandIdx=41
[mBand41]
Measure=Plugin
Plugin=AudioLevel
Parent=mAudioOut
Type=Band
BandIdx=42
[mBand42]
Measure=Plugin
Plugin=AudioLevel
Parent=mAudioOut
Type=Band
BandIdx=43
[mBand43]
Measure=Plugin
Plugin=AudioLevel
Parent=mAudioOut
Type=Band
BandIdx=44
[mBand44]
Measure=Plugin
Plugin=AudioLevel
Parent=mAudioOut
Type=Band
BandIdx=45
[mBand45]
Measure=Plugin
Plugin=AudioLevel
Parent=mAudioOut
Type=Band
BandIdx=46
[mBand46]
Measure=Plugin
Plugin=AudioLevel
Parent=mAudioOut
Type=Band
BandIdx=47
[mBand47]
Measure=Plugin
Plugin=AudioLevel
Parent=mAudioOut
Type=Band
BandIdx=48
[mBand48]
Measure=Plugin
Plugin=AudioLevel
Parent=mAudioOut
Type=Band
BandIdx=49
[mBand49]
Measure=Plugin
Plugin=AudioLevel
Parent=mAudioOut
Type=Band
BandIdx=50
[mBand50]
Measure=Plugin
Plugin=AudioLevel
Parent=mAudioOut
Type=Band
BandIdx=51
[mBand51]
Measure=Plugin
Plugin=AudioLevel
Parent=mAudioOut
Type=Band
BandIdx=52
[mBand52]
Measure=Plugin
Plugin=AudioLevel
Parent=mAudioOut
Type=Band
BandIdx=53
[mBand53]
Measure=Plugin
Plugin=AudioLevel
Parent=mAudioOut
Type=Band
BandIdx=54
[mBand54]
Measure=Plugin
Plugin=AudioLevel
Parent=mAudioOut
Type=Band
BandIdx=55
[mBand55]
Measure=Plugin
Plugin=AudioLevel
Parent=mAudioOut
Type=Band
BandIdx=56
[mBand56]
Measure=Plugin
Plugin=AudioLevel
Parent=mAudioOut
Type=Band
BandIdx=57
[mBand57]
Measure=Plugin
Plugin=AudioLevel
Parent=mAudioOut
Type=Band
BandIdx=58
[mBand58]
Measure=Plugin
Plugin=AudioLevel
Parent=mAudioOut
Type=Band
BandIdx=59
[mBand59]
Measure=Plugin
Plugin=AudioLevel
Parent=mAudioOut
Type=Band
BandIdx=60
[mBand60]
Measure=Plugin
Plugin=AudioLevel
Parent=mAudioOut
Type=Band
BandIdx=61
[mBand61]
Measure=Plugin
Plugin=AudioLevel
Parent=mAudioOut
Type=Band
BandIdx=62
[mBand62]
Measure=Plugin
Plugin=AudioLevel
Parent=mAudioOut
Type=Band
BandIdx=63
[mBand63]
Measure=Plugin
Plugin=AudioLevel
Parent=mAudioOut
Type=Band
BandIdx=64
[mBand64]
Measure=Plugin
Plugin=AudioLevel
Parent=mAudioOut
Type=Band
BandIdx=65
[mBand65]
Measure=Plugin
Plugin=AudioLevel
Parent=mAudioOut
Type=Band
BandIdx=66
[mBand66]
Measure=Plugin
Plugin=AudioLevel
Parent=mAudioOut
Type=Band
BandIdx=67
[mBand67]
Measure=Plugin
Plugin=AudioLevel
Parent=mAudioOut
Type=Band
BandIdx=68
[mBand68]
Measure=Plugin
Plugin=AudioLevel
Parent=mAudioOut
Type=Band
BandIdx=69
[mBand69]
Measure=Plugin
Plugin=AudioLevel
Parent=mAudioOut
Type=Band
BandIdx=70
[mBand70]
Measure=Plugin
Plugin=AudioLevel
Parent=mAudioOut
Type=Band
BandIdx=71
[mBand71]
Measure=Plugin
Plugin=AudioLevel
Parent=mAudioOut
Type=Band
BandIdx=72
[mBand72]
Measure=Plugin
Plugin=AudioLevel
Parent=mAudioOut
Type=Band
BandIdx=73
[mBand73]
Measure=Plugin
Plugin=AudioLevel
Parent=mAudioOut
Type=Band
BandIdx=74
[mBand74]
Measure=Plugin
Plugin=AudioLevel
Parent=mAudioOut
Type=Band
BandIdx=75
[mBand75]
Measure=Plugin
Plugin=AudioLevel
Parent=mAudioOut
Type=Band
BandIdx=76
[mBand76]
Measure=Plugin
Plugin=AudioLevel
Parent=mAudioOut
Type=Band
BandIdx=77
[mBand77]
Measure=Plugin
Plugin=AudioLevel
Parent=mAudioOut
Type=Band
BandIdx=78
[mBand78]
Measure=Plugin
Plugin=AudioLevel
Parent=mAudioOut
Type=Band
BandIdx=79
[mBand79]
Measure=Plugin
Plugin=AudioLevel
Parent=mAudioOut
Type=Band
BandIdx=80