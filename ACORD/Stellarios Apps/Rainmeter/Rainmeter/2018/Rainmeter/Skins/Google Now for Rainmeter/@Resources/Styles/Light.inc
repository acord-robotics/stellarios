[Variables]
MainButtonColour=0,0,0
LightBg=0,0,0,20
LightFg=0,0,0,100

[StyleTitle]
AntiAlias=1
FontColor=0,0,0,138
FontFace=Roboto
FontSize=10
X=54
Y=17

[StyleContentTitle]
AntiAlias=1
FontColor=0,0,0
FontFace=Roboto
FontSize=17
X=20
Y=10R

[StyleContentSubtitle]
AntiAlias=1
;FontColor=123,123,123
FontColor=0,0,0,138
FontFace=Roboto
FontSize=11
X=20
Y=6R

[StyleDayTitle]
AntiAlias=1
FontFace=Roboto
FontSize=11
FontColor=0,0,0,97
StringAlign=Center
X=31r
Y=-2r

[StyleDayMax]
AntiAlias=1
FontFace=Roboto
FontColor=0,0,0
StringAlign=Center
FontSize=11
Postfix="º"
X=12r
Y=10R

[StyleDayMin]
AntiAlias=1
FontFace=Roboto
FontColor=0,0,0,133
StringAlign=Center
FontSize=10
Postfix="º"
X=r
Y=8R


[StyleLauncherTitle]
AntiAlias=1
FontSize=11
FontFace=Roboto Light
FontColor=0,0,0,215
StringAlign=CenterCenter
X=32r
Y=16R


[StyleIcon16]
X=21
Y=17

[StyleIcon18]
X=20
Y=16
H=18
W=18
ImageTint=0,0,0,138

[StyleWeatherIcon]
X=-13r
Y=10R
W=24
H=24

[StyleIcon24MoreVertical]
ImageName=#@#Icons\24_grey_more_vertical.png
X=316
Y=13

[StyleIcon18MoreVertical]
ImageName=#@#Icons\18_more_vertical.png
X=319
Y=16
ImageTint=0,0,0,51

[StyleDivider]
X=4
Y=15R
W=344
H=1
SolidColor=0,0,0,32
