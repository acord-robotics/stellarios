[Variables]
MainButtonColour=255,255,255
LightBg=255,255,255,40
LightFg=255,255,255,100

[StyleTitle]
AntiAlias=1
FontColor=255,255,255
FontFace=Roboto
FontSize=10
X=54
Y=17

[StyleContentTitle]
AntiAlias=1
FontColor=255,255,255
FontFace=Roboto
FontSize=17
X=20
Y=10R

[StyleContentSubtitle]
AntiAlias=1
FontColor=255,255,255,179
FontFace=Roboto
FontSize=11
X=20
Y=6R

[StyleLauncherTitle]
AntiAlias=1
FontSize=11
FontFace=Roboto Light
FontColor=FFFFFF
StringAlign=CenterCenter
X=32r
Y=16R

[StyleDayTitle]
AntiAlias=1
FontFace=Roboto
FontSize=11
FontColor=255,255,255,179
StringAlign=Center
X=31r
Y=-2r

[StyleDayMax]
AntiAlias=1
FontFace=Roboto
FontColor=255,255,255
StringAlign=Center
FontSize=11
Postfix="º"
X=12r
Y=10R

[StyleDayMin]
AntiAlias=1
FontFace=Roboto
FontColor=255,255,255,138
StringAlign=Center
FontSize=10
Postfix="º"
X=r
Y=8R

[StyleIcon16]
X=21
Y=17

[StyleIcon18]
X=20
Y=16

[StyleWeatherIcon]
X=-13r
Y=10R
W=24
H=24

[StyleIcon24MoreVertical]
ImageName=#@#Icons\24_grey_more_vertical.png
X=316
Y=13

[StyleIcon18MoreVertical]
ImageName=#@#Icons\18_more_vertical.png
X=319
Y=16
ImageTint=255,255,255,179

[StyleDivider]
X=4
Y=15R
W=344
H=1
SolidColor=255,255,255,32

