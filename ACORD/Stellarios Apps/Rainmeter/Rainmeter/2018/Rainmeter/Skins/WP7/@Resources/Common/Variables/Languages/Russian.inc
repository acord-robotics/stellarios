[Variables]
Translation=Русский
langoverride=1
StartText=Начать
Translated=Алекс Джэймс (vk.com/alexrodichev)

languagedomain=ru
programs=Программы
systemtools=Инструменты
alarm1=Будильник
Set=установить
Snooze=отложить
Videos=Видео
Music=Музыка
TV=TВ
Pictures=Изобр.
openfolder=Открыть
new=новых
no=0
Picturesfoldername=Открыть
applications=приложения
Library=Библиотека
editnotes=Изменить
games=игры

Monday=Понед.
Tuesday=Вторник
Wednesday=Среда
Thursday=Четверг
Friday=Пятница
Saturday=Суббота
Sunday=Воскр.
January=Январь
February=Февраль
March=Март
April=Апрель
May=Май
June=Июнь
July=Июль
August=Август
September=Сентябрь
October=Октябрь
November=Ноябрь
December=Декабрь

Mon=Пн
Tue=Вт
Wed=Ср
Thu=Чт
Fri=Пт
Sat=Сб
Sun=Вс

Januaryshort=Янв.
Februaryshort=Фев.
Marchshort=Март
Aprilshort=Апрель
Mayshort=Май
Juneshort=Июнь
Julyshort=Июль
Augustshort=Авг.
Septembershort=Сент.
Octobershort=Окт.
Novembershort=Ноябрь
Decembershort=Дек.

Panels=Панели
Skins=Скины
Credit=Благодарность
OpenTrash=Открыть
Items=Файлов
Size=Размер
Battery=Батарея
ACLine=Питание
Power=Питание
Uptime=Включен
Memory=Память
CORE=Ядро
Phase=Фаза
harddrives=Жесткий диск
Free=Свободно
Space=Память
Used=Занято
drives1=Разделы
tools=Инструменты
downloads=Загрузки
Network=Сеть
Setaswallpaper=Установить обои
RecycleBin=Корзина
MostlyCloudy=Перем. обл.
LightSnow=Неб. снег
LightRain=Неб. дождь
LightRainShower=Неб. ливень
Cloudy=Облачно
Drizzle=Изморось
Lgt=Ясно
And=и
Partly= 
Mostly=Преимуществ.
with=с
Clear=Ясно
Fair=Ясно
PartlyCloudy=Облачно
Cloudy=Облачно
FreezingRain=Ледяной дождь
Rain=Дождь
Thunder=Гром
intheVicinity=В окрестностях
Shower=Ливень
Snow=Снег
Sunny=Солнечно
Windy=Ветренно
Haze=Дымка
Fog=Туман
WidespreadDust=Пыльная буря
Set=Уст
T-Storm=Гроза
LightDrizzle=Неб. изморось
WintryMiX=Ветер
Light=Light
Weather=Погода

notconfigured=Не настроена
Updates=Обновления
Currentversion=Текущая версия
NoUpdatesAvailable=Нет новых обновлений
NewUpdateAvailable=Доступно обновление
news=rss
feeds=новости
systemstorage=Диски
BinaryClock=Бинарные часы
noresize=Нет масштабирования
countdown=Отсчет
start=старт
stop=стоп
settimer=уст
reset=сброс
IPAddress=IP Адрес
Empty=Очистить
Processor=Процессор
Volume=Громкость
systeminfo=О Системе
ME=Я
Wireless=Wi-Fi
Folders=Папки
Maps=Карты
Search=Поиск
MoonPhase=Фазы Луны
Stocks=Акций
Tonight=Сегодня
Mon=ПH
Tue=ВТ
Wed=СР
Thu=ЧТ
Fri=ПТ
Sat=СБ
Sun=ВС
Januaryshort=Янв
Februaryshort=Фев
Marchshort=Мар
Aprilshort=Апр
Mayshort=Май
Juneshort=Июнь
Julyshort=Июль
Augustshort=Авг
Septembershort=Сен
Octobershort=Окт
Novembershort=Ноя
Decembershort=Дек
Calculator=Калькулятор
Camera=Скриншот
Notestitle=Заметки

TIME=Время
PCINFO=Инфо о ПК
SHORTCUTS=ЯРЛЫКИ
INTERNET=ИНТЕРНЕТ
TOOLS1=ИНСТР.
INSTALLEDPANELS=УСТАНОВЛЕНЫЕ ПАНЕЛИ
ALLTEXTITEMS=ВСЕ ТЕКСТОВЫЕ ЭЛЕМЕНТЫ
INSTALLED=УСТАНОВЛЕННО
textitemscolor=Цвет элементов
panels1=Панели
textitems=Элементы

Close= Закрыть [x]
Apply= Применить

Loadtheme=Загрузить тему
Applytheme=Применить тему
all=все
unreademails=непрочитанные
inboX=входящие
resource=использование
resourceuseage=использование ресурсов
SYSTEMMONITORING=МОНИТОРИНГ СИСТЕМЫ
Processorload=Загрузка процессора
Systemmemory=Системная память
Virtualmemory=Виртуальная память
Primaryharddrive=Системный диск
Secondaryharddrive=Диск пользователя

today=Сейчас
todayforecast=today forecast
BaroMeter=Барометр
Humidity=Влажность
Visibility=Видимость
Wind=Ветер
Windchill=Температура ветра
Winddirection=Направление ветра
Sunrise=Рассвет
Sunset=Закат
world=Мировое
worldclock=Мировое время
Localtime=Текущее время
Translator=Переводчик
Stocks=Стоп
PowerPlan=Режим питания
Select=Выбрать
Balanced=Сбалансированый
HighPerf=Производительность
PowerSaver=Энергосбережение
clickhereforgallery=открыть галерию

moreaddons=Дополнения
donatorpanels=Панели жертвовательей
donateifyoulike=Пожертвуйте, если вы хотите
Calendar=Календарь
Devices=Устройства
Sound=Звук
ControlPanel=Управления
Radio=Радио
Playlists= 
ColorConverter=Конвертер Цвета
Convert=Конвертер
ImageConverter=Конвертер
SunClock=Солнечные часы
Eject=Извлечь
Thanks=Спасибо
Donation=Мы потратили много времени на Omnimo, если Bы хотите показать свою благодарность, поддержите нас для будущих проектов.
rss=rss
Feeds=каналы

;;;;
Style=Стиль
settings=Hастройки
normalcolorTR=Цвет 1
hovercolorTR=Цвет 2
textcolorTR=Цвет текста 1
textitemscolorTR=Цвет текста 2
bordercolorTR=Цвет границы
borderstyleTR=Стиль границы
aeroglass=Aero
roundedTR=Закруглен
centertext=Центр
changecolor=Изменение цвета
timelineview=временная шкала
timeline=временная
forecast=прогноз

;can be Transparency or opacity, shorter word plz
opacityTR=Прозрачн.
resizepanels=Размер

Individualpanelcolor=Индивидуальный цвет

off=Off

donothing=Bыбранное действие выполниться через
donothing2=секунд

Sleep=Спать
Logoff=Bыйти
Shutdown=Выключить
Restart=Перезагрузить
Hibernate=Гибернация
cancel=Отменить
clickhereforgallery=Открыть галерею
changegallerytheme=Изменение темы галерии
Addons=Добавл.
Computer=Компьютер

CloseString=Закрыть
SetString=Применить
info=Инфо
information=Информация
people=Люди
networkoptions=Параметры сети
gamesexplorer=Игры
internetshortcuts=Интернет ярлыки
windowsupdate=Центр обновления
friends=Друзья
gallery=Галерея
displayoptions=Параметры
installedthemes=Темы
Lock=Блокировка
Headers=Заголовки
TrayIcons=Rainmeter значок
Fahrenheit=Фаренгейт
24HourTime=24 час.
RSSDecoding=Pасшифровка
ArrowStyle=Стиль кнопки
LayoutThemes=Темы Omnimo
Checkforupdates=Обновления
Goodmorning=Доброе утро
Goodafternoon=Добрый день
Goodevening=Добрый вечер
Greetings=Здравствуйте
sunasinstar=Солнце
Pressure=Давление
Browserballot=Bыбор браузера
Connected=Подключен
storage=Память
Desktop=Pабочий стол
Finance=Финансы
Photos=Фото
Reader=RSS
languagename=Язык
default=[по умолчанию]
system=Система
weatherforecast=Прогноз погоды
Font=Шрифт
font1=Шрифт 1
font2=Шрифт 2
font3=Шрифт 3
noupdates=Нет обновлений
newupdate=Новое обновление!
extras=Элементы 2
Styles=Скины
quickaccess=Быстрый доступ
time=Время
weather=Погода
mail=Почта
morepcsettings=Другие настройки ПК
Wifi=Wi-Fi
Mute=Отключить
extrawidth=30
brightness=Яркость


Layouts=Макеты
Toggle=переключ.
Advanced=Дополнительно
Simple=Просто
ResizeAllPanels=Изменение размера
FontString=Шрифт
TogglePanelIcons=Переключить значки
SidebarColors=Боковая панель
Menu=Меню



High=Высок.
Low=Низк.
MiddleClickToDelete=Средняя кнопка мыши чтобы удалить панель
CreatePanel=Создать панель
ViewPanels=Просмотр панели
donothing1=Выбранное действие будет выполняться через
donothing2=секунд.

DominantRSS=http://lenta.ru/rss
DominantRSSName=Lenta.ru

viewall=Cмотреть все...
videotutorials=Видео уроки
