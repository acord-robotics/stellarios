[Variables]
langoverride=1
Translation=Spanish
Translated=Allucard9 and Adrián @sithdown
programs=Programas
systemtools=Herramientas

alarm1=Alarma
Set=Establecer
Snooze=Reposar
languagedomain=es
;these are pretty lame, you can ignore them
spotlight=spotlight
LaunchGamesforWindowsLive=Lanzar Juegos para Windows Live
GotoGamesforWindows=Ir a los juegos para Windows

Videos=Videos
Music=Música
TV=TV
Pictures=Imágenes
About=Acerca de
openfolder=Abrir

new=Nuevo
no=0
Picturesfoldername=Carpeta de Imágenes
applications=Aplicaciones
Library=Librería
editnotes=Editar notas
games=Juegos

;calendars/misc
Calendar=Calendario
Todayis=Hoy es

Monday=Lunes
Tuesday=Martes
Wednesday=Miércoles
Thursday=Jueves
Friday=Viernes
Saturday=Sábado
Sunday= Domingo
January=Enero
February=Febrero
March=Marzo
April=Abril
May=Mayo
June=Junio
July=Julio
August=Agosto
September=Septiembre
October=Octubre
November=Noviembre
December= Diciembre

Tonight=Esta noche
Mon=Lun
Tue=Mar
Wed=Mier
Thu=Jue
Fri=Vier
Sat=Sáb
Sun=Dom
Januaryshort=Ene.
Februaryshort=Feb.
Marchshort=Mar.
Aprilshort=Abr.
Mayshort=May
Juneshort=Jun.
Julyshort=Jul.
Augustshort=Ago.
Septembershort=Sept.
Octobershort=Oct.
Novembershort=Nov.
Decembershort=Dic.

ControlPanel=Panel De Control
Devices=Dispositivos
Sound=Sonido
Gamesexplorer=Explorador de Juegos
Friends=Amigos
internetshortcuts=Accesos Directos de Internet
Radio=Radio
Playlists=Listas de Reproducción
People=Personas

Gallery=Galería
Panels= Paneles
Skins= Pieles
Credit=Crédito
OpenTrash=Abrir Papelera
Items=Artículos
Size=Tamaño
Battery=Batería
ACLine=Línea AC
Power=Energía
Uptime=Tiempo de funcionamiento
resizepanels=Resize Panels
harddrives=Disco duro
Memory=Memoria
CORE=Núcleo
Phase=Fase
harddrive=Disco duro
Free=Libre
Space=Espacio
Used=Usado
drives1=Unidad
settings= Preferencias
tools=Herramientas
downloads=Descargas
Network=Red
Setaswallpaper=Establecer como fondo de escritorio
RecycleBin= Papelera de reciclaje

;weather
MostlyCloudy=Nuboso
LightSnow=Ligera Nevada
LightRain=Chubascos
Cloudy=Nuboso
Drizzle=Llovizna
And=y
Partly=en parte
Mostly=en su mayoría
and=y
with=con
Clear=Despejado
Fair=Buen tiempo
PartlyCloudy=Nublado
Cloudy=Nublado
FreezingRain=Lluvia
LightRain Shower=Chubascos
LightRain=Chubascos
Rain=Lluvia
Shower= 
Thunder=Trueno
intheVicinity=en las proximidades
Snow=Nieve
Sunny=Soleado
Windy=Ventoso
Haze=Neblina
Fog=Niebla
WidespreadDust=Viento Extendido
Set=Establecer
T-Storm=Tormenta Eléctrica
LightDrizzle=Leve Llovizna
WintryMiX=Clima de Invierno Mezclado
Light=Luz
Mist=Bruma

Weather=El tiempo

notconfigured=No configurado
Updates=Actualizaciones
Currentversion=Versión actual
NoUpdatesAvailable=No hay actualizaciones disponibles
NewUpdateAvailable=Nuevas actualizaciones disponibles
news=Noticias
feeds=feeds
systemstorage=Sistema de almacenamiento
BinaryClock=Reloj Binario
noresize=Este panel no se puede redimensionar
countdown=Cuenta atrás
start=Inicio
stop=Alto
settimer=Establecer
reset=Restablecer
IPAddress=Dirección IP
Empty=Vaciar
Processor=Procesador
Volume=Volumen
systeminfo=Información del sistema

;The user panel - ME as in "I"

ME=Yo
Wireless=Wi-Fi
Folders=Carpetas
Maps=Mapas
Search=Buscar
MoonPhase=Fase De La Luna
;Stock makret
Stocks=Stocks
Calculator=Calculadora
Camera=Captura de pantalla
Notestitle=Notas

;GALLERY
DONATERPANELS=PANELES
PCINFO=PC INFO
SHORTCUTS=ATAJOS
INTERNET=INTERNET
TOOLS1=HERRAMIENTAS
INSTALLEDPANELS=PANELES INSTALADOS
INSTALLEDTHEMES=INSTALAR TEMAS
ALLTEXTITEMS=TODOS LOS ARTÍCULOS DE TEXTO
INSTALLED=INSTALADO
CUSTOMIZE=PERSONALIZAR
textitemscolor=Elementos De Texto De Color
Viewgift=Ver Gift

;Better ignore these 2
panels1=panels
textitems=text items
;Changecolorsettings=Cambiar la configuración de la Skin y el color
viewinstalledpanels=Ver paneles instalados
Viewdefaultpanels=Ver paneles por defecto
Downloadpanels=Descargar Paneles/Complementos
Changeadvancedcolorandappearance=Cambio avanzado de color y apariencia 
viewtextitems=Ver elementos de Texto
Preview=Previa
Close= Cerrar [x]
Apply= Aplicar

all=Todo
unreademails=Correos electrónicos sin leer
inboX=Bandeja de entrada
resource=Uso De
resourceuseage=Uso De Recursos 
SYSTEMMONITORING=Monitoreo Del Sistema
Processorload=Carga del Procesador
Systemmemory=Memoria del Sistema
Virtualmemory=Memoria Virtual
Primaryharddrive=Unidad de Disco Duro principal
Secondaryharddrive=Disco Duro secundario
information=información
system=Sistema
info=info
dateandtime=fecha y hora
networkoptions=opciones de red
poweroptions=opciones de energía
audiooptions=opciones de audio
themeoptions=opciones del tema
displayoptions=opciones de visualización
useraccounts=cuentas de usuario
windowsupdate=Windows Update
monitorsconnected=monitor(es) conectado
loggedinas=Conectado como
installupdatesevery=Instalar actualizaciones: cada
today=hoy
forecast=Pronóstico
BaroMeter=Barómetro
Humidity=Humedad
Visibility=Visibilidad
Wind=Viento
Windchill=Sensación térmica
Winddirection=Dirección del viento
Sunrise=Salida del sol
Sunset=Puesta del sol

world=reloj
worldclock=reloj mundial
Localtime=Hora local
Translator=Traductor
Stocks=Stocks
PowerPlan=Plan de energía
Select=Seleccionar
Balanced=Equilibrada
HighPerf=Alto rendimiento
PowerSaver=Ahorro de energía

Radio=Radio
Playlists= 

Style=Estilo
Settings=Configuración
normalcolorTR=Color 1
hovercolorTR=Color 2
textcolorTR=Texto Color
textitemscolorTR=Texto Color 2
bordercolorTR=Esquema Color
borderstyleTR=Esquema estilo
aeroglass=Aero Glass
roundedTR=Esférico
centertext=Centrar Texto
changecolor=Cambiar color
opacityTR=Opacidad

moreaddons=Complementos
donatorpanels=Donator Panels
donateifyoulike=Donate if you like
Calendar=Calendario
Devices=Dispositivos
Sound=Sonido
ControlPanel=Panel de control

ColorConverter=Color Convertidor
Convert=Convertir
ImageConverter=Image Convertidor
SunClock=Sun Clock
Eject=Expulsar
timelineview=timeline view
timeline=timeline

Thanks=Gracias
Donation=We spent a lot of time on omnimo, if you wish to show your gratitude, please consider donating to help maintain the server costs and for future projects.

donothing=La acción seleccionada se realiza automáticamente en 10 segundos.
off=Off

Sleep=Domir
Logoff=Log off
Shutdown=Apagado
Restart=Reinicie
Hibernate=Hibernar
cancel=Cancelar
clickhereforgallery=Abrir la galería
changegallerytheme=Cambiar el tema galería

StartText=Iniciar
Addons=Compl.
individualpanelcolor=De color individuales
Computer=Ordenador

SetString=Establecer
CloseString=Cerrar
;If the words are too long or no sensible translation, this can be used: X and √

WeatherForecast= Pronóstico del tiempo
Lock=Bloquear
; Lock as in Lock PC

Headers= Encabezados
;Headers as in TextItem big font headers

TrayIcons= Iconos en la Bandeja del Sistema
;Can be Rainmeter Icon

Fahrenheit=Fahrenheit
24HourTime=24 Horas
RSSDecoding=Descifrar RSS
ArrowStyle=Estilo de Flecha
;Can be Button Theme/Style

LayoutThemes=Plantillas y Temas
;Can be Omnimo Themes

Checkforupdates= Buscar Actualizaciones
Goodmorning= Buenos Días
Goodafternoon= Buenas Tardes
Goodevening=Buenas Noches
Greetings=Saludos
;Can be Hello

sunasinstar=Sol
Pressure=Presión
;Barometer / Pressure

Browserballot=Selector
;Browser Picker, Browser Selector, etc

Connected=Conectado
storage=Almacenamiento
;Hard Drive storage

Desktop=Escritorio
Finance= Finanzas
Photos=Fotos
Reader=Lector RSS
;Can be just RSS

languagename=Idioma
default=[reset to default]
Font=Font
font1=Font 1
font2=Font 2
font3=Font 3

noupdates= No hay Actualizaciones
newupdate= Nueva Actualización Disponible!
extras=Extras
;Can be "Elements"

Styles=Estilos
quickaccess= Acceso Rápido
;Can be Sidebar

time=Hora
weather=Clima
mail=Correo
morepcsettings=Mas Configuraciones de la PC
Wifi=Wi-Fi
Mute=Silencio
;As in disable volume (can be "disable")

extrawidth=20
;Ignore this

brightness=Brillo


Layouts=Diseños
Toggle=Alternar
Advanced=Avanzado
Simple=Simple
ResizeAllPanels=Redimensionar todos los paneles
FontString=Fuente
TogglePanelIcons=Alternar Iconos de Panel
SidebarColors=Colores de la barra lateral
Menu=Menú
High=Alto
Low=Bajo
MiddleClickToDelete=Botón central para eliminar panel
CreatePanel=Crear Panel
ViewPanels=Ver Paneles
donothing1=£La acción seleccionada será realizada en %$%
donothing2=segundos.

DominantRSS=http://www.20minutos.es/rss/
DominantRSSName=20minutos

viewall=Ver todo...
videotutorials=Tutoriales en vídeo