[Variables]
Translation=Nederlands
Translated=Wesley van der Sanden
langoverride=1
;This one is for google searches
languagedomain=nl
individualpanelcolor=Individueel kleur
programs=Programma's
systemtools=Systeem werkset
alarm1=Alarm
Set=instellen
Snooze=snooze
Videos=Video´s
Music=Muziek
Thanks=Thanks
Donation=We spent a lot of time on Omnimo, if you wish to show your gratitude, please consider donating to help maintain the server costs and for future projects.
donatorpanels=Donator Panels
donateifyoulike=Donate if you like

TV=TV
Pictures=Afbeeld.
openfolder=Openen
new=nieuw
no=0
Picturesfoldername=Afbeeldingen map
applications=toepassingen
Library=Bibliotheek
editnotes=Notities bewerken
games=games

Calendar=Kalender
Todayis=Vandaag is
Monday=maandag
Tuesday=dinsdag
Wednesday=woensdag
Thursday=donderdag
Friday=vrijdag
Saturday=zaterdag
Sunday=zondag
January=januari
February=februari
March=maart
April=april
May=mei
June=juni
July=juli
August=augustus
September=september
October=oktober
November=november
December=december
Tonight=Vanavond
Mon=ma
Tue=di
Wed=wo
Thu=do
Fri=vr
Sat=za
Sun=zo
Januaryshort=Jan
Februaryshort=Feb
Marchshort=Mrt
Aprilshort=Apr
Mayshort=Mei
Juneshort=Jun
Julyshort=Jul
Augustshort=Aug
Septembershort=Sep
Octobershort=Okt
Novembershort=Nov
Decembershort=Dec

ControlPanel=Configuratie
Devices=Apparaten
Sound=Geluid
Gamesexplorer=Spelletjes verkenner
Friends=vrienden
internetshortcuts=INTERNET SNELKOPPELINGEN
People=Mensen

Gallery=Galerij
Panels=Panelen
Skins=Skins

Items=Items
Size=Afmeting
Battery=Batterij
ACLine=AC Lijn
Power=Vermogen
Uptime=uptime
Memory=Memory
CORE=CPU
Phase=Fase
harddrives=harde schijven
Free=Vrij
Space=Ruimte
Used=Gebruikt
drives1=schijven
settings=Instellingen
tools=gereedschap
downloads=downloads
Network=Netwerk
Setaswallpaper=Stel in als bureaubladachtergrond
RecycleBin=Prullenbak

;weather
MostlyCloudy=Bewolkt
LightSnow=Lichte sneeuw
LightRain=Lichte regen
LightRainShower=Stortregen
Cloudy=Bewolkt
Drizzle=Motregen
Lgt=Lgt
And=en
Partly=Gedeeltelijk
Mostly=Grotendeels
with=met
Clear=Helder
Fair=Mooi
PartlyCloudy=Gewolkt
Cloudy=Bewolkt
FreezingRain=Regen
Rain=Regen
Thunder=Bliksem
intheVicinity=In de omgeving
Shower=Stortregen
Snow=Sneeuw
Sunny=Zonnig
Windy=Waaierig
Haze=Nevel
Fog=Mist
WidespreadDust=Zandstorm
Set=Instellen
T-Storm=Onweer
LightDrizzle=Motregen
WintryMiX=Wind
Light=Licht
Weather=Weer

notconfigured=Configureren
Updates=Updates
Currentversion=Huidige versie
NoUpdatesAvailable=Geen updates beschikbaar
NewUpdateAvailable=Nieuwe update beschikbaar
news=nieuws
feeds=feeds
systemstorage=systeem opslag
BinaryClock=Binaire klok
noresize=Paneelgrootte kan niet worden gewijzigd
countdown=Aftellen
start=start
stop=stop
settimer=instellen
reset=reset
IPAddress=IP Adres
Empty=Leeg
Processor=Processor
Volume=Volume
systeminfo=Systeem Info

;The user panel - ME as in "I"

ME=MIJ
Wireless=Draadloos
Folders=Mappen
Maps=Kaarten
Search=Zoeken
MoonPhase=Maan fase
;Stock makret
Stocks=Aandelen
Calculator=Rekenmachine
Camera=Screenshot
Notestitle=Notities

;GALLERY
TIME=Tijd
PCINFO=PC INFO
SHORTCUTS=SNELKOPPELINGEN
INTERNET=INTERNET
TOOLS1=TOOLS
INSTALLEDPANELS=GEÏNSTALLEERDE PANELEN
INSTALLEDTHEMES=GEÏNSTALLEERDE THEMA'S
ALLTEXTITEMS=ALLE TEKST ITEMS
INSTALLED=GEÏNSTALLEERD
CUSTOMIZE=AANPASSEN
textitemscolor=Tekst Items kleur
Viewgift=Bekijk gift

;Better ignore these 2
panels1=panelen
textitems=Tekst items
;Changecolorsettings=Wijzig skin en kleur instellingen
viewinstalledpanels=Bekijk geïnstalleerde panelen
Viewdefaultpanels=Bekijk standaard panelen
Downloadpanels=Download panelen/Add-ons
Changeadvancedcolorandappearance=Wijzig de geavanceerde kleur en uiterlijk
viewtextitems=Bekijk tekst items
Preview=Preview
Close=Sluiten [x]
Apply= Toepassen

all=alle
unreademails=ongelezen e-mails
inboX=inbox
resource=bron
resourceuseage=brongebruik
SYSTEMMONITORING=SYSTEEM MONITOR
Processorload=Processorgebruik
Systemmemory=Fysiek geheugen
Virtualmemory=Virtueel geheugen
Primaryharddrive=Primaraire harde schijf
Secondaryharddrive=Secundaire harde schijf
information=informatie
system=systeem
info=info
dateandtime=datum en tijd
networkoptions=netwerk opties
poweroptions=energiebeheer opties
audiooptions=audio opties
themeoptions=thema opties
displayoptions=weergave opties
useraccounts=gebruikersaccounts
windowsupdate=windows update
monitorsconnected=monitor(en) aangesloten
loggedinas=Ingelogd als
installupdatesevery=Installeer updates: elke 
today=vandaag
forecast=Weersverwachting
BaroMeter=Barometer
Humidity=Luchtvochtigheid
Visibility=Zicht
Wind=Wind
Windchill=Gevoelstemperatuur
Winddirection=Windrichting
Sunrise=Zonsopgang
Sunset=Zonsondergang

world=wereld
worldclock=wereld klok
Localtime=Lokale tijd
Translator=Vertaler
Stocks=Aandelen
PowerPlan=Energiebeheer
Select=Selecteer
Balanced=Gebalanceerd
HighPerf=Hoge prestaties
PowerSaver=Energiebesparing

Radio=Radio
Playlists=Afspeellijsten

Style=Stijl
Settings=Instellingen
normalcolorTR=Normale kleur
hovercolorTR=Hover kleur
textcolorTR=Tekst kleur
textitemscolorTR=Tekst items kleur
bordercolorTR=Border kleur
borderstyleTR=Border Stijl
aeroglass=Aero Glass
roundedTR=Afgerond
centertext=Centreer tekst
changecolor=Wijzig kleur
opacityTR=transparantie
resizepanels=Paneelgrootte wijzigen
Addons=Add-ons
moreaddons=Meer Add-ons

Calendar=Kalender
Devices=Apparaten
Sound=Geluid
ControlPanel=Configuratiescherm
Radio=Radio
Playlists=Afspeellijsten
ColorConverter=Kleur Converter
Convert=Converteer
ImageConverter=Converter
SunClock=Zonneklok
Eject=Uitwerpen
timelineview=Tijdlijn bezichtiging
timeline=Tijdlijn

off=Uit

donothing=De geselecteerde actie wordt automatisch uitgevoerd na 10 seconden.

Sleep=Slaapstand
Logoff=Afmelden
Shutdown=Afsluiten
Restart=Herstarten
Hibernate=Sluimerstand
cancel=Annuleren

clickhereforgallery=Klik hier voor de galerij
changegallerytheme=Wijzig galerij thema

StartText=Start
Computer=Computer

SetString=Instellen
CloseString=Sluit

WeatherForecast=Weersvoorspelling
Lock=Vergrendelen

Headers=Headers

TrayIcons=Tray icons

Fahrenheit=Fahrenheit
24HourTime=24 uur formaat
RSSDecoding=RSS Decoderen
ArrowStyle=Knop stijl

LayoutThemes=Omnimo Thema

Checkforupdates=Updates controleren
Goodmorning=Goede morgen
Goodafternoon=Goede middag
Goodevening=Goede avond
Greetings=Hallo
sunasinstar=Zon
Pressure=Luchtdruk

Browserballot=Browser kiezer
Connected=Verbonden
storage=Opslag
Desktop=Bureaublad
Finance=Fininciën
Photos=Foto's
Reader=Reader
languagename=Taal
default=[herstellen naar standaard]
Font=Lettertype
font1=Lettertype 1
font2=Lettertype 2
font3=Lettertype 3
noupdates=Geen updates
newupdate=Update Beschikbaar!
extras=Extra's
Styles=Stijlen
quickaccess=Snelle toegang
time=Tijd
weather=Weer
mail=Mail
morepcsettings=Meer PC Instellingen
Wifi=Wi-Fi
Mute=Dempen
extrawidth=20
brightness=Helderheid

Layouts=£Layouts
Toggle=£Schakelaar
Advanced=£Geavanceerd
Simple=£Makkelijk
ResizeAllPanels=£Wijzig het formaat van alle panelen
FontString=£Lettertype
TogglePanelIcons=£(de)activeer paneel iconen
SidebarColors=£Zijbalk kleur
Menu=£Menu
High=Hoog
Low=Laag
MiddleClickToDelete=Middelmuisknop om paneel te verwijderen
CreatePanel=Creëer Paneel
ViewPanels=Bekijk panelen
donothing1=£De geselecteerde actize al worden uitgevoerd in
donothing2=seconden.
 
DominantRSS=http://www.nu.nl/feeds/rss/algemeen.rss
DominantRSSName=NU.NL
 
viewall=Bekijk alle
videotutorials=Video Tutorials



