[Variables]
extrawidth=0
translation=English
Translated=fediaFedia
langoverride=0
ChangeColors=Change Colors
DominantRSS=http://feeds.bbci.co.uk/news/rss.xml
DominantRSSName=BBC

languagedomain=com
individualpanelcolor=Individual Panel Color
programs=Programs
systemtools=System Tools
alarm1=Alarm
Set=set
Snooze=snooze
Videos=Videos
Music=Music
TV=TV
Pictures=Pictures
openfolder=Open
new=new
no=0
Picturesfoldername=Images folder
applications=applications
editnotes=Edit notes
games=games

Calendar=Calendar
Monday=Monday
Tuesday=Tuesday
Wednesday=Wednesday
Thursday=Thursday
Friday=Friday
Saturday=Saturday
Sunday=Sunday
January=January
February=February
March=March
April=April
May=May
June=June
July=July
August=August
September=September
October=October
November=November
December=December
Tonight=Tonight
Mon=Mon
Tue=Tue
Wed=Wed
Thu=Thu
Fri=Fri
Sat=Sat
Sun=Sun
Januaryshort=Jan.
Februaryshort=Feb.
Marchshort=Mar.
Aprilshort=Apr.
Mayshort=May
Juneshort=Jun.
Julyshort=Jul.
Augustshort=Aug.
Septembershort=Sept.
Octobershort=Oct.
Novembershort=Nov.
Decembershort=Dec.

ControlPanel=Control Panel
Devices=Devices
Sound=Sound
Gamesexplorer=Games explorer
Friends=friends
internetshortcuts=INTERNET SHORTCUTS
People=People

Gallery=Gallery
Panels=Panels

Items=Items
Size=Size
Battery=Battery
ACLine=AC Line
Power=Power
Uptime=uptime
Memory=Memory
CORE=CPU

harddrives=hard drives
Free=Free
Space=Space
Used=Used
tools=tools
downloads=downloads
Network=Network
Setaswallpaper=Set as wallpaper
RecycleBin=Recycle Bin

;weather
MostlyCloudy=Mostly Cloudy
LightSnow=Light Snow
LightRain=Light Rain
Cloudy=Cloudy
Drizzle=Drizzle
And=and
Partly=Partly
Mostly=Mostly
with=with
Clear=Clear
Fair=Fair
PartlyCloudy=Partly Cloudy
Cloudy=Cloudy
FreezingRain=Cold Rain
Rain=Rain
Thunder=Thunder
intheVicinity=
Shower=Shower
Snow=Snow
Sunny=Sunny
Windy=Windy
Haze=Haze
Fog=Fog
WidespreadDust=Dust
Set=Set
T-Storm=Thunder Storm
LightDrizzle=Drizzle
WintryMiX=Wintry Mix
Light=Light

notconfigured=Not configured
Updates=Updates
Currentversion=Current version
NoUpdatesAvailable=No Updates Available
news=news
feeds=feeds
systemstorage=system storage
BinaryClock=Binary Clock
noresize=This panel isn't resizable
countdown=Countdown
start=start
stop=stop
settimer=set
reset=reset
IPAddress=IP Address
Empty=Empty
Processor=Processor
Volume=Volume
systeminfo=System Info

;The user panel - ME as in "I"

ME=ME
Wireless=Wireless
Folders=Folders
Maps=Maps
Search=Search
MoonPhase=Moon phase
;Stock makret
Stocks=Stocks
Calculator=Calculator
Camera=Screenshot
Notestitle=Notes

;GALLERY
PCINFO=PC INFO
SHORTCUTS=SHORTCUTS
INTERNET=INTERNET
INSTALLEDPANELS=INSTALLED PANELS
INSTALLEDTHEMES=INSTALLED THEMES
ALLTEXTITEMS=ALL TEXTITEMS

;Better ignore these 2
textitems=Text Items

Close= CLOSE [x]
Apply=  APPLY

all=all
unreademails=unread emails
inboX=inbox
resource=resource
resourceuseage=resource usage
SYSTEMMONITORING=SYSTEM MONITORING
Processorload=Processor load
Virtualmemory=Virtual memory
Primaryharddrive=Primary hard drive
Secondaryharddrive=Secondary hard drive
information=information
system=system
info=info
networkoptions=network options
displayoptions=display options
windowsupdate=Windows Update
today=today
forecast=forecast
BaroMeter=Barometer
Humidity=Humidity
Visibility=Visibility
Wind=Wind
Windchill=Wind chill
Winddirection=Wind direction
Sunrise=Sunrise
Sunset=Sunset

world=world
worldclock=world clock
Localtime=Local time
Translator=Translator
Stocks=Stocks
PowerPlan=Power Plan
Select=Select

Radio=Radio
Playlists=Playlists

Style=Style
Settings=Settings
normalcolorTR=Normal Color
hovercolorTR=Hover Color
textcolorTR=Text Color
textitemscolorTR=TextItems Color
bordercolorTR=Border Color
borderstyleTR=Border Style
aeroglass=Aero Glass
roundedTR=Rounded
centertext=Center Text
changecolor=Change color
opacityTR=Opacity
resizepanels=Resize all Panels
moreaddons=MORE ADD-ONS

donatorpanels=Donator Panels
donateifyoulike=Donate if you like :)
Calendar=Calendar
Devices=Devices
Sound=Sound
ControlPanel=Control Panel
Radio=Radio
Playlists=Playlists
ColorConverter=Color Converter
Convert=Convert
ImageConverter=Image Converter
SunClock=Sun Clock
Eject=Eject

Thanks=Thanks
Donation=We spent a lot of time on Omnimo, if you wish to show your gratitude, please consider donating to help maintain the server costs and for future projects.

off=Off


Sleep=Sleep
Logoff=Log off
Shutdown=Shutdown
Restart=Restart
Hibernate=Hibernate
cancel=Cancel

clickhereforgallery=Click here for Gallery
changegallerytheme=Change gallery theme
StartText=Start
Addons=Add-ons
Computer=Computer

WeatherForecast=Weather forecast
Lock=Lock
Headers=Headers
TrayIcons=Tray icons
Fahrenheit=Fahrenheit
24HourTime=24 Hour Time
RSSDecoding=RSS Decoding
ArrowStyle=Arrow Style
LayoutThemes=Layout Themes
Checkforupdates=Check for Updates
Goodmorning=Good morning
Goodafternoon=Good afternoon
Goodevening=Good evening
Greetings=Greetings
sunasinstar=Sun
Pressure=Pressure
Browserballot=Browser ballot
Connected=Connected
storage=Storage
Desktop=Desktop
Finance=Finance
Photos=Photos
Reader=Reader
languagename=Language
default=[reset to default]
Font=Font
font1=Normal Font
font2=Semibold Font
font3=Light Font
noupdates=No updates
newupdate=New update available!
extras=Extras
Styles=Styles
quickaccess=Quick access
time=Time
weather=Weather
mail=Mail
morepcsettings=More PC Settings
Wifi=Wi-Fi
Mute=Mute
extrawidth=0
brightness=Brightness

Layouts=Layouts
Toggle=Toggle
Advanced=Advanced
Simple=Simple
ResizeAllPanels=Resize All Panels
FontString=Font
TogglePanelIcons=Toggle Panel Icons
SidebarColors=Sidebar Colors
Menu=Menu
High=High
Low=Low
MiddleClickToDelete=Middle click to delete panel
CreatePanel=Create Panel
ViewPanels=View Panels
donothing1=The selected action will be performed in
donothing2=seconds.
viewall=View all...
videotutorials=Video Tutorials

