[Variables]

;-------------------------------------------------------------
;-------------------------------------------------------------

;Please understand me i can not able to translate the skin to each language,but you can translate at yours.
;If you want to help me translate into your language,see the instruction,translate to your language,and please share fuly translated language to me,
;and i will add it in the next update. :)

;HOW TO TRANSLATE TO YOUR LANGUAGE?
;Replace the word that is right to the colon [:] with your language translation.
;Leave the quotation marks intact and separate each section with a comma [,].
;It`s simple,just look below :)

;NOTES:
;But if just in case,something is not clear,you'll see clearly below,
;how it looks translated language,for example,German. :)
;Date="Sunday":"Sonntag","Monday":"Montag","Tuesday":"Dienstag","Wednesday":"Mittwoch","Thursday":"Donnerstag","Friday":"Freitag","Saturday":"Samstag"Date="Sunday":"Sonntag","Monday":"Montag","Tuesday":"Dienstag","Wednesday":"Mittwoch","Thursday":"Donnerstag","Friday":"Freitag","Saturday":"Samstag","January":"Januar","February":"Februar","March":"März","Aprril":"April","May":"May","Jun":"Juni","July":"Juli","August":"August","September":"September","October":"Oktober","November":"November","December":"Dezember"
;Conditions="Thunderstorms":"Gewitter","Windy Rain":"Wind und Regen","T-Storms":"Gewitter","Rain Snow":"Schneeregen","Sleet":"Graupel","Snow/Rain Icy Mix":"Gefrorener Schneeregen","Freezing Drizzle":"Gefrierender Niesel","Drizzle":"Niesel","Freezing Rain":"Gefrierender Regen","T-Showers":"Platzregen","Showers":"Regenschauer","Light Rain":"Leichter Regen","Heavy Rain":"Heftiger Regen","Snow Flurries":"Vereinzelte Schneefall","Light Snow":"Leichter Schneefall","Snowflakes":"Schneeflocken","Heavy Snow":"Heftiger Schneefall","Hail":"Hagel","Dust":"Staub","Fog":"Nebel","Haze":"Dunst","Smoke":"Rauch","Windy":"Windig","Frigid":"Kühl","Partly Cloudy":"Teilweise bewölkt","Mostly Cloudy":"Stark bewölkt","Clear":"Klar","Sunny":"Sonnig","Fair":"Heiter","Mostly Clear":"Klar","Mostly Sunny":"Meist Sonnig","Hot":"Heiß","Isolated Thunder":"Vereinzelt Donner","Scattered T-Storms":"Vereinzelte Gewitter","Scattered Rain":"Vereinzelt Regen","Scattered Snow":"Vereinzelt Schneefall","Windy/Snowy":"Windig/Schneefall","Scattered wers":"Vereinzelte Regenschauer","Snowy":"Schneefall","and":"und","Shower":"Schauer","Mostly":"Meist","Scattered":"Vereinzelt","Rain":"Regen","Snow":"Schneefall","Wind":"Wind","Early":"Morgens","Late":"Abends","PM":"Nachmittags","AM":"Vormittags","Sun":"Sonne","Clouds":"Wolken","Cloudy":"Bewölkt","Cloud":"Wolke","Light":"Leicht","Snow Shower":"Schneefall","Widespread":"Verbreitet","Few":"Wenig","Isolated":"Vereinzelt","Mist":"Leichter Nebel","Thunder":"Donner","with":"Mit","In the Vicinity":"In der Nähe"

;-------------------------------------------------------------
;-------------------------------------------------------------

;Translate to your language below:

Hour="23":"Twenty Three","22":"Twenty Two","21":"Twenty One","20":"Twenty","19":"Nineteen","18":"Eighteen","17":"Seventeen","16":"Sixteen","15":"Fifteen","14":"Fourteen","13":"Thirteen","12":"Twelve","11":"Eleven","10":"Ten","9":"Nine","8":"Eight","7":"Seven","6":"Six","5":"Five","4":"Four","3":"Three","2":"Two","1":"One","0":"Twelve"," ":""

Minute="59":"Fifty Nine","58":"Fifty Eight","57":"Fifty Seven","56":"Fifty Six","55":"Fifty Five","54":"Fifty Four","53":"Fifty Three","52":"Fifty Two","51":"Fifty One","50":"Fifty","49":"Forty Nine","48":"Forty Eight","47":"Forty Seven","46":"Forty Six","45":"Forty Five","44":"Forty Four","43":"Forty Three","42":"Forty Two","41":"Forty One","40":"Forty","39":"Thirty Nine","38":"Thirty Eight","37":"Thirty Seven","36":"Thirty Six","35":"Thirty Five","34":"Thirty Four","33":"Thirty Three","32":"Thirty Two","31":"Thirty One","30":"Thirty","29":"Twenty Nine","28":"Twenty Eight","27":"Twenty Seven","26":"Twenty Six","25":"Twenty Five","24":"Twenty Four","23":"Twenty Three","22":"Twenty Two","21":"Twenty One","20":"Twenty","19":"Nineteen","18":"Eighteen","17":"Seventeen","16":"Sixteen","15":"Fifteen","14":"Fourteen","13":"Thirteen","12":"Twelve","11":"Eleven","10":"Ten","09":"OH Nine","08":"OH Eight","07":"OH Seven","06":"OH Six","05":"OH Five","04":"OH Four","03":"OH Three","02":"OH Two","01":"OH One","9":"Nine","8":"Eight","7":"Seven","6":"Six","5":"Five","4":"Four","3":"Three","2":"Two","1":"One","00":"O' Clock","0":"O' Clock"

Date="Sunday":"Sunday","Monday":"Monday","Tuesday":"Tuesday","Wednesday":"Wednesday","Thursday":"Thursday","Friday":"Friday","Saturday":"Saturday"

Conditions="Thunderstorms":"Thunderstorms","Windy Rain":"Windy Rain","T-Storms":"T-Storms","Rain Snow":"Rain Snow","Sleet":"Sleet","Snow/Rain Icy Mix":"Snow/Rain Icy Mix","Freezing Drizzle":"Freezing Drizzle","Drizzle":"Drizzle","Freezing Rain":"Freezing Rain","T-Showers":"T-Showers","Showers":"Showers","Light Rain":"Light Rain","Heavy Rain":"Heavy Rain","Snow Flurries":"Snow Flurries","Light Snow":"Light Snow","Snowflakes":"Snowflakes","Heavy Snow":"Heavy Snow","Hail":"Hail","Dust":"Dust","Fog":"Fog","Haze":"Haze","Smoke":"Smoke","Windy":"Windy","Frigid":"Frigid","Partly Cloudy":"Partly Cloudy","Cloudy":"Cloudy","Mostly Cloudy":"Mostly Cloudy","Clear":"Clear","Sunny":"Sunny","Fair":"Fair","Mostly Clear":"Mostly Clear","Mostly Sunny":"Mostly Sunny","Hot":"Hot","Isolated Thunder":"Isolated Thunder","Scattered T-Storms":"Scattered T-Storms","Scattered Rain":"Scattered Rain","Scattered Snow":"Scattered Snow","Windy/Snowy":"Windy/Snowy","Scattered Showers":"Scattered Showers","Snowy":"Snowy","and":"and","Shower":"Shower","Mostly":"Mostly","Scattered":"Scattered","Rain":"Rain","Snow":"Snow","Wind":"Wind","Early":"Early","Late":"Late","PM":"PM","AM":"AM","Sun":"Sun","Cloud":"Cloud","Light":"Light","Snow Shower":"Snow Shower","Widespread":"Widespread","Few":"Few","Isolated":"Isolated","Mist":"Mist","Thunder":"Thunder","with":"with","In the Vicinity":"In the Vicinity","Clouds":"Clouds","Clearing":"Clearing"

celsius=celsius

fahrenheit=fahrenheit

Weather conditions for today in=Weather conditions for today in

is=is

with temperature from=with temperature from

Wind speed in your location is=Wind speed in your location is

and humidity is=and humidity is