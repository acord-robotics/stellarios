[Variables]

;-------------------------------------------------------------
;-------------------------------------------------------------

Hour="23":"Twenty Three","22":"Twenty Two","21":"Twenty One","20":"Twenty","19":"Nineteen","18":"Eighteen","17":"Seventeen","16":"Sixteen","15":"Fifteen","14":"Fourteen","13":"Thirteen","12":"Twelve","11":"Eleven","10":"Ten","9":"Nine","8":"Eight","7":"Seven","6":"Six","5":"Five","4":"Four","3":"Three","2":"Two","1":"One","0":"Twelve"," ":""

Minute="59":"Fifty Nine","58":"Fifty Eight","57":"Fifty Seven","56":"Fifty Six","55":"Fifty Five","54":"Fifty Four","53":"Fifty Three","52":"Fifty Two","51":"Fifty One","50":"Fifty","49":"Forty Nine","48":"Forty Eight","47":"Forty Seven","46":"Forty Six","45":"Forty Five","44":"Forty Four","43":"Forty Three","42":"Forty Two","41":"Forty One","40":"Forty","39":"Thirty Nine","38":"Thirty Eight","37":"Thirty Seven","36":"Thirty Six","35":"Thirty Five","34":"Thirty Four","33":"Thirty Three","32":"Thirty Two","31":"Thirty One","30":"Thirty","29":"Twenty Nine","28":"Twenty Eight","27":"Twenty Seven","26":"Twenty Six","25":"Twenty Five","24":"Twenty Four","23":"Twenty Three","22":"Twenty Two","21":"Twenty One","20":"Twenty","19":"Nineteen","18":"Eighteen","17":"Seventeen","16":"Sixteen","15":"Fifteen","14":"Fourteen","13":"Thirteen","12":"Twelve","11":"Eleven","10":"Ten","09":"OH Nine","08":"OH Eight","07":"OH Seven","06":"OH Six","05":"OH Five","04":"OH Four","03":"OH Three","02":"OH Two","01":"OH One","9":"Nine","8":"Eight","7":"Seven","6":"Six","5":"Five","4":"Four","3":"Three","2":"Two","1":"One","00":"O' Clock","0":"O' Clock"

Date="Sunday":"Sunday","Monday":"Monday","Tuesday":"Tuesday","Wednesday":"Wednesday","Thursday":"Thursday","Friday":"Friday","Saturday":"Saturday"

Conditions="Thunderstorms":"Thunderstorms","Windy Rain":"Windy Rain","T-Storms":"T-Storms","Rain Snow":"Rain Snow","Sleet":"Sleet","Snow/Rain Icy Mix":"Snow/Rain Icy Mix","Freezing Drizzle":"Freezing Drizzle","Drizzle":"Drizzle","Freezing Rain":"Freezing Rain","T-Showers":"T-Showers","Showers":"Showers","Light Rain":"Light Rain","Heavy Rain":"Heavy Rain","Snow Flurries":"Snow Flurries","Light Snow":"Light Snow","Snowflakes":"Snowflakes","Heavy Snow":"Heavy Snow","Hail":"Hail","Dust":"Dust","Fog":"Fog","Haze":"Haze","Smoke":"Smoke","Windy":"Windy","Frigid":"Frigid","Partly Cloudy":"Partly Cloudy","Cloudy":"Cloudy","Mostly Cloudy":"Mostly Cloudy","Clear":"Clear","Sunny":"Sunny","Fair":"Fair","Mostly Clear":"Mostly Clear","Mostly Sunny":"Mostly Sunny","Hot":"Hot","Isolated Thunder":"Isolated Thunder","Scattered T-Storms":"Scattered T-Storms","Scattered Rain":"Scattered Rain","Scattered Snow":"Scattered Snow","Windy/Snowy":"Windy/Snowy","Scattered Showers":"Scattered Showers","Snowy":"Snowy","and":"and","Shower":"Shower","Mostly":"Mostly","Scattered":"Scattered","Rain":"Rain","Snow":"Snow","Wind":"Wind","Early":"Early","Late":"Late","PM":"PM","AM":"AM","Sun":"Sun","Cloud":"Cloud","Light":"Light","Snow Shower":"Snow Shower","Widespread":"Widespread","Few":"Few","Isolated":"Isolated","Mist":"Mist","Thunder":"Thunder","with":"with","In the Vicinity":"In the Vicinity","Clouds":"Clouds","Clearing":"Clearing"

celsius=celsius

fahrenheit=fahrenheit

Weather conditions for today in=Weather conditions for today in

is=is

with temperature from=with temperature from

Wind speed in your location is=Wind speed in your location is

and humidity is=and humidity is